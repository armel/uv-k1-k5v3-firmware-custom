/* Copyright 2026 Johan Denoyer F4WAT
 * https://github.com/jdenoy
 *
 * Licensed under the Apache License, Version 2.0 (the "License");
 * you may not use this file except in compliance with the License.
 * You may obtain a copy of the License at
 *
 *     http://www.apache.org/licenses/LICENSE-2.0
 *
 *     Unless required by applicable law or agreed to in writing, software
 *     distributed under the License is distributed on an "AS IS" BASIS,
 *     WITHOUT WARRANTIES OR CONDITIONS OF ANY KIND, either express or implied.
 *     See the License for the specific language governing permissions and
 *     limitations under the License.
 */

/*
 * EPIRB 406 (RX only) - decodes first-generation Cospas-Sarsat 406 MHz beacon
 * messages on the radio. Tune the VFO (FM, wide; 406.031 MHz covers the
 * 406.025-406.040 channels, or a test generator's frequency), then launch.
 *
 * The receiver is switched to RAW (RX HPF300 / LPF3K / de-emphasis and AFC off)
 * and the RX audio is left on: it reaches PA4 (the voice DAC pin, unused while
 * voice is disabled), held at mid-scale by the MCU DAC (unbuffered) and sampled
 * on ADC channel 4 at 9.6 kHz, timed from
 * SysTick, from the moment RSSI shows a burst. Samples go straight into dec406
 * (see README.md); the last five decoded messages stay in RAM.
 *
 * A decoded message plays three beeps, whatever the speaker setting.
 * Keys (UV-K5 and UV-K1): UP/DOWN scroll, then select the newer / older message
 *   at an end · * normal / compact view · 4/6 tune -/+5 kHz (up to +/-50 kHz)
 *   · 5 back to the VFO frequency · 1 speaker on/off · MENU clear · EXIT quit.
 * The loader re-runs RADIO_SetupRegisters on exit (amplifier off); the resident capture
 * (af_capture_close) restores the ADC, PA4, the DAC and its clock.
 * Screen texts and protocol names are read-only assets (gen_assets.py, API
 * level 2), kept out of the 4 KiB overlay.
 */

#include <stdint.h>
#include <stdbool.h>
#include <stddef.h>
#include "../app_api.h"
#include "epirb406_assets.h"   /* generated by gen_assets.py */
#define DEC406_LEAN            /* no idData / stdLoc: not displayed */
#include "dec406.c"

/* ---- sampling: the PA4 capture and the 48 MHz cycle clock are resident
 * (API level 3); the capture holds PA4 at mid-scale ---- */
#define CYC_PER_SAMPLE (48000000u / DEC406_FS)     /* 5000 */
#define CAP_MAX_CYC    (48000000u / 1000u * 900u)  /* 900 ms after trigger */

/* ---- BK4829 RAW receive ---- */
#define REG_2B      0x2B
#define REG_73      0x73
#define REG_38      0x38   /* RX frequency, 10 Hz units, low 16 bits  */
#define REG_39      0x39   /* RX frequency, high 16 bits              */
#define STEP_10HZ   500    /* 5 kHz                                   */
#define OFF_MAX     10     /* +/- 10 steps = +/- 50 kHz               */

#define TRIG_DB     10
#define REARM_DB    5
#define COOL_MS     1500
#define TICK_MS     50
#define KEY_POLL_START_CYC (48000000u / 1000u * 300u)
#define KEY_POLL_CYC       (48000000u / 1000u * TICK_MS)
#define HISTORY     5u
#define CAPS_END    127u
#define SCROLL_X    72u
#define SPK_X       59u
#define VIEW_COMPACT 1u
#define BODY_BOTTOM 39u
#define BEEP_HZ     1536u   /* 3 << 9: a cheap Thumb constant */
#define BEEP_MS     150u
#define SETTLE_MS   50u     /* tune(): REG_30 cycle to amplifier on (5 ms clicked) */

typedef struct {
    dec406_info_t info;
    int16_t rssi;
    uint16_t seq;
} frame_t;

typedef struct {
    uint8_t spk, view;                  /* persistent byte order */
} app_cfg_t;
_Static_assert(sizeof(app_cfg_t)==2u && offsetof(app_cfg_t,view)==1u,
               "EPIRB config layout changed");

/* The app state in one struct: a function loads one base address instead of one
 * literal-pool word per global. Frequently used fields stay close to that base
 * for the Thumb load/store immediate ranges. The loader zeroes the overlay
 * (.bss) at every launch. */
static struct {
    const app_api_t *A;
    frame_t **history;                  /* newest first; records live on app_main's stack */
    uint32_t vfoFreq;                  /* VFO RX frequency at launch, 10 Hz units  */
    int32_t  floorQ;                   /* noise floor, dBm x64                     */
    uint32_t coolUntil;                /* wall-clock deadline for RSSI rearming    */
    uint8_t  count, cur, prevKey, lastErr;
    app_cfg_t cfg;
    int8_t   offSteps;                 /* tuning offset from the VFO, 5 kHz steps  */
    bool     running;
    int16_t  rssi;                     /* current RSSI                             */
    uint16_t vrow, top, lim, nSync, nFail; /* UI and counters */
} g;

/* ---- formatting ---- */
static char *put(char *o,const char *s){ while(*s)*o++=*s++; return o; }
/* Formatting by repeated subtraction: no division, so no __udivsi3 in the
 * 4 KiB overlay. Values printed stay below 100000. */
static unsigned sub(uint32_t *v,uint32_t d){ unsigned q=0; while(*v>=d){ *v-=d; q++; } return q; }
/* The resident formatter (API level 3). One local stub keeps every call a
 * plain bl: the service lies past the ldr immediate range of the table. */
__attribute__((noinline))
static char *puti(char *o,int32_t v){ return g.A->append_i32(o,v); }
/* Arc seconds to truncated decimal degrees followed by the hemisphere. */
static char *putPos(char *o,int32_t s,char pos,char neg){
    uint32_t a=(uint32_t)(s<0?-s:s);
    o=puti(o,sub(&a,3600u)); *o++='.';
    for(unsigned k=0;k<5u;k++){ a*=10u; *o++=(char)('0'+sub(&a,3600u)); }
    *o++= s<0?neg:pos;
    return o;
}
/* Flags row: every text starts with a space, skipped by the caller. */
static char *putFlags(char *o,const dec406_info_t *in,const char *s){
    if(in->internalPos){            /* bit 1: source flag present */
        o=put(o,(in->internalPos&1u)?s+T_INT:s+T_EXT);
        if(in->homing) o=put(o,s+T_HOMING);
    }
    if(in->hasPos&&!in->hasFine) o=put(o,s+T_COARSE);
    if(in->idRaw) o=put(o,in->idRaw>1u?s+T_CANCEL:s+T_RAWID);
    return o;
}
static void tiny(char *buf,uint8_t x,uint8_t y,char *end){ *end='\0'; g.A->print_tiny(buf,x,y,false,true); }

/* RX audio as the decoder needs it: AF in FM (PA4 follows the AF DAC), speaker
 * amplifier as configured. */
static void rxAudio(void){ g.A->set_af(APP_AF_FM); g.A->audio_path(g.cfg.spk); }

/* ---- tuning: offset the RX frequency from the VFO (restored by the loader on exit) ---- */
static void tune(void){
    /* Amplifier off first, as AUDIO_PlayBeep does: the REG_30 cycle below steps
     * the AF DAC output, a loud click if amplified. The two frequency writes
     * give it a head start; rxAudio() turns it back on if the speaker is on. */
    g.A->audio_path(false);
    uint32_t f=(uint32_t)((int32_t)g.vfoFreq+(int32_t)g.offSteps*STEP_10HZ);
    g.A->bk_write(REG_38,(uint16_t)(f&0xFFFFu));
    g.A->bk_write(REG_39,(uint16_t)(f>>16));
    g.A->tones_off_rx();         /* REG_30 to 0 then RX: VCO recalibration, relock */
    g.A->delay_ms(SETTLE_MS);    /* the AF output re-centres on the PA4 bias: amplifier still off */
    rxAudio();
}
/* "433.645" from 10 Hz units, rounded to the kHz, without division */
static char *putFreq(char *o,uint32_t f){
    f+=50u;
    o=puti(o,(int32_t)sub(&f,100000u)); *o++='.';
    *o++=(char)('0'+sub(&f,10000u)); *o++=(char)('0'+sub(&f,1000u)); *o++=(char)('0'+sub(&f,100u));
    return o;
}

/* ---- one burst: sample PA4 at 9.6 kHz into the decoder ---- */
/* Not inlined into app_main: smaller that way (4 KiB overlay). */
__attribute__((noinline)) static uint8_t capture(void){
    dec406_t d;
    dec406_init(&d,true);        /* INT: integrate the discriminator pulses */
    /* The two per-sample services, held in registers: their table slots lie
     * past the ldr immediate range. Time counts from the trigger. */
    uint32_t (*const clk)(void)=g.A->cycles_48mhz;
    uint16_t (*const sample)(void)=g.A->af_capture_sample;
    const uint32_t t0=clk();
    uint32_t next=0;
    uint32_t nextKey=KEY_POLL_START_CYC;
    bool done=false;
    while(next<CAP_MAX_CYC){
        uint32_t cyc;
        while((cyc=clk()-t0)<next){}
        if(dec406_push(&d,sample())){ done=true; break; }
        if(d.state==DEC406_SEARCH && cyc>=nextKey){
            nextKey+=KEY_POLL_CYC;
            uint8_t key=g.A->get_key();
            if(key<APP_KEY_INVALID) return key;
        }
        next+=CYC_PER_SAMPLE;
    }

    if(!done){ g.nFail++; g.lastErr=d.state==DEC406_DATA?2u:1u; return APP_KEY_INVALID; }
    g.nSync++; g.lastErr=0;
    frame_t *f=g.history[HISTORY-1u];
    for(unsigned k=HISTORY-1u;k;k--) g.history[k]=g.history[k-1u];
    g.history[0]=f;
    dec406_parse(&d,&f->info);
    f->rssi=g.rssi;              /* RSSI at the trigger (not updated while sampling) */
    f->seq=g.nSync;
    if(g.count<HISTORY) g.count++;
    g.cur=0;
    g.top=0;
    /* Decode alert, even with the speaker off: three 150 ms beeps, 150 ms apart.
     * The gaps are 0 Hz "tones" (REG_71 = 0, no output): the same call as a beep,
     * cheaper than a delay. The burst is over and the next one is ~50 s away.
     * tune() then cuts the amplifier and brings RX, the AF and the speaker back. */
    g.A->prepare_tone();
    g.A->audio_path(true);
    for(unsigned hz=BEEP_HZ, n=5u; n; n--, hz^=BEEP_HZ) g.A->play_tone_raw((uint16_t)hz,BEEP_MS);
    tune();
    return APP_KEY_INVALID;
}

/* ---- display ---- */
/* Render one row on scratch page 6, then shift each column into at most two
 * framebuffer pages. The fixed ID and diagnostic rows are redrawn afterwards. */
static void emit(char *buf,char *end){
    const app_api_t *A=g.A;
    *end='\0';
    unsigned y=(unsigned)g.vrow-g.top;
    if(y<BODY_BOTTOM){
        uint8_t *scratch=A->fb[6];
        if(g.cfg.view) A->print_tiny(buf,0,48,false,true);
        else A->print_normal(buf,0,0,6);
        unsigned page=y>>3, shift=y&7u;
        for(unsigned x=0;x<128u;x++){
            uint16_t bits=(uint16_t)scratch[x]<<shift;
            uint8_t *out=A->fb[page]+x;
            if(page==4u) bits&=0x7Fu;  /* y = 39 stays blank */
            *out|=(uint8_t)bits;
            if(page<4u) out[128]|=(uint8_t)(bits>>8);
            scratch[x]=0;
        }
    }
    g.vrow+=g.cfg.view?6u:8u;
}

static void draw(void){
    /* The UI texts live in the assets: one read per frame into this word-aligned
     * stack block, so each text costs a 2-byte sp-relative add instead of a
     * literal and its pool word (gen_assets.py keeps every offset aligned). */
    char s[UI_SIZE] __attribute__((aligned(4)));
    char str[34];
    char *o;
    g.A->asset_read(0,s,UI_SIZE);
    g.A->display_clear();
    g.A->status_clear();
    g.A->print_inverse(s+T_TITLE,2,0,true,true,(uint8_t)(2u+T_TITLE_CHARS*4u));
    g.A->draw_battery();
    g.vrow=8;

    if(!g.count && (g.A->ticks_ms()&512u)){
        g.vrow+=8u;
        o=put(str,s+T_WAIT);
        emit(str,o);
    }

    if(g.count){
        const frame_t *frame=g.history[g.cur];
        const dec406_info_t *in=&frame->info;

        /* Normal view has five or six rows, plus one when coordinates wrap.
         * Compact view has four or five rows depending on metadata. */
        o=puti(str,in->country); *o++=' ';
        o+=g.A->asset_read((uint16_t)(T_PROTO+in->proto*T_PROTO_STRIDE),o,T_PROTO_STRIDE);
        emit(str,o);

        if(in->hasPos){
            char *latEnd=putPos(str,in->latS,'N','S');
            o=latEnd; *o++=' ';
            o=putPos(o,in->lonS,'E','W');
            if(!g.cfg.view && (unsigned)(o-str)>18u){
                emit(str,latEnd);
                o=putPos(str,in->lonS,'E','W');
            }
        } else o=put(str,s+T_NOPOS);
        emit(str,o);

        /* Flags right below the position, so they show without scrolling. */
        o=putFlags(str,in,s);
        if(o!=str) emit(str+1,o);

        o=str;
        if(in->selftest) o=put(o,s+T_SELFTEST);
        o=put(o,in->longMsg?s+T_LONG:s+T_SHORT);
        emit(str,o);

        o=put(str,s+T_FRAME); o=puti(o,frame->seq); *o++=' '; o=puti(o,frame->rssi); o=put(o,s+T_DBM);
        emit(str,o);

        /* Keep the last row whole above the two fixed information rows. */
        g.lim=g.vrow>40u?g.vrow-40u:0u;

        /* BCH of the selected message, right-aligned on the bottom row. */
        o=put(str,s+T_BCH); o=put(o,in->bch1?s+T_OK:s+T_ERR); *o++='/';
        o=put(o,in->longMsg?(in->bch2?s+T_OK:s+T_ERR):s+T_NA);
        tiny(str,(uint8_t)(128u-(unsigned)(o-str)*4u),49,o);

        /* Fixed ID over the scrolled rows; the tiny history capsule fits in
         * the remaining columns at its right. */
        for(unsigned x=0;x<128u;x++) g.A->fb[0][x]=0;
        g.A->print_bold(in->id,0,0,0);
        if(g.count>1u){
            o=str; *o++=(char)('1'+g.cur); *o++='/'; *o++=(char)('0'+g.count); *o='\0';
            g.A->print_inverse(str,CAPS_END-12u,0,false,true,CAPS_END);
        }
    }

    if(!g.count) g.lim=0;

    unsigned marks=0;
    if(g.top||g.cur) marks|=1u;
    if(g.top<g.lim||g.cur+1u<g.count) marks|=2u;
    if(g.cfg.spk) g.A->asset_read(BMP_SPK,g.A->status_line+SPK_X,SPK_W);
    g.A->asset_read((uint16_t)(BMP_SCROLL+marks*SCROLL_W),g.A->status_line+SCROLL_X,SCROLL_W);

    /* APRS-style dotted separator at y=40, above the two fixed information rows. */
    for(unsigned x=0;x<128u;x+=2u) g.A->fb[5][x]|=0x01u;

    o=put(str,s+T_RX);
    o=putFreq(o,g.vfoFreq+(uint32_t)((int32_t)g.offSteps*STEP_10HZ));
    if(g.offSteps){ *o++=' '; if(g.offSteps>0) *o++='+'; o=puti(o,(int32_t)g.offSteps*5); o=put(o,s+T_KHZ); }
    tiny(str,0,43,o);

    o=puti(str,g.rssi); o=put(o,s+T_SEP); o=puti(o,g.floorQ/64); o=put(o,s+T_DBM);
    tiny(str,(uint8_t)(128u-(unsigned)(o-str)*4u),43,o);

    o=put(str,s+T_FRAME); o=puti(o,g.nSync);
    o=put(o,s+T_ERROR); o=puti(o,g.nFail);
    if(g.lastErr) o=put(o,g.lastErr==1u?s+T_NOSYNC:s+T_CUT);
    tiny(str,0,49,o);
}

/* ---- input ---- */
static void handleKey(uint8_t key){
    int d=(key==APP_KEY_DOWN)-(key==APP_KEY_UP);
    unsigned top=(unsigned)(g.top+d);
    if(top<=g.lim) g.top=(uint16_t)top;
    else if(key!=g.prevKey && (unsigned)(g.cur+d)<g.count){ g.cur=(uint8_t)(g.cur+d); g.top=0; }
    if(key==APP_KEY_INVALID||key==g.prevKey){ g.prevKey=key; return; }
    g.prevKey=key;
    switch(key){
        case APP_KEY_EXIT: g.running=false; break;
        case APP_KEY_1:    g.cfg.spk^=1u; rxAudio(); break;
        case APP_KEY_STAR: g.cfg.view^=VIEW_COMPACT; g.top=0; break;
        case APP_KEY_5:    g.offSteps=0; tune(); break;
        case APP_KEY_MENU: g.count=g.cur=0; g.top=g.lim=0; g.nSync=g.nFail=0; g.lastErr=0; break;
        case APP_KEY_4:
        case APP_KEY_6: {
            int8_t n=(int8_t)(g.offSteps+(key==APP_KEY_4?-1:1));
            if(n>=-OFF_MAX && n<=OFF_MAX){ g.offSteps=n; tune(); }
            break; }
        default: break;
    }
}

__attribute__((section(".text.entry"),used))
void app_main(const app_api_t *api){
    frame_t frames[HISTORY];    /* on the stack: the 4 KiB overlay also holds .bss */
    frame_t *history[HISTORY];
    for(unsigned k=0;k<HISTORY;k++) history[k]=&frames[k];
    g.A=api;
    g.history=history;
    g.prevKey=APP_KEY_INVALID;   /* the rest of g starts at 0 (overlay zeroed by the loader) */

    g.A->af_capture_open();      /* PA4 bias and ADC channel 4, restored by close */
    g.A->backlight_on();
    g.vfoFreq=g.A->rx_freq();
    g.A->bk_write(REG_2B,(uint16_t)((g.A->bk_read(REG_2B)|0x0700u)&~0x0007u));
    g.A->bk_write(REG_73,(uint16_t)(g.A->bk_read(REG_73)|0x0010u));
    g.A->cfg_load(&g.cfg.spk,sizeof g.cfg);
    g.cfg.spk=(uint8_t)(g.cfg.spk==1u);         /* erased flash or junk: speaker off */
    if(g.cfg.view!=VIEW_COMPACT) g.cfg.view=0;  /* normal view by default */
    rxAudio();                                  /* PA4 is before the speaker amplifier */
    g.A->delay_ms(50);

    int32_t f=0;
    for(unsigned i=0;i<16;i++){ f+=g.A->rssi_dbm(); g.A->delay_ms(5); }
    g.floorQ=f*4;

    g.running=true;
    while(g.running){
        uint8_t key=APP_KEY_INVALID;
        for(unsigned i=0;i<TICK_MS;i++){
            g.rssi=g.A->rssi_dbm();
            int32_t fl=g.floorQ/64;          /* noise floor, dBm */
            if(g.coolUntil){
                uint32_t now=g.A->ticks_ms();
                if(g.rssi < fl+REARM_DB || (int32_t)(now-g.coolUntil)>=0)
                    g.coolUntil=0;
                else { g.A->delay_ms(1); continue; }
            }
            if(g.rssi>=fl+TRIG_DB){
                key=capture();
                g.coolUntil=g.A->ticks_ms()+COOL_MS;
                if(!g.coolUntil) g.coolUntil=1u;
                break;
            }
            g.floorQ+=((int32_t)g.rssi*64-g.floorQ)/64;
            g.A->delay_ms(1);
        }
        if(key==APP_KEY_INVALID) key=g.A->get_key();
        handleKey(key);
        if(!g.running) break;
        draw();
        g.A->blit_status();
        g.A->blit_full();
        g.A->battery_sample();
        g.A->backlight_on();         /* keep the screen lit while waiting for bursts (and after a key) */
    }

    g.A->af_capture_close();
    g.A->set_af(APP_AF_MUTE);    /* the loader's RADIO_SetupRegisters turns the amplifier off */
    g.A->cfg_save(&g.cfg.spk,sizeof g.cfg);
}

/* Copyright 2025 Armel F4HWN
 * https://github.com/armel
 *
 * Licensed under the Apache License, Version 2.0 (the "License");
 * you may not use this file except in compliance with the License.
 * You may obtain a copy of the License at
 *
 *     http://www.apache.org/licenses/LICENSE-2.0
 *
 *     Unless required by applicable law or agreed to in writing, software
 *     distributed under the License is distributed on an "AS IS" BASIS,
 *     WITHOUT WARRANTIES OR CONDITIONS OF ANY KIND, either express or implied.
 *     See the License for the specific language governing permissions and
 *     limitations under the License.
 */

/*
 * Breakout — overlay-app port (POC).
 *
 * Self-contained: no firmware headers, no libc. Every resident service is
 * reached through the app_api_t table; the entry point app_main() is forced to
 * blob offset 0 via section ".text.entry". The loader zeroes the 4 KiB overlay,
 * copies this blob in, and calls app_main(&api).
 *
 * No division is linked (libgcc's two would cost ~740 B): numbers are printed
 * by subtracting decimal places, bounce directions come from tables computed
 * by gen_assets.py, and the wall is cleared by counting the bricks left.
 */

#include <stdint.h>
#include <stdbool.h>
#include <stddef.h>
#include "../app_api.h"
#include "breakout_assets.h"   /* generated by gen_assets.py */

#define LCD_WIDTH     128
#define BRICK_NUMBER   18
#define BALL_NUMBER     5

#define BRICK_WIDTH  14
#define BRICK_HEIGHT  5
#define BALL_WIDTH    3
#define BALL_HEIGHT   3
#define RACKET_WIDTH 24
#define RACKET_HEIGHT 2
#define RACKET_Y     50
#define TICK_MS      20u
#define STR_LEN      12u      /* "Score " + 5 digits + NUL */

typedef struct { uint8_t x; uint8_t y; bool destroy; } Brick;
typedef struct { uint8_t x; uint8_t p; } Racket;   /* x: 0..102, even */
typedef struct { int16_t x; int8_t y; int8_t dx; int8_t dy; } Ball;

/* ---- tiny freestanding helpers (replace libc / libgcc-free where cheap) ---- */
void *memset(void *d, int c, size_t n) {
    uint8_t *p = d; while (n--) *p++ = (uint8_t)c; return d;
}
void *memcpy(void *d, const void *s, size_t n) {
    uint8_t *p = d; const uint8_t *q = s; while (n--) *p++ = *q++; return d;
}
static int iabs(int v) { return v < 0 ? -v : v; }
static int imin(int a, int b) { return a < b ? a : b; }

/* ---- all the state in one struct: Thumb-1 code then reaches every field
 * from a single base address (one literal per function instead of one per
 * global), byte fields first so their offsets fit ldrb's 0..31 immediate.
 * It lives in the overlay, which the loader zeroes at each launch. ---- */
struct globals {
    uint8_t  blockAnim, titleTick, levelCountBreakout, gameOverLevel;
    uint8_t  kbdPrev, kbdCur, wallLeft;
    bool     isInitialized, isPaused, saverPaused, saverActive;
    bool     gameOver, redrawRequired, title;
    Racket   racket;
    uint16_t tone, score, gameOverScore;
    int16_t  ballCount;
    Ball     ball;
    const app_api_t *api;
    Brick    brick[BRICK_NUMBER];
};
static struct globals g;
#define A (g.api)

_Static_assert(offsetof(struct globals, title) < 32u, "byte fields out of ldrb range");

/* A random ball dx in -3..3, by multiplication rather than a modulo. */
static int rand_dx(void) { return (int)(((A->rand32() >> 24) * 7u) >> 8) - 3; }

static void reset(void) { g.ballCount = BALL_NUMBER; g.levelCountBreakout = 1; g.score = 0; }

static void playBeep(uint16_t t) { A->play_tone(t, 100); }

/* "<label><value>" in tiny type on the status line: the value zero-padded to
 * w digits, or longer if it needs more (up to 5, no division). */
static void stat(uint16_t label, uint16_t v, uint8_t w, uint8_t x) {
    char s[STR_LEN];
    uint16_t place[5];
    A->asset_read(label, s, TEXT_MAX);
    char *o = s;
    while (*o) o++;
    A->asset_read(PLACE, place, sizeof(place));
    bool lead = true;   /* still in leading zeros beyond the width */
    for (uint8_t i = 0; i < 5u; i++) {
        uint8_t d = 0;
        while (v >= place[i]) { v -= place[i]; d++; }
        if (d || i >= 5u - w) lead = false;
        if (!lead) *o++ = (char)('0' + d);
    }
    *o = '\0';
    A->print_tiny(s, x, 1, true, true);
}

/* A centred bold text from the assets on LCD line `line`. */
static void say(uint16_t off, uint8_t line) {
    char s[TEXT_MAX];
    A->asset_read(off, s, TEXT_MAX);
    A->print_bold(s, 0, LCD_WIDTH - 1, line);
}

static void drawScoreValues(uint8_t level, int16_t balls, uint16_t value) {
    A->status_clear();
    stat(T_LEVEL, level, 2, 0);
    stat(T_BALL,  (balls < 0) ? 0 : (uint16_t)balls, 2, 45);
    stat(T_SCORE, value, 4, 88);
}

static void drawScore(void) { drawScoreValues(g.levelCountBreakout, g.ballCount, g.score); }

static void renderBall(bool state) {
    A->draw_rect(A->fb, g.ball.x, g.ball.y, g.ball.x + BALL_WIDTH - 1, g.ball.y + BALL_HEIGHT - 1, state);
    A->draw_line(A->fb, g.ball.x - 1, g.ball.y + 1, g.ball.x + BALL_WIDTH, g.ball.y + 1, state);
}

static void initBall(void) { g.ball.x = 62; g.ball.y = 30; g.ball.dx = 0; g.ball.dy = 1; renderBall(true); }

/* Bounce off a racket or brick at x, w wide: the new dx for the hit offset
 * x + w - ball.x (-1 at most below 0, as the hit tests allow) comes from a
 * table of the original formula (x + w - ball.x) * -2num / w + num. */
static void bounce(uint16_t table, int x, int w) {
    int8_t dx;
    A->asset_read((uint16_t)(table + (x + w - g.ball.x) + 1), &dx, 1);
    g.ball.dx = dx;
    g.ball.dy = (int8_t)-g.ball.dy;
}

static void initWall(void) {
    Brick *current = g.brick;
    for (uint8_t y = 0; y < 24; y += 8)
        for (uint8_t x = 6; x < 126; x += 20) {
            current->x = x; current->y = y; current->destroy = false; current++;
        }
    g.wallLeft = BRICK_NUMBER;
}

static void initRacket(void);

static void drawBall(void) {
    renderBall(false);
    g.ball.x += g.ball.dx; g.ball.y += g.ball.dy;

    if (g.ball.y <= 0)        { g.ball.dx = (int8_t)rand_dx(); g.ball.dy = 1; }
    else if (g.ball.x <= 2)   { g.ball.dx = (int8_t)iabs(g.ball.dx); }
    else if (g.ball.x >= 124) { g.ball.dx = (int8_t)-iabs(g.ball.dx); }

    if (g.ball.y == 47) {
        if (g.ball.x + 1 >= g.racket.x && g.ball.x - 1 <= g.racket.x + RACKET_WIDTH) {
            bounce(RACKET_DX, g.racket.x, RACKET_WIDTH); g.tone = 400;
        }
    } else if (g.ball.y > 49) {
        g.ballCount--;
        A->display_clear();
        drawScore();
        g.tone = 800;
        if (g.ballCount < 0) {
            g.gameOverLevel = g.levelCountBreakout;
            g.gameOverScore = g.score;
            g.gameOver = true;
            reset(); initWall(); /* drawWall drawn by main loop */
            g.isPaused = true;
            say(T_GAME_OVER, 4);
        }
        initRacket(); initBall();
    }
    renderBall(true);
}

static void drawWall(bool checkCollision) {
    uint8_t anim[BRICK_ANIM_LEN];   /* brick patterns, read once per frame */
    A->asset_read(BRICK_ANIM, anim, sizeof(anim));
    for (uint8_t i = 0; i < BRICK_NUMBER; i++) {
        Brick *b = &g.brick[i];
        if (b->destroy) continue;
        uint8_t *fb_ptr = A->fb[b->y >> 3] + b->x;
        fb_ptr[0]  = 0b00011110;
        fb_ptr[14] = 0b00011110;

        if (checkCollision &&
            (g.ball.x + 1 >= b->x && g.ball.x - 1 <= b->x + BRICK_WIDTH) &&
            (g.ball.y + 1 >= b->y && g.ball.y - 1 <= b->y + BRICK_HEIGHT)) {
            b->destroy = true; g.score++;
            bounce(BRICK_DX, b->x, BRICK_WIDTH);

            A->led(true);
            memset(fb_ptr + 1, 0b00111111, 13);
            A->blit_line(b->y >> 3);
            playBeep(600);
            memset(fb_ptr + 0, 0b00000000, 15);
            A->blit_line(b->y >> 3);
            A->led(false);

            if (--g.wallLeft == 0u) {   /* the wall is cleared */
                g.levelCountBreakout++; g.ballCount++; initWall(); return;
            }
        } else {
            for (uint8_t k = 0; k < 13; k++)
                fb_ptr[k + 1] = anim[(g.blockAnim + k) & 3u];
        }
    }
}

static void renderRacket(int x, bool state) {
    A->draw_rect(A->fb, x + 1, RACKET_Y, x + RACKET_WIDTH - 2, RACKET_Y + RACKET_HEIGHT, state);
    A->draw_line(A->fb, x, RACKET_Y + 1, x + RACKET_WIDTH - 1, RACKET_Y + 1, state);
}

static void initRacket(void) { g.racket.x = 64 - (RACKET_WIDTH / 2); g.racket.p = g.racket.x; renderRacket(g.racket.x, true); }

static void drawRacket(void) {
    if (g.racket.p != g.racket.x) {
        renderRacket(g.racket.p, false);
        g.racket.p = g.racket.x;
        renderRacket(g.racket.x, true);
    }
}

static void redrawScene(void) {
    A->display_clear();
    if (g.gameOver) {
        drawScoreValues(g.gameOverLevel, -1, g.gameOverScore);
    } else {
        drawScore();
        drawWall(false);
    }
    renderRacket(g.racket.x, true);
    g.racket.p = g.racket.x;
    renderBall(true);
    if (g.isPaused)
        say(g.gameOver ? T_GAME_OVER : T_PAUSE, 4);
}

/* Title: the 1 KiB picture is streamed from the assets into the LCD buffers,
 * with a blinking prompt on the blank bottom page. */
static void drawTitle(void) {
    g.titleTick++;
    A->asset_read(ART_TITLE, A->status_line, LCD_WIDTH);
    A->asset_read(ART_TITLE + LCD_WIDTH, A->fb[0], 7u * LCD_WIDTH);
    if (g.titleTick & 32u)
        say(T_PRESS, 6);
}

static void OnKeyDown(uint8_t key) {
    if (g.title) {   /* MENU starts the game (and pauses it later on) */
        if (key == APP_KEY_MENU) { g.title = false; g.redrawRequired = true; }
        else if (key == APP_KEY_EXIT) g.isInitialized = false;
        return;
    }
    bool wasPaused = g.isPaused;
    switch (key) {
    case APP_KEY_4:
    case APP_KEY_UP:   if (!g.isPaused && g.racket.x > 0)   g.racket.x -= 2; g.isPaused = false; break;
    case APP_KEY_0:
    case APP_KEY_DOWN: if (!g.isPaused && g.racket.x < 102) g.racket.x += 2; g.isPaused = false; break;
    case APP_KEY_MENU:
        g.isPaused = !g.isPaused;
        if (g.isPaused) say(T_PAUSE, 4);
        break;
    case APP_KEY_EXIT: g.isPaused = false; g.isInitialized = false; break;
    }
    if (wasPaused && !g.isPaused) {
        g.gameOver = false;
        for (uint8_t i = 0; i < 8; i++)
            A->draw_line(A->fb, 32, 32 + i, 96, 32 + i, false);
    }
}

static void handleInput(void) {
    g.kbdPrev = g.kbdCur;
    g.kbdCur = A->get_key();

    if (g.kbdCur == APP_KEY_SAVER) {
        if (!g.isPaused) {
            g.isPaused = true;
            g.saverPaused = true;
        }
        g.saverActive = true;
        g.kbdPrev = APP_KEY_INVALID;
        g.kbdCur = APP_KEY_INVALID;
        return;
    }

    if (g.kbdCur == APP_KEY_WAKE || g.kbdCur == APP_KEY_PTT) {
        if (g.saverPaused)
            g.isPaused = false;
        g.saverPaused = false;
        g.saverActive = false;
        g.redrawRequired = true;
        g.kbdPrev = APP_KEY_INVALID;
        g.kbdCur = APP_KEY_INVALID;
        return;
    }

    if (g.kbdCur == APP_KEY_INVALID) return;
    if (g.kbdCur == APP_KEY_UP || g.kbdCur == APP_KEY_DOWN ||
        g.kbdCur == APP_KEY_4  || g.kbdCur == APP_KEY_0    || g.kbdCur != g.kbdPrev)
        OnKeyDown(g.kbdCur);
}

/* ---- entry point, pinned to blob offset 0 ---- */
__attribute__((section(".text.entry"), used))
void app_main(const app_api_t *api) {
    A = api;

#ifdef APP_POC_HELLO
    /* Minimal bisection test: prove jump + ABI + return work, no game body. */
    A->display_clear();
    say(T_HELLO, 3);
    A->blit_full();
    A->delay_ms(2000);
    return;
#endif

    /* the loader zeroed the overlay: every flag starts false, every count 0 */
    g.kbdPrev = APP_KEY_INVALID; g.kbdCur = APP_KEY_INVALID;
    uint8_t swap = 0;

    A->led(false);
    A->backlight_on();

    A->display_clear();
    reset(); initWall(); initRacket(); initBall();
    A->status_clear();
    g.isInitialized = true;
    g.title = true;

    while (g.isInitialized) {
        handleInput();

        if (g.saverActive) {
            A->backlight_update();
            A->delay_ms(TICK_MS);
            continue;
        }

        if (g.title) {   /* the game scene is redrawn when MENU leaves the title */
            drawTitle();
            A->blit_status();
            A->blit_full();
            A->backlight_update();
            A->delay_ms(TICK_MS);
            continue;
        }

        if (g.redrawRequired) {
            redrawScene();
            g.redrawRequired = false;
        }

        if (!g.isPaused) {
            if (swap == 0) g.blockAnim = (g.blockAnim + 1) & 3u;
            swap = (swap + 1) & 3u;
            drawScore(); drawWall(true); drawRacket(); drawBall();
            if (g.tone != 0) { playBeep(g.tone); g.tone = 0; }
            else A->delay_ms(40 - imin(g.levelCountBreakout - 1, 20));
        }
        A->blit_status();
        A->blit_full();
        A->backlight_update();
        if (g.isPaused)
            A->delay_ms(TICK_MS);
    }
}

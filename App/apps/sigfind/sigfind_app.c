/* Copyright 2026 Johan Denoyer F4WAT
 * https://github.com/jdenoy
 *
 * Based on the FoxHunt overlay app,
 * Copyright 2026 Armel F4HWN
 * https://github.com/armel
 *
 * Licensed under the Apache License, Version 2.0 (the "License");
 * you may not use this file except in compliance with the License.
 * You may obtain a copy of the License at
 *
 *     http://www.apache.org/licenses/LICENSE-2.0
 *
 *     Unless required by applicable law or agreed to in writing, software
 *     distributed under the License is distributed on an "AS IS" BASIS,
 *     WITHOUT WARRANTIES OR CONDITIONS OF ANY KIND, either express or implied.
 *     See the License for the specific language governing permissions and
 *     limitations under the License.
 */

/*
 * Sig Finder (RX only), the Signal Finder - overlay app forked from FoxHunt.
 * Direction finding of any carrier (a 121.5 / 243 MHz homing beacon, a fox,
 * an interferer) with a directional antenna: tune the VFO (AM, FM or USB)
 * first, then launch. Feedback is RELATIVE to a peak, not absolute dBm, so it
 * keeps working when the signal gets strong: the closer the reading is to the peak, the
 * faster and higher the beeps; within ONPEAK_Q of it, a fast high "on peak" chirp.
 *
 *   FOLLOW (default): the peak falls back slowly (0.5/1/2/4 dB/s), so the app always
 *                     answers "is this the best direction of the last few seconds".
 *   SWEEP:            the peak never decays. MENU starts a new sweep: turn 360 deg,
 *                     then turn back until the feedback says you are on the maximum.
 *
 * Direction finding works on any modulation (RSSI is taken before demodulation and
 * the app never retunes). Listening follows the firmware (radio.c): AM and FM both
 * use the FM AF output, the VFO having already enabled the AM demodulator in REG_31;
 * USB uses the baseband output. The USB listen mode is picked at launch when the VFO
 * had it set (REG_47 is muted while the squelch is closed, so it can also be chosen
 * by hand).
 *
 * Swept-tone detector (sweep.c): while the AF output is on (audio off or
 * listen), the RX audio is sampled on PA4 at 9.6 kHz during each tick's 50 ms
 * pause and its frequency tracked. A homer's downward sweep (1600..300 Hz,
 * 2..4 Hz) shows "ELT" in the status bar and its range and rate on the line
 * above the graph; otherwise that line shows the audio frequency, amplitude
 * and score. PA4 receives the AF before the speaker amplifier, so audio off
 * keeps the speaker quiet. In beep mode the AF is muted between beeps: no
 * detection there.
 *
 * An auto attenuator steps the front end up before the RSSI saturates (and back
 * down when weak, FOLLOW only) and re-bases the peak by the measured offset.
 *
 * Keys (identical on UV-K5 and UV-K1; UP/DOWN go through nav_dir):
 *   1 mode FOLLOW/SWEEP · 2 audio off/beep/listen/listen USB · 3 attenuator step
 *   (manual) · 4 auto attenuator on/off · 5 decay rate · 6 backlight held on/off
 *   (saved) · UP/DOWN attenuator (manual) · MENU reset peak / new sweep
 *   F reverses 2, 3 and 5 · long F keypad lock · EXIT quit.
 *
 * Size: texts, icons, the attenuator ladder and the powers of ten are read-only
 * assets (gen_assets.py), the state is one struct, the history lives on
 * app_main's stack, and the only division (the sweep rate) goes through the
 * resident uidivmod. Needs API level 2 (v6.1.0+). The loader re-runs
 * RADIO_SetupRegisters on exit; the app restores the ADC, PA4, the DAC and its
 * clock itself.
 */

#include <stdint.h>
#include <stdbool.h>
#include <stddef.h>
#include "../app_api.h"
#include "sigfind_assets.h"   /* generated by gen_assets.py */
#include "sweep.c"

/* ---- MCU registers (PY32F071, core and SysTick at 48 MHz, 10 ms period),
 * PA4 sampling as in the POCSAG and EPIRB 406 apps ---- */
/* Registers as base + offset, the base passed through an empty asm so the
 * compiler cannot fold it into one 4-byte literal per register: one literal
 * per peripheral instead (the accesses themselves are unchanged). */
static inline uint32_t periph(uint32_t base){ __asm__("" : "+l"(base)); return base; }
#define PERIPH(base,off) (*(volatile uint32_t *)(periph(base) + (off)))
#define SYST_LOAD   PERIPH(0xE000E010u, 0x04u)
#define SYST_VAL    PERIPH(0xE000E010u, 0x08u)
#define ADC_SR      PERIPH(0x40012400u, 0x00u)
#define ADC_CR2     PERIPH(0x40012400u, 0x08u)
#define ADC_SMPR3   PERIPH(0x40012400u, 0x14u)
#define ADC_SQR3    PERIPH(0x40012400u, 0x38u)
#define ADC_DR      PERIPH(0x40012400u, 0x50u)
#define GPIOA_MODER (*(volatile uint32_t *)0x50000000u)
#define DAC_CR      PERIPH(0x40007400u, 0x00u)
#define DAC_SWTRIGR PERIPH(0x40007400u, 0x04u)
#define DAC_DHR12R1 PERIPH(0x40007400u, 0x08u)
#define RCC_APBENR1 (*(volatile uint32_t *)0x4002103Cu)
#define RCC_DACEN   (1u << 29)
/* DAC channel 1 on, output buffer off, software trigger (TSEL1 = 111) */
#define DAC_CR_BIAS ((1u << 0) | (1u << 1) | (1u << 2) | (7u << 3))
#define BIAS_CODE   2048u
#define ADC_SR_EOC     (1u << 1)
#define ADC_CR2_START  ((1u << 22) | (1u << 20))   /* SWSTART | EXTTRIG */
#define SMP8_POS       24u
#define SMP4_POS       12u
#define ADC_CH_PA4     4u
#define CYC_PER_SAMPLE (48000000u / SW_FS)         /* 5000 */

#define LCD_WIDTH    128
#define BK_REG_13    0x13
#define BK_REG_31    0x31         /* bit 0: AM demodulator enabled by the VFO      */
#define BK_REG_47    0x47         /* bits 11:8: AF output type                     */
#define AF_USB       5            /* BK4819_AF_BASEBAND2, the firmware's USB output */

#define TICK_MS      50           /* = the two sampled windows, 2 x SW_WIN     */
#define LOCK_HOLD_MS 500
#define AUDIO_SETTLE 60
#define ATT_SETTLE   40

/* --- relative feedback, dB in Q8 (x256) --- */
#define Q8(db)       ((int32_t)(db) * 256)
#define WIN_Q        Q8(20)       /* delta at which feedback is at its slowest     */
#define ONPEAK_Q     (Q8(3) / 2)  /* 1.5 dB: "you are aimed"                       */
#define GATE_DBM     (-122)       /* below this, no beeps / AM stays muted         */
#define TONE_MIN     500
#define TONE_MAX     2000
#define TONE_PEAK    2800
#define RATE_SLOW    16           /* ticks between beeps at delta >= WIN           */
#define RATE_FAST    2            /* ticks between beeps just off the peak         */
#define BLIP_MS      40

/* --- auto attenuator --- */
#define ATT_UP_DBM   (-60)        /* step up (more attenuation) at/above this      */
#define ATT_DN_DBM   (-105)       /* step down (FOLLOW only) at/below this         */
#define ATT_HOLD     20           /* ticks between two automatic steps (1 s)       */
#define ATT_COUNT    6

/* --- history graph, relative to the peak --- */
#define HIST_LEN     120
#define HIST_DECIM   3            /* 120 x 3 x 50 ms = 18 s, about one slow sweep  */
#define HIST_BIAS    200          /* stored as clamp(dBm + 200, 0..255)            */
#define GRAPH_X0     4
#define GRAPH_TOP    31
#define GRAPH_BOT    46
#define GRAPH_SPAN   30           /* dB shown below the peak, 2 dB per row         */
#define SWEEP_Y      25           /* the sweep line, tiny font, above the graph    */

#define MODE_FOLLOW  0
#define MODE_SWEEP   1
#define AUDIO_OFF    0
#define AUDIO_BEEP   1
#define AUDIO_LSN    2            /* listen, AF as the firmware sets it for AM/FM  */
#define AUDIO_USB    3            /* listen, USB baseband output                   */
#define AUDIO_COUNT  4
#define DECAY_COUNT  4
#define DECAY_DEF    1

#define CFG_MAGIC    0xE5
#define CFG_LEN      7
#define BL_HOLD_TICKS 20         /* backlight held on: re-armed every second      */

/* No division is linked: numbers are printed by subtracting powers of ten and
 * the divisions by constants are exact multiply-and-shift equivalents, checked
 * exhaustively over their input ranges. They rely on these constants. */
_Static_assert(WIN_Q == 5120 && TONE_MAX - TONE_MIN == 1500, "q5120() divides by 5120 up to 1500 x WIN_Q");
_Static_assert(GRAPH_BOT - GRAPH_TOP == 15 && GRAPH_SPAN == 30, "drawHist() scales by 1/2");
_Static_assert(2u * SW_WIN * 1000u == TICK_MS * SW_FS, "a tick samples two windows");

/* Icons read with one asset call per slot share their length. */
_Static_assert(BMP_SIGNAL_LEN == BMP_SPEAKER_LEN && BMP_F_LEN == BMP_LOCK_LEN, "icon pairs differ in length");

/* per-tick peak decay in Q8: dB/s * 256 / 20 */
static const uint8_t DECAY_Q8[DECAY_COUNT] = { 6, 13, 26, 51 };

/* All the state in one struct: Thumb-1 code then reaches every field from a
 * single base address, byte fields first so their offsets fit ldrb's 0..31
 * immediate. The loader zeroes the overlay at each launch. */
struct globals {
    /* the saved config, in its stored order: loaded and saved in place */
    uint8_t  cfgMagic, attStep, mode, audioMode, autoAtt, decayIdx, blHold;
    uint8_t  blTick;
    bool     locked, fArm, fLongDone, quit, vfoAm, vfoUsb;
    uint8_t  audioTick, attHold, prevKey, histHead, histTick, histMax;
    uint16_t fHoldMs;
    int32_t  rawDbm;
    int32_t  smQ, peakQ;          /* smoothed reading and peak, dBm in Q8 */
    int32_t  dQ;                  /* peak - reading, 0..WIN_Q, set by measure() */
    const app_api_t *api;
    uint8_t *hist;                /* HIST_LEN levels, on app_main's stack */
    uint32_t tPrev, tCyc;         /* SysTick cycle counter */
    uint32_t savedSqr3, savedSmpr3, savedModer, savedDac, savedRcc, savedDhr;
};
static struct globals g;
/* The detector state on its own: inside g its fields sat past the reach of
 * ldrb / ldrh offsets (31 / 62) and each access took two more instructions. */
static sw_t sw;
#define A (g.api)

_Static_assert(offsetof(struct globals, histMax) < 32u, "byte fields out of ldrb range");

/* A->asset_read from a single place: its slot is past the reach of a load
 * offset, so each direct call costs more than a call here. */
__attribute__((noinline))
static void asset(uint16_t off, void *buf, uint16_t len){ A->asset_read(off, buf, len); }

/* x / 5120, exact for x <= 1500 x 5120 */
static uint32_t q5120(uint32_t x){ return ((x >> 10) * 52429u) >> 18; }

/* ---- tiny formatting ---- */
__attribute__((noinline))
static uint8_t slen(const char *s){ uint8_t n=0; while(s[n])n++; return n; }
__attribute__((noinline))
static char *put(char *o,const char *s){ while(*s)*o++=*s++; return o; }
/* Decimal digits of u, no leading zeros, by subtracting the powers of ten. */
static char *putu(char *o,uint32_t u){
    uint32_t place[PLACE_LEN/4u];
    asset(PLACE,place,sizeof(place));
    bool lead=true;
    for(uint8_t i=0;i<PLACE_LEN/4u;i++){
        uint8_t d=0;
        while(u>=place[i]){ u-=place[i]; d++; }
        if(d||i==PLACE_LEN/4u-1u) lead=false;
        if(!lead) *o++=(char)('0'+d);
    }
    return o;
}
static char *puti(char *o,int32_t v){
    if(v<0){ *o++='-'; v=-v; }
    return putu(o,(uint32_t)v);
}
/* Text from the assets in the caller's buffer (TEXT_MAX bytes). */
static char *T(char *buf,uint16_t off){ asset(off,buf,TEXT_MAX); return buf; }
/* Text from the assets appended at o: one call instead of T() + put(). */
__attribute__((noinline))
static char *putT(char *o,uint16_t off){ char t[TEXT_MAX]; return put(o,T(t,off)); }

/* Q8 -> nearest whole dB (symmetric rounding) */
static int32_t qdb(int32_t q){ return q<0 ? -((-q+128)>>8) : (q+128)>>8; }

__attribute__((noinline))
static uint8_t cycleIndex(uint8_t value, uint8_t count, int8_t dir)
{
    if (dir > 0)
        return ++value < count ? value : 0u;
    return value > 0u ? (uint8_t)(value - 1u) : (uint8_t)(count - 1u);
}

__attribute__((noinline))
static uint8_t histEnc(int32_t q){
    int32_t v=qdb(q)+HIST_BIAS;
    return (uint8_t)(v<0?0:v>255?255:v);
}

/* ---- radio ---- */
static void applyAtt(void){
    uint16_t reg = A->bk_read(BK_REG_13), gain;
    asset(ATT_REG13 + g.attStep * 2u, &gain, sizeof(gain));
    A->bk_write(BK_REG_13, (uint16_t)((reg & ~0x03FFu) | gain));
}

/* Audio off: speaker off but the AF on, as the VFO demodulates, for the sweep
 * detector (PA4 is before the speaker amplifier). */
static void setAudio(void){
    if(g.audioMode==AUDIO_OFF){ A->audio_path(false); A->set_af(g.vfoUsb?AF_USB:APP_AF_FM); return; }
    A->audio_path(true);
    A->delay_ms(AUDIO_SETTLE);
    A->set_af(APP_AF_MUTE);
}

/* ---- PA4 sampling ---- */
static void clkStart(void){ g.tPrev=SYST_VAL; g.tCyc=0; }
static uint32_t clkCyc(void){       /* call at least every 10 ms */
    uint32_t v=SYST_VAL;
    g.tCyc += (v<=g.tPrev) ? g.tPrev-v : g.tPrev+(SYST_LOAD+1u-v);
    g.tPrev=v;
    return g.tCyc;
}
/* PA4 has no DC reference: the unbuffered MCU DAC holds it at mid-scale (see
 * the EPIRB 406 README). Restored on exit. */
static void biasOn(void){
    GPIOA_MODER=g.savedModer|(3u<<8);
    RCC_APBENR1=g.savedRcc|RCC_DACEN;
    DAC_CR=DAC_CR_BIAS;
    DAC_DHR12R1=BIAS_CODE;
    DAC_SWTRIGR=1u;
}
static void biasOff(void){ DAC_CR=g.savedDac; DAC_DHR12R1=g.savedDhr; RCC_APBENR1=g.savedRcc; GPIOA_MODER=g.savedModer; }
/* ADC channel 4 (PA4) while sampling; channel 8 (battery) back afterwards */
static void adcRestore(void){ ADC_SQR3=g.savedSqr3; ADC_SMPR3=g.savedSmpr3; }
static uint16_t adcRead(void){
    ADC_CR2|=ADC_CR2_START;
    for(uint16_t k=0; !(ADC_SR&ADC_SR_EOC) && k<2000u; k++){}
    return (uint16_t)(ADC_DR&0x0FFFu);
}

static void blip(uint16_t freq){
    A->prepare_tone();
    A->play_tone_raw(freq, BLIP_MS);
    A->tones_off_rx();
    A->set_agc(false);
    applyAtt();
}

static void resetPeak(void){
    g.peakQ=g.smQ;
    uint8_t v=histEnc(g.smQ);
    for(uint8_t i=0;i<HIST_LEN;i++) g.hist[i]=v;
    g.histHead=0; g.histTick=0; g.histMax=0;
}

/* Change the attenuator and shift every stored level by the MEASURED offset, so the
 * peak and the history stay comparable with the new readings. */
static void attSet(uint8_t step){
    if(step==g.attStep) return;
    g.attStep=step;
    applyAtt();
    A->delay_ms(ATT_SETTLE);
    int32_t after=0;
    for(uint8_t i=0;i<4;i++){ after+=A->rssi_dbm(); A->delay_ms(5); }
    after=after*64;                       /* sum of 4 dBm -> mean in Q8 */
    int32_t off=after-g.smQ;
    g.smQ=after; g.peakQ+=off;
    int32_t offDb=qdb(off);
    for(uint8_t i=0;i<HIST_LEN;i++){
        if(!g.hist[i]) continue;
        int32_t v=g.hist[i]+offDb;
        g.hist[i]=(uint8_t)(v<1?1:v>255?255:v);
    }
    g.attHold=ATT_HOLD;
}

static void autoAttTick(void){
    if(g.attHold){ g.attHold--; return; }
    if(!g.autoAtt) return;
    if(g.rawDbm>=ATT_UP_DBM && g.attStep<ATT_COUNT-1)
        attSet((uint8_t)(g.attStep+1));
    else if(g.mode==MODE_FOLLOW && g.rawDbm<=ATT_DN_DBM && g.attStep>0)
        attSet((uint8_t)(g.attStep-1));
}

static void measure(void){
    g.rawDbm=A->rssi_dbm();
    g.smQ+=(Q8(g.rawDbm)-g.smQ)/2;
    if(g.mode==MODE_FOLLOW) g.peakQ-=DECAY_Q8[g.decayIdx];
    if(g.smQ>g.peakQ) g.peakQ=g.smQ;

    uint8_t v=histEnc(g.smQ);
    if(v>g.histMax) g.histMax=v;
    if(++g.histTick>=HIST_DECIM){
        g.hist[g.histHead]=g.histMax;
        if(++g.histHead>=HIST_LEN) g.histHead=0;
        g.histTick=0; g.histMax=0;
    }
    /* peak - reading, clamped: attSet() shifts both by the same offset, so
       this stays valid for the draw and the feedback of this tick */
    int32_t d=g.peakQ-g.smQ;
    g.dQ=d<0?0:d>WIN_Q?WIN_Q:d;
}


static void feedback(void){
    bool live = qdb(g.smQ)>=GATE_DBM;
    if(g.audioMode>=AUDIO_LSN){ A->set_af(live?(g.audioMode==AUDIO_USB?AF_USB:APP_AF_FM):APP_AF_MUTE); return; }
    if(g.audioMode!=AUDIO_BEEP || !live){ g.audioTick=0; return; }

    uint32_t d=(uint32_t)g.dQ;
    uint8_t  rate;
    uint16_t tone;
    if(d<=ONPEAK_Q){ rate=1; tone=TONE_PEAK; }
    else {
        rate=(uint8_t)(RATE_FAST+q5120((RATE_SLOW-RATE_FAST)*d));
        tone=(uint16_t)(TONE_MAX-q5120((TONE_MAX-TONE_MIN)*d));
    }
    if(++g.audioTick>=rate){ g.audioTick=0; blip(tone); }
}

/* ---- drawing ---- */
static void tag(const char *s,uint8_t x,uint8_t line){
    A->print_inverse(s,x,line,false,true,(uint8_t)(x+slen(s)*4));
}
/* normal font, right aligned on column 127 */
static void rprint(const char *s,uint8_t line){
    A->print_normal(s,(uint8_t)(127-slen(s)*7),0,line);
}

/* Closeness bar, line 2 (y 16..23) as whole bytes: the frame (rows 16 and 23,
 * columns 1 and 126), the fill (rows 18..21) and the on-peak marker (the last
 * ONPEAK_Q of the bar), the pixels of the former draw_rect + vertical lines. */
static void drawCloseness(void){
    const uint8_t len=(uint8_t)q5120((WIN_Q-(uint32_t)g.dQ)*123u);
    uint8_t *row=A->fb[2];
    for(uint8_t x=1;x<=126;x++){
        uint8_t b=0x81;
        if(x==1||x==126||x==2+((WIN_Q-ONPEAK_Q)*123)/WIN_Q) b=0xFF;
        else if((uint8_t)(x-2)<len) b=0xBD;
        row[x]|=b;
    }
}

/* History: each column from its level down to the base line, the base line
 * alone when 30 dB or more under the peak, and the dotted peak line. Pixels go
 * straight into the frame buffer, the ones the resident draw_line would set
 * (buffer[y / 8][x] |= 1 << (y % 8)), without a call per column. */
static void drawHist(void){
    app_fb_t fb=A->fb;
    int32_t top=qdb(g.peakQ)+HIST_BIAS;
    uint8_t idx=g.histHead;
    for(uint8_t c=0;c<HIST_LEN;c++){
        uint8_t v=g.hist[idx]; if(++idx>=HIST_LEN)idx=0;
        int32_t below=top-v;                        /* dB under the peak */
        if(below<0) below=0;
        uint8_t y=below>=GRAPH_SPAN ? GRAPH_BOT : (uint8_t)(GRAPH_TOP+(below>>1));
        uint8_t x=GRAPH_X0+c;
        for(;y<=GRAPH_BOT;y++) fb[y>>3][x]|=(uint8_t)(1u<<(y&7u));
        if(!(c&3u)) fb[GRAPH_TOP>>3][x]|=1u<<(GRAPH_TOP&7u);
    }
}

/* The sweep line: "ELT 1560>820Hz 3.1Hz" once detected (range and rate of the
 * last valid sweep), else "AF 1240Hz A35 S1" (frequency of the last window,
 * amplitude in ADC LSB, score), "AF --" without a tone. */
static void drawSweep(char *str){
    const sw_t *s=&sw;
    char *o;
    if(sw_detected(s)){
        o=putu(putT(str,T_ELT_SP),s->shHi); *o++='>';
        o=putT(putu(o,s->shLo),T_HZ); *o++=' ';
        /* rate x10, rounded; per <= SW_PMAX so r >= 16: two digits at least */
        uint32_t r=(uint32_t)A->uidivmod(10000u+s->per/2u,s->per);
        char *e=putu(o,r);
        e[0]=e[-1]; e[-1]='.';                 /* "31" -> "3.1" */
        o=putT(e+1,T_HZ);
    } else {
        o=putT(str,T_AF_SP);
        if(s->f) o=putT(putu(o,s->f),T_HZ); else { *o++='-'; *o++='-'; }
        o=putu(putT(o,T_AMP),s->amp);
        o=putu(putT(o,T_SCORE),s->score);
    }
    *o='\0';
    A->print_tiny(str,2,SWEEP_Y,false,true);
}

static void draw(void){
    const app_api_t *const a=A;   /* kept in a register across the calls */
    char big[8], str[24], t[TEXT_MAX];

    a->display_clear();
    a->status_clear();
    a->print_inverse(T(t,T_TITLE),2,0,true,true,27);
    a->draw_battery();
    uint8_t *sl=a->status_line;
    if(g.audioMode!=AUDIO_OFF){
        asset(g.audioMode==AUDIO_BEEP?BMP_SIGNAL:BMP_SPEAKER,sl+40,BMP_SIGNAL_LEN);
        /* the label box is 52..66 (sized for "USB"): the text is centred in it,
           "AM" / "FM" 2 px further right, then the box inverted the way
           print_inverse (GUI_DisplaySmallestInverse) does it */
        if(g.audioMode>=AUDIO_LSN){
            bool usb=g.audioMode==AUDIO_USB;
            a->print_tiny(T(t,T_AF+(usb?2u:g.vfoAm?0u:1u)*T_AF_STRIDE),usb?54:56,1,true,true);
            sl[52]^=0x3E;
            for(uint8_t x=53;x<66;x++) sl[x]^=0x7F;
            sl[66]^=0x3E;
        }
    }
    if(g.locked||g.fArm) asset(g.locked?BMP_LOCK:BMP_F,sl+29,BMP_F_LEN);
    if(sw_detected(&sw)) a->print_inverse(T(t,T_ELT),70,0,true,true,82);

    /* big: dB under the peak */
    int32_t dDb=qdb(g.dQ);
    *puti(big,-dDb)='\0';
    a->display_freq(big,2,0,false);
    a->print_normal(T(t,T_DB),(uint8_t)(slen(big)*13+4),0,1);

    /* right: absolute level and frequency */
    putT(puti(str,qdb(g.smQ)),T_DBM)[0]='\0';
    rprint(str,0);
    /* the RX frequency (10 Hz units) as MHz with 3 decimals: every digit but
       the last two, then the point before the last three (f >= 1 MHz) */
    { char *e=putu(str,a->rx_freq())-2;
      e[1]='\0';
      for(uint8_t k=0;k<3u;k++,e--) e[0]=e[-1];
      e[0]='.'; }
    rprint(str,1);

    drawCloseness();
    drawSweep(str);
    drawHist();

    /* bottom tags: mode, attenuator, peak */
    tag(T(t,T_MODE+(g.mode==MODE_SWEEP?DECAY_COUNT:g.decayIdx)*T_MODE_STRIDE),2,6);
    tag(T(t,T_ATT+(g.autoAtt?g.attStep:ATT_COUNT+g.attStep)*T_ATT_STRIDE),54,6);
    *puti(putT(str,T_PK),qdb(g.peakQ))='\0';
    tag(str,(uint8_t)(126-slen(str)*4),6);
}

/* ---- config (deferred) ----
 * Read in place into g. A foreign config (wrong magic) reads as erased flash;
 * every out-of-range byte, erased ones included, keeps its default. */
static void loadConfig(void){
    A->cfg_load(&g.cfgMagic,CFG_LEN);
    if(g.cfgMagic!=CFG_MAGIC) for(uint8_t i=1;i<CFG_LEN;i++) (&g.cfgMagic)[i]=0xFF;
    if(g.attStep>=ATT_COUNT)    g.attStep=0;
    if(g.mode>MODE_SWEEP)       g.mode=MODE_FOLLOW;
    if(g.audioMode>=AUDIO_COUNT) g.audioMode=AUDIO_BEEP;
    if(g.decayIdx>=DECAY_COUNT) g.decayIdx=DECAY_DEF;
    if(g.blHold>1u)             g.blHold=0;
}
static void saveConfig(void){
    g.cfgMagic=CFG_MAGIC;
    A->cfg_save(&g.cfgMagic,CFG_LEN);
}

/* ---- input ---- */
static void manualAtt(int8_t dir){
    g.autoAtt=false;
    attSet(cycleIndex(g.attStep,ATT_COUNT,dir));
}

static void handleKeys(void){
    const app_api_t *const a=A;
    uint8_t key=a->get_key();

    if(key==APP_KEY_F){
        if(!g.fLongDone){ g.fHoldMs+=TICK_MS; if(g.fHoldMs>=LOCK_HOLD_MS){ g.fLongDone=true; g.locked=!g.locked; g.fArm=false; a->backlight_on(); } }
    } else { g.fHoldMs=0; g.fLongDone=false; }

    if(key==APP_KEY_INVALID||key==g.prevKey){ g.prevKey=key; return; }
    g.prevKey=key;
    a->backlight_on();

    /* UP/DOWN and MENU act the same when locked (F is never armed then) */
    if(key==APP_KEY_UP||key==APP_KEY_DOWN) manualAtt(a->nav_dir(key));
    else if(key==APP_KEY_MENU) resetPeak();
    else if(g.locked) return;
    else if(key==APP_KEY_F){ g.fArm=!g.fArm; return; }
    else { int8_t dir=g.fArm?-1:1; switch(key){
        case APP_KEY_EXIT: g.quit=true; break;
        case APP_KEY_1:    g.mode^=1; resetPeak(); break;
        case APP_KEY_2:    g.audioMode=cycleIndex(g.audioMode,AUDIO_COUNT,dir); setAudio(); g.audioTick=0; break;
        case APP_KEY_3:    manualAtt(dir); break;
        case APP_KEY_4:    g.autoAtt=!g.autoAtt; g.attHold=0; break;
        case APP_KEY_5:    g.decayIdx=cycleIndex(g.decayIdx,DECAY_COUNT,dir); break;
        case APP_KEY_6:    g.blHold^=1u; break;
        default: break;
    } }
    g.fArm=false;
}

/* The tick's pause: two sweep windows sampled from PA4 (50 ms), the backlight
 * served every 96 samples (10 ms) as the 10 ms delays used to. */
#define BL_SAMPLES   (SW_FS / 100u)
static void tickSample(void){
    const app_api_t *const a=A;
    ADC_SMPR3=(g.savedSmpr3&~(7u<<SMP4_POS))|(((g.savedSmpr3>>SMP8_POS)&7u)<<SMP4_POS);
    ADC_SQR3=(g.savedSqr3&~0x1Fu)|ADC_CH_PA4;
    clkStart();
    uint32_t next=0;
    uint8_t bl=BL_SAMPLES;
    for(uint8_t w=0;w<2u;w++){
        for(uint8_t k=0;k<SW_WIN;k++){
            while(clkCyc()<next){}
            sw_push(&sw,adcRead());
            next+=CYC_PER_SAMPLE;
            if(!--bl){ bl=BL_SAMPLES; a->backlight_update(); }
        }
        sw_window(&sw,a->ticks_ms());
    }
    adcRestore();
}

__attribute__((section(".text.entry"),used))
void app_main(const app_api_t *api){
    uint8_t hist[HIST_LEN];   /* the history, on the stack: not in the overlay */
    A=api; g.hist=hist;
    g.prevKey=APP_KEY_INVALID;

    loadConfig();
    /* before anything touches the AF: what did the VFO set up? */
    g.vfoAm=(api->bk_read(BK_REG_31)&1u)!=0;
    { uint8_t af=(uint8_t)((api->bk_read(BK_REG_47)>>8)&0x0Fu);
      g.vfoUsb=af==AF_USB;
      if(g.audioMode==AUDIO_LSN && af==AF_USB)       g.audioMode=AUDIO_USB;
      else if(g.audioMode==AUDIO_USB && af==APP_AF_FM) g.audioMode=AUDIO_LSN; }
    g.savedSqr3=ADC_SQR3; g.savedSmpr3=ADC_SMPR3; g.savedModer=GPIOA_MODER;
    g.savedDac=DAC_CR; g.savedRcc=RCC_APBENR1; g.savedDhr=DAC_DHR12R1;
    biasOn();
    api->backlight_on();
    api->set_agc(false);
    applyAtt();
    setAudio();
    api->delay_ms(ATT_SETTLE);
    g.rawDbm=api->rssi_dbm();
    g.smQ=Q8(g.rawDbm);
    resetPeak();

    while(!g.quit){
        handleKeys();
        if(g.quit) break;

        measure();
        autoAttTick();

        draw();
        api->blit_status();
        api->blit_full();

        feedback();
        /* backlight held on: backlight_on() re-arms the timeout (and the sleep
           timer); at full brightness already it changes nothing visible */
        if(g.blHold && ++g.blTick>=BL_HOLD_TICKS){ g.blTick=0; api->backlight_on(); }
        api->battery_sample();
        tickSample();
    }

    saveConfig();
    biasOff();
    api->audio_path(false);
}

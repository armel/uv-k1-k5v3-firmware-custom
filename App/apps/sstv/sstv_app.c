/* Copyright 2026 Armel F4HWN
 * https://github.com/armel
 *
 * Licensed under the Apache License, Version 2.0 (the "License");
 * you may not use this file except in compliance with the License.
 * You may obtain a copy of the License at
 *
 *     http://www.apache.org/licenses/LICENSE-2.0
 *
 *     Unless required by applicable law or agreed to in writing, software
 *     distributed under the License is distributed on an "AS IS" BASIS,
 *     WITHOUT WARRANTIES OR CONDITIONS OF ANY KIND, either express or implied.
 *     See the License for the specific language governing permissions and
 *     limitations under the License.
 */

/*
 * SSTV - sends the boot logo and receives pictures in 14 SSTV modes: Robot 36
 * and 72, Martin M1 and M2, Scottie S1, S2 and DX, PD50, PD90, PD120, PD160,
 * PD180, PD240 and PD290 (the ISS sends PD120 or PD180). The receiver takes
 * the mode from the VIS; the TX mode is chosen with key 1.
 *
 * The modes are records in the assets (test/modes.py, after the Dayton paper):
 * the segments of one period between two syncs for the TX, and for the RX the
 * offsets of its picture scans from the sync end, their weights in the
 * luminance, the period and the pixel step.
 *
 * TX (MENU): the boot logo (128x64, 1 bit, external flash 0x011008, as
 * ui/welcome.c reads it), each scan carrying the logo row in 128 equal columns
 * (scan / 128: whole cycles at 48 MHz), the 64 rows spread over the periods;
 * grey (every colour scan the same, neutral chroma): a dark LCD pixel is black
 * (1500 Hz), a clear one white (2300 Hz). The tones come from the BK4829 tone
 * generator, as APRS TX sends AFSK: REG_71 written at each tone change, timed
 * to the cycle. The logo is shown while it goes out, each row inverted once
 * sent, during a sync, where the keys are read too (EXIT aborts).
 *
 * RX: the RX audio is sampled as APRS RX and EPIRB 406 do (PA4, ADC channel 4,
 * 9.6 kHz, continuously), through the receiver modelled and tested in
 * test/model.py (keep the two in step): band-pass, then the ratio of the sums
 * p = y1 (y0 + y2) and q = y1^2 is 2 cos w for a tone of angular step w,
 * whatever its level. Smoothed, it flags the VIS leader, the sync and the VIS
 * bits; summed over a pixel, it gives the luminance. Each period starts at its
 * sync end (searched +-10 ms around the prediction, the period tracked for the
 * sender's clock); the luminance of its scans (Y, or G B R weighted 2:1:1) goes
 * to a line buffer, periods are averaged per screen row, rendered 1-bit
 * (threshold) or dithered (4x4 Bayer), key 3. The chroma is ignored: grey.
 * The picture fills the whole screen, status line included; the keys and the
 * row just drawn (one LCD page, ~1.5 ms) are served after each period's last
 * scan, before its sync ends. Rows go out with blit_page: the resident line
 * blit also forces a blocking K5Viewer frame, which would turn the skipped
 * picture data into bands.
 *
 * Keys (UV-K5 and UV-K1): MENU sends the logo · 1 next TX mode, F then
 *   1 the previous one (F icon in the status bar while armed, as APRS TX) ·
 *   2 rendering 1-bit / dither · 3 speaker on/off (off at launch: the decoder
 *   does not need it) · 4 picture / info screen (once a picture came) ·
 *   EXIT quit from the info screen (abort a TX or a picture being received,
 *   leave the picture view first). TX mode, rendering
 *   and speaker are saved.
 * The loader re-runs RADIO_SetupRegisters on exit; the resident capture
 * (af_capture_close) restores the ADC, PA4, the DAC and its clock.
 */

#include <stdint.h>
#include <stdbool.h>
#include <stddef.h>
#include "../app_api.h"
#include "sstv_assets.h"       /* generated by gen_assets.py */

/* The PA4 capture, the 48 MHz cycle clock and the LCD page blit without
 * K5Viewer (blit_page) are resident (API level 3). */
#define FS             9600u
#define CYC_PER_SAMPLE (48000000u / FS)            /* 5000 */
#define HOUSE_EVERY    480u    /* samples between key/screen slots (50 ms)       */
#define BUSY_MAX       60u     /* serve them anyway after 60 busy slots (3 s)    */
#define REFRESH_MS     5000u   /* periodic redraw of the info screen (battery)   */

/* ---- BK4829 ---- */
#define REG_51      0x51   /* sub-audio: 0 = no CTCSS/DCS (BK4819_ExitSubAu)   */
#define REG_71      0x71   /* tone 1 frequency: (f * 1353245 + 2^16) >> 17    */
#define F1100       11357u
#define F1200       12389u
#define F1300       13422u
#define F1500       15487u
#define F1900       19616u
#define F2300       23746u

#define MS(x)       ((x) * 48000u)     /* cycles at 48 MHz */
#define LEAD_IN     1000u  /* ms of 1900 Hz before the VIS: squelch, repeater */
#define LOGO_ADDR   0x011008u  /* ui/welcome.c LOGO_BITMAP_ADDR: 8 pages x 128 */

/* ---- receiver (test/model.py, samples at 9.6 kHz) ---- */
#define BP_B0       21424  /* APRS RX's band-pass, Q14, 4x its gain           */
#define BP_A1     (-10714)
#define BP_A2       5673
#define LEAD_MIN    384    /* leader run: 40 ms                               */
#define BUSY_LEAD   96     /* a leader run this long holds the key/screen slot */
#define VIS_RUN     192    /* start bit run: 20 ms                            */
#define VIS_BIT     288    /* 30 ms                                           */
#define SYNC_WIN    96     /* +-10 ms around the prediction                   */
#define MISS_MAX    20u    /* periods without a sync: lost                    */
#define RELOCK      3u     /* periods without a sync: take one anywhere       */

/* ---- a mode (test/modes.py record(), the MODES assets) ---- */
enum { SEG_SCAN = 0, SEG_ALT = 1 };    /* else a segment code is a REG_71 value */
typedef struct {                       /* what the receiver keeps (g.m) */
    uint8_t  vis;                      /* VIS byte, even parity in bit 7 */
    uint8_t  rowA, rowB;               /* screen rows: racc += A, a row each time >= B */
    uint8_t  nscan, syncMin, nseg;     /* scans per period, shortest sync run, TX segments */
    uint8_t  w[3], pad;                /* scan weights in the luminance (sum 4) */
    uint16_t periods;
    int32_t  per0;                     /* period, samples Q4 */
    int32_t  stepNum;                  /* pixel step Q16 = stepNum / period */
    int32_t  first;                    /* start bit -> end of the first sync, samples */
    int32_t  off[3];                   /* sync end -> scans, samples at per0 */
} mrx_t;
typedef struct { uint32_t dur; uint16_t code, pad; } seg_t;   /* cycles, SEG_* or REG_71 */
typedef struct {
    mrx_t    rx;
    uint32_t pre;                      /* Scottie's sync after the VIS, cycles */
    seg_t    seg[SEG_MAX];             /* one period, from the TX side */
} mode_t;
_Static_assert(sizeof(mrx_t)==MODE_RX && sizeof(mode_t)==MODE_SIZE,
               "mode record: keep sstv_app.c and test/modes.py in step");

enum { H_HUNT = 0, H_VIS, H_LINE };
/* info screen status: the order of ST_TEXT in gen_assets.py */
enum { ST_WAIT = 0, ST_RX, ST_OK, ST_LOST, ST_SENT, ST_DENIED, ST_ABORT, ST_NOPIC, ST_RXABORT };

#define WAIT_CAPS_X 40u    /* "WAIT" capsule in the status bar, after the title (APRS RX) */
#define SPK_X       59u    /* speaker icon (FoxHunt's, x = 59-68) after the capsule (APRS RX) */
#define F_X         70u    /* F icon (9 px) while armed, as APRS TX / FoxHunt     */

/* The app state in one struct: a function loads one base address instead of one
 * literal-pool word per global. Bytes, then halfwords, then words, so every
 * field stays within the Thumb load/store immediate ranges (ldrb <= 31, ldrh <= 62,
 * ldr <= 124); the mode being received goes last.
 * The loader zeroes the overlay (.bss) at every launch. */
static struct {
    uint8_t  prevKey, redraw, spk;
    uint8_t  image, have, mode;        /* picture view on, a picture came, 0 dither / 1 1-bit */
    uint8_t  txMode, rxMode;           /* mode indexes; rxMode MODE_COUNT: none yet */
    uint8_t  st, status, lineDone, dirty; /* receiver state, info status, house after this
                                          sample, picture page to show + 1 */
    uint8_t  clr;                      /* picture pages shown since the VIS (one per period) */
    uint8_t  bit, code, votes;         /* VIS bit, bits so far, votes for a 1 */
    uint8_t  row, racc, cnt;           /* screen row, period->row accumulator, periods in row */
    uint8_t  px, sc, found, prevFound, miss; /* pixel, scan, this/last period's sync found,
                                          periods without */
    uint8_t  busyFor, fArm;            /* fArm: F pressed, the next key goes back */
    bool     running;
    uint16_t hc;                       /* samples since the last key/screen slot */
    uint16_t f;                        /* TX: REG_71 now                             */
    uint16_t line;                     /* period of the picture                     */
    const app_api_t *A;
    uint8_t  *img;                     /* the picture, LCD layout (app_main's stack) */
    uint16_t *acc;                     /* row sums of the luminance (stack)          */
    uint16_t *lbuf;                    /* the current period's luminance x 4 (stack) */
    int32_t  x1, x2, y1, y2, P, Q;     /* band-pass, smoothed p and q                */
    int32_t  sp, sq;                   /* p and q summed over the current pixel      */
    int32_t  n, lead, leadAt, srun;    /* sample index, leader run, its last sample, sync run */
    int32_t  t0, c, pred, step, per;   /* VIS start, period start, prediction, Q16 px step, period Q4 */
    int32_t  ys;                       /* start of the current scan                  */
    uint32_t next, tDraw;              /* next sample / tone (clkCyc), last redraw   */
    mrx_t    m;                        /* the mode being received                    */
} g;
static char str[34];

/* ---- tiny freestanding helpers: GCC may turn the zeroing / copy loops into calls ---- */
void *memset(void *d, int c, size_t n) {
    uint8_t *p = d; while (n--) *p++ = (uint8_t)c; return d;
}
void *memcpy(void *d, const void *s, size_t n) {
    uint8_t *p = d; const uint8_t *q = s; while (n--) *p++ = *q++; return d;
}

/* Division through the resident helper (API level 2) instead of libgcc's: the
 * period and the luminance divide, signed only. */
__attribute__((noinline))
uint64_t __aeabi_idivmod(int32_t n, int32_t d){ return g.A->idivmod(n, d); }
uint64_t __aeabi_idiv(int32_t n, int32_t d) __attribute__((alias("__aeabi_idivmod")));

/* ---- formatting ---- */
__attribute__((noinline))
static char *put(char *o,const char *s){ while(*s)*o++=*s++; return o; }
/* The resident formatter (API level 3). One local stub keeps every call a
 * plain bl: the service lies past the ldr immediate range of the table. */
__attribute__((noinline))
static char *puti(char *o,uint32_t u){ return g.A->append_u32(o,u); }

/* ---- screens ---- */
/* A 3x5 capsule on line 0, in capitals: from x = 2 (as the title in the status
 * bar), or ending at x = 125. */
static void tag(const char *s,bool right){
    char *o=str;
    for(char ch; (ch=*s++)!='\0'; ) *o++=(char)(ch>='a'&&ch<='z'?ch-32:ch);
    *o='\0';
    uint8_t w=(uint8_t)((o-str)*4), x=right?(uint8_t)(125u-w):2u;
    g.A->print_inverse(str,x,0,false,true,(uint8_t)(x+w));
}
/* Info screen: the TX mode and rendering, the status (with the mode of the
 * picture), the RX frequency, the keys. */
static void draw(void){
    const app_api_t *A=g.A;
    /* The UI texts live in the assets: one read per frame into this word-aligned
     * stack block, so each text costs a 2-byte sp-relative add. */
    char s[UI_SIZE] __attribute__((aligned(4)));
    char nm[T_NAMES_STRIDE];
    uint8_t t;
    A->asset_read(0,s,UI_SIZE);
    A->display_clear();
    A->status_clear();
    A->print_inverse(s+T_TITLE,2,0,true,true,(uint8_t)(2u+T_TITLE_CHARS*4u));
    if(g.spk) A->asset_read(BMP_SPK,A->status_line+SPK_X,BMP_SPK_LEN);
    if(g.fArm) A->asset_read(BMP_F,A->status_line+F_X,BMP_F_LEN);
    A->draw_battery();
    /* line 0: the TX mode (key 1) on the left, the rendering (key 2) on the
     * right, as 3x5 capsules */
    A->asset_read((uint16_t)(T_NAMES+g.txMode*T_NAMES_STRIDE),nm,T_NAMES_STRIDE);
    tag(nm,false);
    tag(g.mode?s+T_1BIT:s+T_DITHER,true);
    if(!g.have)                         /* no picture yet: a capsule, as APRS RX */
        A->print_inverse(s+T_WAIT,WAIT_CAPS_X,0,true,true,(uint8_t)(WAIT_CAPS_X+T_WAIT_CHARS*4u));
    if(g.status!=ST_WAIT){              /* the capsule says it */
        char *o=str;
        if(g.status<=ST_LOST){          /* a picture: "PD120 123/248", "PD120 OK", "PD120 lost" */
            A->asset_read((uint16_t)(T_NAMES+g.rxMode*T_NAMES_STRIDE),nm,T_NAMES_STRIDE);
            o=put(o,nm);
        }
        A->asset_read((uint16_t)(ST_TEXT+g.status),&t,1);
        o=put(o,s+t);
        if(g.status==ST_RX){ o=puti(o,g.line); *o++='/'; o=puti(o,g.m.periods); }
        *o='\0';                        /* 18 characters at most: "Scottie DX 255/256" */
        A->print_normal(str,0,0,2);
    }
    g.A->draw_frequency(A->rx_freq(),0,4);   /* the main screen's big digits, lines 4-5 */
    A->print_tiny(s+T_HELP,0,49,false,true);
}
/* The picture to the display buffers (whole screen, status line included). */
static void picture(void){
    const app_api_t *A=g.A;
    memcpy(A->status_line,g.img,128);
    memcpy(A->fb[0],g.img+128,896);
}
/* The current view to the LCD: the picture or the info screen. */
static void show(void){
    const app_api_t *A=g.A;
    if(g.image) picture(); else draw();
    A->blit_status();
    A->blit_full();
}
static uint8_t *page(unsigned pg){
    const app_api_t *A=g.A;
    return pg?A->fb[pg-1u]:A->status_line;
}

/* ---- the resident absolute cycle clock (10 ms tick + SysTick phase): a
 * blocking service (a full LCD blit is ~11 ms: SPI at 750 kHz) cannot lose a
 * period. Wraps every 89 s: compare with a signed difference. ---- */
static uint32_t clkCyc(void){ return g.A->cycles_48mhz(); }

/* ---- TX: the logo in the chosen mode ---- */
/* one tone from the current event time, for cyc cycles; REG_71 is written
 * only when the frequency changes, in case a write resets the tone phase */
static void tone(uint16_t f,uint32_t cyc){
    while((int32_t)(clkCyc()-g.next)<0){}
    if(f!=g.f){ g.A->bk_write(REG_71,f); g.f=f; }
    g.next+=cyc;
}
static void hunt(void){ g.st=H_HUNT; g.lead=0; g.srun=0; }

static void send(void){
    const app_api_t *A=g.A;
    mode_t md;
    if(A->tx_state()){ g.status=ST_DENIED; return; }
    A->asset_read((uint16_t)(MODES+g.txMode*MODE_SIZE),&md,MODE_SIZE);
    /* the logo on the LCD, as UI_LoadLogo: page 0 to the status line, 1-7 to
     * the frame buffer; it is read back from there, row by row */
    A->sys_storage_read(LOGO_ADDR,A->status_line,128);
    A->sys_storage_read(LOGO_ADDR+128u,A->fb[0],896);
    A->blit_status();
    A->blit_full();
    A->tx_set_params();                  /* carrier + PA on the TX VFO          */
    A->bk_write(REG_51,0);               /* no CTCSS/DCS under the picture      */
    A->tx_tone(1900);                    /* tone path on, mic off, 50 ms settle */
    g.f=F1900;
    g.next=clkCyc();
    /* VIS: leader, break, leader, start bit, 7 bits LSB first + parity, stop.
     * The first leader is lengthened by LEAD_IN: a receiver's squelch, CTCSS
     * decoder or a repeater's key-up eats the start of the transmission, and
     * the VIS has to arrive whole (QSSTV sends an 800 ms header for this) */
    tone(F1900,MS(LEAD_IN+300u)); tone(F1200,MS(10)); tone(F1900,MS(300)); tone(F1200,MS(30));
    for(unsigned i=0;i<8u;i++) tone(((md.rx.vis>>i)&1u)?F1100:F1300,MS(30));
    tone(F1200,MS(30));
    if(md.pre) tone(F1200,md.pre);
    g.status=ST_SENT;
    unsigned row=0, racc=0, inv=0;      /* rows sent, accumulator, rows shown sent */
    for(unsigned per=0;per<md.rx.periods;per++){
        uint8_t *p=page(row>>3), m=(uint8_t)(1u<<(row&7u));
        for(unsigned s=0;s<md.rx.nseg;s++){
            const seg_t *sg=&md.seg[s];
            uint16_t code=sg->code;
            if(code==SEG_SCAN){
                uint32_t pc=sg->dur>>7;  /* 128 logo columns */
                for(unsigned x=0;x<128u;x++) tone((p[x]&m)?F1500:F2300,pc);
                continue;
            }
            if(code==SEG_ALT) code=(per&1u)?F2300:F1500;   /* Robot 36's separator */
            tone(code,sg->dur);
            if(code==F1200){            /* in the sync (4.8 ms at least): a sent row
                                           shown inverted (one page), and the keys */
                if(inv<row){
                    uint8_t *q=page(inv>>3), k=(uint8_t)(1u<<(inv&7u));
                    for(unsigned x=0;x<128u;x++) q[x]^=k;
                    g.A->blit_page((uint8_t)(inv>>3));
                    inv++;
                }
                uint8_t key=A->get_key();
                if(key==APP_KEY_EXIT){ g.status=ST_ABORT; g.prevKey=key; goto out; }
            }
        }
        racc+=md.rx.rowA;
        if(racc>=md.rx.rowB){ racc-=md.rx.rowB; row++; }
    }
out:
    while((int32_t)(clkCyc()-g.next)<0){}   /* the last tone plays out          */
    A->tx_mute(true);
    A->tx_end();                         /* PA off + RX restored                */
    A->set_af(APP_AF_FM);                /* the receiver's audio again          */
    A->audio_path(g.spk);
    hunt();
}

/* ---- RX ---- */
/* the current scan from g.c, its offset scaled to the tracked period
 * (|per - per0| <= per0 / 16: no overflow) */
static void scanStart(void){
    int32_t o=g.m.off[g.sc];
    g.ys=g.c+o+o*(g.per-g.m.per0)/g.m.per0;
    g.px=0;
    g.sp=g.sq=0;
}
static void restart(void){              /* the period from g.c */
    g.step=g.m.stepNum/g.per;
    g.sc=0;
    memset(g.lbuf,0,128u*sizeof g.lbuf[0]);
    scanStart();
}
static void startImage(void){
    g.line=0;
    g.row=g.racc=g.cnt=0;
    memset(g.acc,0,128u*sizeof g.acc[0]);
    memset(g.img,0,1024);
    g.per=g.m.per0;
    g.miss=RELOCK;                       /* the first sync is taken anywhere: QSSTV sends
                                            no sync after the VIS stop bit, its first line
                                            starts 9 ms early, at the edge of the window */
    g.c=g.pred=g.t0+g.m.first;
    g.found=g.prevFound=0;
    g.st=H_LINE;
    g.have=1;
    g.image=1;
    g.status=ST_RX;
    g.clr=0;                             /* the screen is cleared one page per period:
                                            a full redraw (~12 ms) could hide a sync */
    g.A->backlight_on();
    restart();
}
/* luminance 0..255 of a pixel: 285 - 256 P / Q (2300 Hz ~ 255, 1500 Hz ~ 0) */
static uint8_t lum(int32_t sp,int32_t sq){
    while(sq>=(1<<22)){ sp>>=1; sq>>=1; }
    int32_t v=285-sp*256/sq;
    return (uint8_t)(v<0?0:v>255?255:v);
}
/* a screen row from the sums of its cnt periods (x 4): 1 = dark under the threshold */
static void putRow(void){
    uint8_t t[4];
    unsigned r=g.row, cnt=(unsigned)g.cnt<<2;
    g.A->asset_read((uint16_t)(THR+g.mode*16u+(r&3u)*4u),t,4);
    uint8_t *p=g.img+(r>>3)*128u, m=(uint8_t)(1u<<(r&7u));
    uint16_t *a=g.acc;
    for(unsigned x=0;x<128u;x++){
        if(a[x]<t[x&3u]*cnt) p[x]|=m; else p[x]&=(uint8_t)~m;
        a[x]=0;
    }
    g.dirty=(uint8_t)((r>>3)+1u);
}
static void endLine(void){
    if(!g.found && ++g.miss>MISS_MAX){ g.status=ST_LOST; g.redraw=1; hunt(); return; }
    uint16_t *a=g.acc, *l=g.lbuf;
    for(unsigned x=0;x<128u;x++) a[x]+=l[x];
    g.cnt++;
    g.racc+=g.m.rowA;
    if(g.racc>=g.m.rowB){ g.racc-=g.m.rowB; putRow(); g.cnt=0; g.row++; }
    if(++g.line>=g.m.periods){ g.status=ST_OK; g.redraw=1; hunt(); return; }
    g.c=g.pred=g.c+(g.per>>4);
    g.prevFound=g.found;
    g.found=0;
    g.lineDone=1;                        /* keys and screen before the sync ends */
    restart();
}

static void sample(int32_t adc){
    int32_t x=adc-2048;
    int32_t y=(BP_B0*(x-g.x2)-BP_A1*g.y1-BP_A2*g.y2)>>14;
    int32_t y1=g.y1;
    int32_t p=y1*(y+g.y2), q=y1*y1;
    g.x2=g.x1; g.x1=x; g.y2=y1; g.y1=y;
    int32_t P=g.P+=(p-g.P)>>3;
    int32_t Q=g.Q+=(q-g.Q)>>3;
    bool sync=4*P>5*Q;                   /* below ~1360 Hz */
    int32_t n=g.n;

    if(g.st==H_HUNT){
        if(2*P>Q && 4*P<3*Q){            /* leader, ~1800-2020 Hz */
            if(++g.lead>=LEAD_MIN) g.leadAt=n;
        } else g.lead=0;
        if(!sync) g.srun=0;
        /* start bit: 20 ms below 1360 Hz, begun right after a leader */
        else if(++g.srun==VIS_RUN && n-VIS_RUN-g.leadAt<48){
            g.t0=n-(VIS_RUN-1);
            g.bit=g.code=g.votes=0;
            g.st=H_VIS;
        }
    } else if(g.st==H_VIS){
        /* bit i: [t0 + 288 (i + 1), +288), votes below ~1210 Hz in its middle 20 ms */
        int32_t k=n-g.t0-VIS_BIT*(g.bit+1);
        if(k>=48 && k<240 && 32*P>45*Q) g.votes++;
        if(k==240){
            if(g.votes>96u) g.code|=(uint8_t)(1u<<g.bit);
            g.votes=0;
            if(++g.bit==8u){             /* the VIS byte (parity included) picks the mode */
                hunt();
                for(unsigned i=0;i<MODE_COUNT;i++){
                    uint16_t a=(uint16_t)(MODES+i*MODE_SIZE);
                    g.A->asset_read(a,&g.m,1);
                    if(g.m.vis==g.code){
                        g.A->asset_read(a,&g.m,MODE_RX);
                        g.rxMode=(uint8_t)i;
                        startImage();
                        break;
                    }
                }
            }
        }
    } else {
        /* The sync end (1200 -> 1500 Hz) within +-10 ms of the prediction
         * (re)starts the period: the scans never read as a sync, and a late
         * sync restarts the line buffer before it reaches the picture. */
        if(sync) g.srun++;
        else if(g.srun){
            int32_t ln=g.srun;
            g.srun=0;
            if(ln<g.m.syncMin) goto scan;
            /* a sender with a fast clock: the next sync ends before this
             * period's last scan is over (or this period ran on the prediction
             * and missed its own sync); the period is cut short there, and the
             * keys wait for the next one (no time before the next scan) */
            int32_t e=n-(g.c+(g.per>>4));
            if(e>=-SYNC_WIN && e<=SYNC_WIN){
                endLine();
                g.lineDone=0;
                if(g.st!=H_LINE) return;
            }
            int32_t err=n-g.pred;
            if(!g.found){
                bool in=err>=-SYNC_WIN && err<=SYNC_WIN;
                if(in){
                    if(g.prevFound){    /* the period, 1/8 of the error, +-6 % */
                        int32_t per=g.per+err*2, p0=g.m.per0, lim=p0>>4;
                        if(per>p0+lim) per=p0+lim;
                        if(per<p0-lim) per=p0-lim;
                        g.per=per;
                    }
                    g.found=1;
                    g.miss=0;
                }
                /* lock lost (a sender whose first line is not where the VIS
                 * says, a fade): after RELOCK periods on the prediction a sync
                 * anywhere restarts the period. It does not count as found:
                 * only a sync in the window of the next prediction clears
                 * miss, so noise alone still ends as lost. */
                if(in || g.miss>=RELOCK){
                    g.c=n;
                    restart();
                    return;
                }
            }
        }
    scan:;
        int32_t d=n-g.ys;
        if(d>=0){
            unsigned k=(unsigned)((d*g.step)>>16);
            if(k!=g.px){
                g.lbuf[g.px]+=(uint16_t)(g.m.w[g.sc]*lum(g.sp,g.sq));
                g.sp=g.sq=0;
                g.px=(uint8_t)k;
                if(k>=128u){
                    if(++g.sc>=g.m.nscan) endLine(); else scanStart();
                    return;
                }
            }
            g.sp+=p;
            g.sq+=q;
        }
    }
}

/* ---- input ---- */
static void handleKeys(void){
    const app_api_t *A=g.A;
    uint8_t key=A->get_key();
    if(key==APP_KEY_PTT) key=APP_KEY_INVALID;  /* reject UART-coupled PTT pulses */
    if(key==APP_KEY_INVALID||key==g.prevKey){ g.prevKey=key; return; }
    g.prevKey=key;
    g.redraw=1;
    A->backlight_on();
    if(key==APP_KEY_F){ g.fArm^=1u; return; }   /* as APRS TX: icon while armed */
    bool back=g.fArm;                    /* F then a key: it goes backwards */
    g.fArm=0;
    if(key==APP_KEY_EXIT){
        /* inside a picture: drop it and go back to the info screen, as EXIT
         * aborts a TX; what came so far stays viewable (key 4). From the
         * picture view: back to the info screen. From the info screen: quit. */
        if(g.st==H_LINE){ hunt(); g.status=ST_RXABORT; g.image=0; }
        else if(g.image) g.image=0;
        else g.running=false;
    }
    else if(key==APP_KEY_MENU) send();
    else if(key==APP_KEY_1){             /* next TX mode, F then 1 the previous one */
        if(back) g.txMode=(uint8_t)(g.txMode?g.txMode-1u:MODE_COUNT-1u);
        else if(++g.txMode>=MODE_COUNT) g.txMode=0;
    }
    else if(key==APP_KEY_2) g.mode^=1u;   /* rendering, from the next row on */
    else if(key==APP_KEY_3){ g.spk^=1u; A->audio_path(g.spk); }   /* speaker, as FoxHunt's audio */
    else if(key==APP_KEY_4){ if(g.have) g.image^=1u; else g.status=ST_NOPIC; }
}
static void house(void){
    const app_api_t *A=g.A;
    handleKeys();
    if(!g.running) return;
    A->backlight_update();     /* normal BLTime timeout; keys re-arm it in get_key() */
    if(g.image && !g.redraw){  /* one page at most (~1.5 ms): a new row, else the
                                  next page not shown yet since the VIS */
        unsigned pg=8u;
        if(g.dirty) pg=g.dirty-1u;
        else if(g.st==H_LINE && g.clr<8u) pg=g.clr++;
        if(pg<8u){ memcpy(page(pg),g.img+pg*128u,128); g.A->blit_page((uint8_t)pg); }
    }
    g.dirty=0;
    uint32_t t=A->ticks_ms();
    if(!g.image && t-g.tDraw>=REFRESH_MS) g.redraw=1;
    if(!g.redraw) return;
    g.redraw=0;
    g.tDraw=t;
    if(!g.image) A->battery_sample();  /* yields the capture's ADC itself */
    show();
}

static void listen(void){
    uint16_t (*const adc)(void)=g.A->af_capture_sample;  /* held in a register */
    g.next=clkCyc();
    while(g.running){
        while((int32_t)(clkCyc()-g.next)<0){}
        g.next+=CYC_PER_SAMPLE;
        g.n++;
        sample(adc());
        if(g.st==H_LINE){                /* inside a picture: after each period */
            if(!g.lineDone) continue;
            g.lineDone=0;
        } else {                         /* every 50 ms, unless a VIS may be on */
            if(++g.hc<HOUSE_EVERY) continue;
            g.hc=0;
            /* busy: a VIS being read, a leader, or a start bit begun right after
             * one (a sync run alone is no VIS: receiver noise, mostly low-pitched,
             * reads as a sync half the time and held the keys off) */
            if((g.st==H_VIS || g.lead>=BUSY_LEAD || (g.srun && g.n-g.leadAt<VIS_RUN+48))
               && ++g.busyFor<BUSY_MAX) continue;
            g.busyFor=0;
        }
        house();
        while((int32_t)(clkCyc()-g.next)>=0){ g.next+=CYC_PER_SAMPLE; g.n++; }  /* the slots it took */
    }
}

__attribute__((section(".text.entry"),used))
void app_main(const app_api_t *api){
    uint8_t img[1024];           /* on the stack: the 4 KiB overlay also holds .bss */
    uint16_t acc[128], lbuf[128];
    uint8_t c[4];
    g.A=api;
    g.img=img;
    g.acc=acc;
    g.lbuf=lbuf;
    g.prevKey=APP_KEY_INVALID;   /* the rest of g starts at 0 (overlay zeroed by the loader) */
    g.leadAt=-(1<<20);           /* no leader yet */
    g.rxMode=MODE_COUNT;         /* no picture yet */

    api->af_capture_open();      /* PA4 bias and ADC channel 4, restored by close */
    api->backlight_on();
    api->cfg_load(c,4);          /* rendering (erased 0xFF: 1-bit), TX mode, speaker,
                                    mode of the saved picture */
    g.mode=c[0]?1u:0u;
    if(c[1]<MODE_COUNT) g.txMode=c[1];
    g.spk=(uint8_t)(c[2]==1u);   /* erased (0xFF): off */
    /* The last picture, saved by the loader when the app returned (see the
     * end of app_main). A blank block is no picture: the packaged one, also
     * back after an update of the app. */
    api->asset_read(PIC,img,PIC_LEN);
    uint8_t any=0;
    for(unsigned i=0;i<PIC_LEN;i++) any|=img[i];
    if(any && c[3]<MODE_COUNT){ g.rxMode=c[3]; g.have=1; g.status=ST_OK; }
    /* Speaker amplifier (PA8) as saved, off by default: PA4 joins the audio
     * before the amplifier (APRS RX), so the decoder only needs the BK4829 AF
     * output. Key 3 toggles it. */
    api->audio_path(g.spk);
    api->set_af(APP_AF_FM);
    api->delay_ms(50);

    g.running=true;
    g.redraw=1;
    listen();

    api->af_capture_close();
    api->set_af(APP_AF_MUTE);
    api->audio_path(false);
    /* APP_FLAG_SAVE_SCREEN (build.sh, --save-screen): the loader keeps the
     * screen left in the display buffers as the PIC asset block. Leave the
     * picture there, whatever the view was; not blitted, the menu comes next.
     * Without a picture img still holds the block read at launch. */
    picture();
    c[0]=g.mode; c[1]=g.txMode; c[2]=g.spk; c[3]=g.rxMode;
    api->cfg_save(c,4);
}

/* Copyright 2026 Armel F4HWN
 * https://github.com/armel
 *
 * Licensed under the Apache License, Version 2.0 (the "License");
 * you may not use this file except in compliance with the License.
 * You may obtain a copy of the License at
 *
 *     http://www.apache.org/licenses/LICENSE-2.0
 *
 *     Unless required by applicable law or agreed to in writing, software
 *     distributed under the License is distributed on an "AS IS" BASIS,
 *     WITHOUT WARRANTIES OR CONDITIONS OF ANY KIND, either express or implied.
 *     See the License for the specific language governing permissions and
 *     limitations under the License.
 */

/*
 * APRS RX - receives APRS (AX.25 UI frames, Bell 202 AFSK 1200 bauds) in
 * software and keeps the last five frames, shown one at a time: source,
 * destination and path, the info field. Tune the VFO (FM; 144.800 MHz, or 433.650 MHz for the Flipper Zero
 * bench files of test/flipper_aprs.py), then launch.
 *
 * The BK4829 has no Bell 202 demodulator (see README.md), so the RX audio is
 * sampled as EPIRB 406 does: it reaches PA4 (the voice DAC pin), held at
 * mid-scale by the MCU DAC (unbuffered), and is read on ADC channel 4 at
 * 9.6 kHz, timed from SysTick, continuously, as a TNC does: no RSSI gate, the
 * FCS and the UI check sort frames from noise. Each sample goes through the
 * demodulator modelled and tested in test/model_rx.py: band-pass, 1200/2200 Hz
 * sliding correlators over one bit, per-tone AGC, then 3 slicers (mark/space
 * weights 2:3, 1:1, 3:2), each with its DPLL, NRZI, HDLC and FCS. Keep the two
 * in step.
 * Keys and the screen cost sample time (the key scan alone is ~400 us), so they
 * are served every 50 ms only while no slicer is inside a preamble or a
 * plausible frame; the redraw follows a new frame, a key, or every 5 s.
 *
 * Keys (UV-K5 and UV-K1): UP/DOWN (held) scroll the frame 1 px per slot when
 *   needed; pressed again at either end: the newer / older frame · * normal
 *   view / compact view (saved) · 1 speaker on/off (saved, off by default: the
 *   decoder does not need it) · 2 clear · EXIT quit.
 * The loader re-runs RADIO_SetupRegisters on exit; the app restores the ADC,
 * PA4, the DAC and its clock itself.
 */

#include <stdint.h>
#include <stdbool.h>
#include <stddef.h>
#include "../app_api.h"
#include "aprsrx_assets.h"     /* generated by gen_assets.py */

/* ---- MCU registers (PY32F071, core and SysTick at 48 MHz, 10 ms period) ----
 * The ADC and DAC registers are reached from one base per block: the base goes
 * through an empty asm, so GCC addresses them as [base, #offset] from one
 * literal-pool word instead of one word per register address. */
static inline volatile uint32_t *hw(uint32_t a){
    volatile uint32_t *p=(volatile uint32_t *)a;
    __asm__("" : "+l"(p));
    return p;
}
#define SYST_LOAD   (*(volatile uint32_t *)0xE000E014u)
#define SYST_VAL    (*(volatile uint32_t *)0xE000E018u)
#define ADC_SR      (hw(0x40012400u)[0x00/4])
#define ADC_CR2     (hw(0x40012400u)[0x08/4])
#define ADC_SMPR3   (hw(0x40012400u)[0x14/4])
#define ADC_SQR3    (hw(0x40012400u)[0x38/4])
#define ADC_DR      (hw(0x40012400u)[0x50/4])
#define GPIOA_MODER (*(volatile uint32_t *)0x50000000u)
#define DAC_CR      (hw(0x40007400u)[0x00/4])
#define DAC_SWTRIGR (hw(0x40007400u)[0x04/4])
#define DAC_DHR12R1 (hw(0x40007400u)[0x08/4])
#define RCC_APBENR1 (*(volatile uint32_t *)0x4002103Cu)
#define RCC_DACEN   (1u << 29)
/* DAC channel 1 on, output buffer off, software trigger (TSEL1 = 111) */
#define DAC_CR_BIAS ((1u << 0) | (1u << 1) | (1u << 2) | (7u << 3))
#define BIAS_CODE   2048u
#define ADC_SR_EOC     (1u << 1)
#define ADC_CR2_START  ((1u << 22) | (1u << 20))   /* SWSTART | EXTTRIG */
#define SMP8_POS       24u
#define SMP4_POS       12u
#define ADC_CH_PA4     4u
#define FS             9600u
#define CYC_PER_SAMPLE (48000000u / FS)            /* 5000 */
#define HOUSE_EVERY    480u    /* samples between key/screen slots (50 ms)       */
#define BUSY_MAX       60u     /* serve them anyway after 60 busy slots (3 s)    */
#define REFRESH_SLOTS  100u    /* 100 housekeeping slots = 5 s (battery redraw) */
#define REDRAW_ON      1u      /* g.redraw: a key or the periodic refresh        */
#define REDRAW_FRAME   2u      /* g.redraw: a new frame, also wakes the backlight */
#define DUP_MS         1000u   /* the same frame from another slicer             */

/* ---- BK4829 ---- */

/* ---- demodulator (test/model_rx.py, class Demod) ---- */
#define BP_B0       5356   /* band-pass 1625 Hz, Q 0.9, Q14 (b2 = -b0, b1 = 0) */
#define BP_A1     (-10714)
#define BP_A2       5673
#define AGC_ATT     5      /* peak tracker: attack 1/32 ...                 */
#define AGC_DEC     10     /* ... decay 1/1024 per sample                   */
#define PK_MIN      16
#define PLL_STEP    8192   /* 65536 per bit / 8 samples per bit             */
#define PLL_CTR     36864  /* transitions pulled to mid-bit + half a sample */
#define PLL_SHIFT   2      /* 1/4 of the error per transition               */
#define NSL         3      /* slicers                                       */
#define PRE_BITS    24u    /* busy for 3 bytes after two back-to-back flags */

/* ---- AX.25 ---- */
#define FRAME_MAX   330u   /* 10 addresses + control + PID + 256 info + FCS */
#define FRAME_MIN   18u    /* 2 addresses + control + PID + FCS              */
#define FCS_GOOD    0xF0B8u
#define HISTORY     5u

typedef struct {
    uint16_t len;
    int16_t rssi;
    uint8_t buf[FRAME_MAX];
} frame_t;

/* the front end shared by the slicers */
typedef struct {
    int32_t  dc;                       /* DC tracker, Q4                          */
    int32_t  x1, x2, y1, y2;           /* band-pass state                         */
    int32_t  im, qm, is, qs;           /* sliding correlator sums                 */
    int32_t  pm, ps;                   /* per-tone magnitude peaks (AGC)          */
    uint32_t r, ks;                    /* ring slot = 1200 Hz phase, 2200 Hz phase;
                                          words: dem_t is inlined on the stack, where
                                          only words have an sp-relative load/store */
    int16_t  ring[8][4];               /* the products of the last bit            */
    int8_t   cm[8], cs[48];            /* cos tables (assets)                     */
} dem_t;
/* listen() loads both tables in one asset_read: they must stay back to back,
 * in the assets as in dem_t. */
_Static_assert(COS2200==COS1200+COS1200_LEN &&
               sizeof(((dem_t *)0)->cm)==COS1200_LEN &&
               sizeof(((dem_t *)0)->cs)==COS2200_LEN &&
               offsetof(dem_t,cs)==offsetof(dem_t,cm)+COS1200_LEN,
               "cos tables must stay contiguous");
_Static_assert(BIAS_CODE==2048u && offsetof(dem_t,pm)==36u &&
               offsetof(dem_t,ps)==40u &&
               offsetof(dem_t,cm)==DEMOD_INIT_LEN &&
               COS1200==DEMOD_INIT+DEMOD_INIT_LEN &&
               sizeof(dem_t)==DEMOD_INIT_LEN+COS1200_LEN+COS2200_LEN,
               "demodulator initialization asset must match dem_t");

/* one slicer: decision weights, DPLL, NRZI, HDLC */
typedef struct {
    int32_t  dprev, phase;             /* last decision, DPLL phase (65536/bit)   */
    uint16_t n, crc;                   /* bytes, running FCS                      */
    uint8_t  wa, wb, last;             /* mark/space weights, last level          */
    uint8_t  sr, ones, byte, nb;       /* HDLC: shift reg, 1 run, byte, bit count */
    uint8_t  inframe, hdr;             /* between flags, first bytes look like a call */
    uint8_t  bits;                     /* bits since the last flag                */
    bool     pre;                      /* this flag came right after another one  */
    uint8_t  buf[FRAME_MAX];
} sl_t;

/* The app state in one struct: a function loads one base address instead of one
 * literal-pool word per global. Bytes, then halfwords, then words, so every field
 * stays within the Thumb load/store immediate ranges (ldrb <= 31, ldrh <= 62,
 * ldr <= 124); the ADC registers shared with housekeeping go last.
 * The loader zeroes the overlay (.bss) at every launch. */
static struct {
    uint8_t  prevKey, redraw;
    bool     running;
    uint8_t  count, cur;               /* history count, frame shown (0 = newest) */
    uint8_t  symTable, symCode;        /* symbol of the frame shown; table zero never
                                          matches an asset */
    uint8_t  cw, spk;                  /* the saved settings, in cfg order: view (0 scroll,
                                            CW_COMPACT compact), speaker amplifier on (key 1) */
    uint8_t  refresh;                  /* housekeeping slots since the last redraw */
    uint16_t vrow;                     /* y of the next body row before scrolling */
    uint16_t top, lim, nOk;            /* pixel scroll of the body, its limit, frames */
    const app_api_t *A;
    char *text;                        /* formatting buffer (app_main's stack)    */
    frame_t **history;                 /* newest first; buffers live on app_main's stack */
    uint32_t tPrev, tCyc;              /* SysTick cycle counter                   */
    uint32_t tFrame;                   /* ticks_ms of the last frame              */
    uint32_t savedSqr3, savedSmpr3;
} g;
#define str g.text

/* ---- tiny freestanding helpers: GCC may turn the zeroing / copy loops into calls ---- */
void *memset(void *d, int c, size_t n) {
    uint8_t *p = d; while (n) p[--n] = (uint8_t)c; return d;
}
void *memcpy(void *d, const void *s, size_t n) {
    uint8_t *p = d; const uint8_t *q = s;
    while (n) { --n; p[n] = q[n]; } return d;
}

/* ---- formatting ---- */
/* Share the string-copy loop across the display formatters. */
__attribute__((noinline))
static char *put(char *o,const char *s){ while(*s)*o++=*s++; return o; }
/* Formatting by repeated subtraction: no division. Values printed stay below 100000. */
static unsigned sub(uint32_t *v,uint32_t d){ unsigned q=0; while(*v>=d){ *v-=d; q++; } return q; }
static const uint16_t P10[]={10000u,1000u,100u,10u,1u};
static char *puti(char *o,int32_t v){
    uint32_t u;
    if(v<0){*o++='-';u=(uint32_t)(-v);} else u=(uint32_t)v;
    bool lead=false;
    for(unsigned i=0;i<5u;i++){
        unsigned c=sub(&u,P10[i]);
        if(c||lead||i==4u){ *o++=(char)('0'+c); lead=true; }
    }
    return o;
}
/* A tiny row holds 32 characters (4 px each): print_tiny does not clip, so
 * every row built below stays within that. */
static void tiny(uint8_t y,char *end){ *end='\0'; g.A->print_tiny(str,0,y,false,true); }

#define WAIT_CAPS_X 40u    /* "WAIT" capsule in the status bar, after the title */
#define SPK_X       59u    /* speaker icon (FoxHunt's, x = 59-68) after the capsule
                              (x <= 56), then the scroll marks at x = 72-76 as in APRS
                              TX, before the battery text (x >= 83): BMP_TAIL in the
                              assets, both in one read */

/* One frame at a time: its source in bold on line 0, its body scrolled under
 * it, y = 8 to 30, in one of two views (key *):
 * - normal (g.cw = 0): 18 characters per row, 8 px apart, 3 rows at rest;
 * - compact (g.cw = CW_COMPACT): 32 tiny characters per row, 6 px apart, 4 rows. */
#define ROW_CHARS   18u
#define CAPS_END    127u   /* last column of the capsules at the right of the
                              source (x >= 89 with "65535" and "2/5") */
#define CW_COMPACT  14u    /* compact rows: ROW_CHARS + 14 = 32 characters */

/* The frequency (10 Hz units) drawn as the main screen draws it (ui/main.c,
 * ENABLE_BIG_FREQ): the big digits up to the kHz on lines 4-5, the last two
 * digits in the small font on line 5 right after them. The group is aligned
 * left to reserve the rightmost 20 columns for the APRS symbol. Big digits are
 * 13 px (drawn from +2), the point 3 px. No division. As APRS TX, without its
 * 1 GHz case (the main screen's small font there): 1296.000 still fits. */
__attribute__((noinline))
static void drawFreq(uint32_t f){
    const app_api_t *A=g.A;
    unsigned m=0;
    while(f>=100000u){ f-=100000u; m++; }
    char *o=puti(str,m);
    *o++='.';
    for(unsigned i=0;i<5u;i++) *o++=(char)('0'+sub(&f,P10[i]));
    *o='\0';
    o-=2;                                                   /* last two digits */
    A->print_normal(o,(uint8_t)((o-str)*13u-10u),0,5);
    *o='\0';
    A->display_freq(str,0,4,false);                          /* "144.800" */
}

#define SYM_X 108u
/* The exact (table, code) pair first: E0 and YY have their own bitmap. An
 * overlay (table 0-9 or A-Z) without one then shows the alternate-table symbol
 * it is drawn over; the overlay character itself is in the body text. */
static void drawSymbol(void){
    const app_api_t *A=g.A;
    uint8_t hit[3];
    uint8_t t=g.symTable;
    for(;;){
        uint8_t slot=(uint8_t)((t+59u*g.symCode)&127u);
        A->asset_read((uint16_t)(SYM_MAP+slot*3u),hit,sizeof hit);
        if(hit[0] && hit[1]==t && hit[2]==g.symCode) break;
        if(t<'0' || t=='\\') return;          /* none, '/', or '\\' already tried */
        t='\\';
    }
    uint16_t off=(uint16_t)(SYM_BITMAPS+(uint16_t)(hit[0]-1u)*SYM_BYTES);
    for(uint8_t page=0;page<3u;page++)
        A->asset_read((uint16_t)(off+page*SYM_W),A->fb[4u+page]+SYM_X,SYM_W);
}

/* ---- SysTick cycle counter (call at least every 10 ms; wraps every 89 s,
 * so compare with a signed difference) ---- */
static void clkStart(void){ g.tPrev=SYST_VAL; g.tCyc=0; }
static uint32_t clkCyc(void){
    uint32_t v=SYST_VAL;
    g.tCyc += (v<=g.tPrev) ? g.tPrev-v : g.tPrev+(SYST_LOAD+1u-v);
    g.tPrev=v;
    return g.tCyc;
}

/* ---- PA4 bias: the pin has no DC reference of its own (AC-coupled audio); the
 * MCU DAC on PA4, output buffer off, at mid-scale, holds it at ~VDD/2.
 * Set for the whole run, restored on exit (see EPIRB 406). ---- */
static void biasOn(uint32_t moder,uint32_t rcc){
    GPIOA_MODER=moder|(3u<<8);                 /* PA4 analog                     */
    RCC_APBENR1=rcc|RCC_DACEN;
    DAC_CR=DAC_CR_BIAS;
    DAC_DHR12R1=BIAS_CODE;
    DAC_SWTRIGR=1u;                           /* DHR -> DOR                     */
}
static void biasOff(uint32_t dac,uint32_t dhr,uint32_t rcc,uint32_t moder){
    DAC_CR=dac; DAC_DHR12R1=dhr; RCC_APBENR1=rcc; GPIOA_MODER=moder;
}

/* ---- ADC on PA4 (channel 4); channel 8 (battery) restored afterwards ---- */
static void adcSelPA4(void){
    ADC_SMPR3=(g.savedSmpr3&~(7u<<SMP4_POS))|(((g.savedSmpr3>>SMP8_POS)&7u)<<SMP4_POS);
    ADC_SQR3=(g.savedSqr3&~0x1Fu)|ADC_CH_PA4;
}
static void adcRestore(void){ ADC_SQR3=g.savedSqr3; ADC_SMPR3=g.savedSmpr3; }
static uint16_t adcRead(void){
    ADC_CR2|=ADC_CR2_START;
    for(uint16_t n=0; !(ADC_SR&ADC_SR_EOC) && n<2000u; n++){}
    return (uint16_t)(ADC_DR&0x0FFFu);
}

static bool callChar(uint8_t c){ return (c>='A'&&c<='Z')||(c>='0'&&c<='9')||c==' '; }

/* An APRS frame is a UI frame: the address field ends (bit 0 of an SSID byte)
 * and is followed by control 0x03 and PID 0xF0. Rejects the noise burst that
 * passes the 16-bit FCS about once a day in continuous decoding. */
static bool isUI(const uint8_t *f,uint16_t n){
    uint16_t end=(uint16_t)(n-2u), e=13;
    while(!(f[e]&1u) && e+7u<end) e+=7;
    return (f[e]&1u) && e+2u<end && f[e+1]==0x03u && f[e+2]==0xF0u;
}

/* ---- a good frame from a slicer: shown unless another slicer just gave it ---- */
static void accept(const sl_t *m){
    const app_api_t *A=g.A;
    uint16_t n=m->n;
    uint32_t t=A->ticks_ms();
    frame_t *f=g.history[0];
    if(!(g.count && n==f->len && f->buf[n-1]==m->buf[n-1] && f->buf[n-2]==m->buf[n-2]
         && t-g.tFrame<DUP_MS)){
        f=g.history[HISTORY-1u];
        for(unsigned k=HISTORY-1u;k;k--) g.history[k]=g.history[k-1u];
        g.history[0]=f;
        memcpy(f->buf,m->buf,n);
        f->len=n;
        f->rssi=A->rssi_dbm();              /* capture while the carrier is still up */
        if(g.count<HISTORY) g.count++;
        g.nOk++;                           /* wraps after 65535: five digits in its capsule */
        g.cur=0;                           /* show it, from its first row */
        g.top=0;
        g.redraw|=REDRAW_FRAME;
    }
    g.tFrame=t;
}

/* ---- HDLC: one bit after NRZI. A UI frame with a good FCS goes to accept()
 * (m->buf, m->n bytes) before the closing flag opens the next frame. Not
 * inlined: a function of its own, its m stays in a register (inlined in the
 * slicer loop, it cost 56 B more); called 3600 times a second only. ---- */
__attribute__((noinline))
static void hdlcBit(sl_t *m,uint8_t b){
    if(m->bits<255u) m->bits++;
    m->sr=(uint8_t)((m->sr>>1)|(b<<7));
    if(m->sr==0x7Eu){
        bool ok = m->inframe && m->n>=FRAME_MIN && m->crc==FCS_GOOD && isUI(m->buf,m->n);
        m->pre = m->bits==8u;
        m->bits=0;
        if(ok) accept(m);
        m->inframe=1; m->hdr=1; m->n=0; m->crc=0xFFFFu;
        m->ones=m->byte=m->nb=0;
        return;
    }
    if(b){
        if(++m->ones>6u){ m->ones=7; m->inframe=0; return; }   /* abort / noise */
    } else {
        if(m->ones==5u){ m->ones=0; return; }                 /* stuffed zero  */
        m->ones=0;
    }
    if(!m->inframe) return;
    m->byte|=(uint8_t)(b<<m->nb);
    if(++m->nb==8u){
        if(m->n<FRAME_MAX){
            uint16_t c=m->crc^m->byte;        /* CRC-16/X.25, reflected 0x1021 */
            for(uint8_t i=0;i<8u;i++) c=(c&1u)?(uint16_t)((c>>1)^0x8408u):(uint16_t)(c>>1);
            m->crc=c;
            if(m->n<6u && ((m->byte&1u) || !callChar((uint8_t)(m->byte>>1)))) m->hdr=0;
            m->buf[m->n++]=m->byte;
        } else m->inframe=0;
        m->byte=m->nb=0;
    }
}

/* A slicer is busy inside a preamble (two back-to-back flags, then 3 bytes) or
 * a frame whose first bytes look like a callsign: noise is busy ~4 % of the time. */
static bool busy(const sl_t *m){
    return (m->pre && m->bits<PRE_BITS) || (m->inframe && m->n && m->hdr);
}

/* |(i, q)| ~ max + 3/8 min */
static int32_t mag(int32_t i,int32_t q){
    if(i<0) i=-i;
    if(q<0) q=-q;
    if(i<q){ int32_t t=i; i=q; q=t; }
    return i+(q>>2)+(q>>3);
}

/* Magnitude of one tone and its peak tracker (AGC). Not inlined: one copy for
 * both tones, two calls per sample. */
__attribute__((noinline))
static int32_t tone(int32_t i,int32_t q,int32_t *pk){
    int32_t mt=mag(i,q), p=*pk;
    p+= mt>p ? (mt-p)>>AGC_ATT : -(p>>AGC_DEC);
    if(p<PK_MIN) p=PK_MIN;
    *pk=p;
    return mt;
}

/* ---- front end, one ADC sample: *a = Mm*Ps, *b = Ms*Pm (each tone over its
 * own peak, without division; both stay below ~2^21) ---- */
static void front(dem_t *m,int32_t adc,int32_t *a,int32_t *b){
    m->dc+=((adc<<4)-m->dc)>>6;
    int32_t x=adc-(m->dc>>4);
    int32_t y=(BP_B0*(x-m->x2)-BP_A1*m->y1-BP_A2*m->y2)>>14;
    m->x2=m->x1; m->x1=x; m->y2=m->y1; m->y1=y;

    /* sliding correlators over one bit; the sine is the cos table 3/4 period ahead.
     * At 9.6 kHz one bit and one 1200 Hz period are both 8 samples: the ring slot
     * is also the 1200 Hz table phase. */
    int16_t *o=m->ring[m->r];
    uint32_t k=m->ks+12u; if(k>=48u) k-=48u;
    int32_t p;
    p=(y*m->cm[m->r])>>8;               m->im+=p-o[0]; o[0]=(int16_t)p;
    p=(y*m->cm[(m->r+6u)&7u])>>8;       m->qm+=p-o[1]; o[1]=(int16_t)p;
    p=(y*m->cs[m->ks])>>8;              m->is+=p-o[2]; o[2]=(int16_t)p;
    p=(y*m->cs[k])>>8;                  m->qs+=p-o[3]; o[3]=(int16_t)p;
    m->r=(m->r+1u)&7u;
    if(++m->ks>=48u) m->ks=0;

    int32_t mm=tone(m->im,m->qm,&m->pm), ms=tone(m->is,m->qs,&m->ps);
    *a=mm*m->ps;
    *b=ms*m->pm;
}

/* ---- slicer: decision sign(wa*a - wb*b), DPLL, NRZI, HDLC ---- */
static void slice(sl_t *m,int32_t a,int32_t b){
    int32_t d=a*m->wa-b*m->wb;
    /* DPLL: a bit at each phase wrap (mid-bit), transitions pulled to mid-phase */
    m->phase+=PLL_STEP;
    if((d>0)!=(m->dprev>0)) m->phase+=(PLL_CTR-m->phase)>>PLL_SHIFT;
    m->dprev=d;
    if(m->phase>=65536){
        m->phase-=65536;
        uint8_t lv=d>0;
        hdlcBit(m,lv==m->last);           /* NRZI: no change = 1 */
        m->last=lv;
    }
}

/* ---- AX.25 address field -> "F4HWN-7" ---- */
static char *putCall(char *o,const uint8_t *a){
    for(uint8_t i=0;i<6u;i++){ char c=(char)(a[i]>>1); if(c!=' ') *o++=c; }
    uint8_t ssid=(uint8_t)((a[6]>>1)&15u);
    if(ssid){ *o++='-'; o=puti(o,ssid); }
    return o;
}

/* The tiny font covers 0x20-0x7F: anything else shows as '.'. */
__attribute__((noinline))
static char safe(uint8_t ch){ return (ch<0x20u||ch>0x7Eu)?'.':(char)ch; }

/* Body rows str..end, wrapped every ROW_CHARS + g.cw. A visible row is rendered
 * on scratch page 4, then its columns are ORed into lines 0-3 at its exact pixel
 * offset: 8-pixel and 6-pixel rows scroll alike, without another framebuffer.
 * Rows may spill over line 0 and the separator: draw() redraws both afterwards.
 * The scratch page is left blank: display_clear() blanks it before the first
 * row and each row clears it after use. */
static char *emit(char *end){
    const app_api_t *A=g.A;
    char *p=str;
    while(p<end){
        unsigned w=ROW_CHARS+g.cw;   /* 18 or 32; compare lengths before forming p + w */
        char *q=((unsigned)(end-p)>w)?p+w:end;
        char c=*q; *q='\0';
        unsigned y=(unsigned)g.vrow-g.top;   /* wraps to a huge value above the screen */
        if(y-1u<30u){                /* y = 1..30: higher rows lie under the source */
            uint8_t *scratch=A->fb[4];
            if(g.cw) A->print_tiny(p,0,32,false,true);
            else A->print_normal(p,0,0,4);
            for(unsigned x=0;x<128u;x++){
                uint32_t bits=(uint32_t)scratch[x]<<y;
                for(uint8_t *out=A->fb[0]+x;bits;out+=128){
                    *out|=(uint8_t)bits;
                    bits>>=8;
                }
            }
            memset(scratch,0,128);
        }
        *q=c;
        g.vrow+=g.cw?6u:8u;
        p=q;
    }
    return str;                         /* the next row starts there */
}

/* Between two parts of a row ("48 50.89N" / "002 16.25E"): a new row in the
 * scroll view, a space in the compact one. */
static char *brk(char *o){
    if(g.cw){ *o++=' '; return o; }
    return emit(o);
}

/* Info bytes f[i..end) after the text already at str..o, on as many rows as
 * they take. */
static void textRows(char *o,const uint8_t *f,unsigned i,unsigned end){
    const uint8_t *p=f+i, *last=f+end;
    do{
        for(; o<str+ROW_CHARS+g.cw && p<last; p++) *o++=safe(*p);
        o=emit(o);
    }while(p<last);
}

/* ---- Mic-E (APRS 1.0.1 chapter 10; test/mice.py is the reference) ----
 * The latitude, N/S, the longitude +100 offset, E/W and the message bits are in
 * the destination address; the longitude, speed, course and symbol in the info
 * field. Byte arithmetic wraps as uint8, so a bad field prints junk, never loops. */
static char *put2(char *o,uint32_t v){ *o++=(char)('0'+sub(&v,10u)); *o++=(char)('0'+v); return o; }
static char *put3(char *o,uint32_t v){ *o++=(char)('0'+sub(&v,100u)); return put2(o,v); }
static bool micType(uint8_t t){ return t=='`'||t=='\''||t==0x1Cu||t==0x1Du; }

/* Keep decoder temporaries out of the history renderer's register allocation. */
__attribute__((noinline))
static void drawMicE(const uint8_t *f,unsigned i,unsigned end,const char *s){
    uint8_t c[6];
    /* The asset lookup packs digit, position/message bit and custom flag. */
    for(unsigned k=0;k<6u;k++) c[k]=(uint8_t)s[T_MIC+(f[k]>>1)];

    /* "48 50.89N" / "002 16.25E" (brk) */
    char *o=str;
    for(uint8_t k=0;k<6u;k++){
        *o++=(char)('0'+(c[k]&15u));
        if(k==1u) *o++=' ';
        if(k==3u) *o++='.';
    }
    *o++=(c[3]&16u)?'N':'S';
    o=brk(o);
    uint32_t deg=(uint8_t)(f[i+1]-28u);
    if(c[4]&16u) deg+=100u;
    if(deg>=180u && deg<=189u) deg-=80u;
    else if(deg>=190u && deg<=199u) deg-=190u;
    uint32_t mn=(uint8_t)(f[i+2]-28u);
    if(mn>=60u) mn-=60u;
    o=put3(o,deg); *o++=' '; o=put2(o,mn); *o++='.'; o=put2(o,(uint8_t)(f[i+3]-28u));
    *o++=(c[5]&16u)?'W':'E';
    emit(o);

    /* "12km/h 245 [/" / "En Route" (brk): speed in knots x 1.8525 (1897/1024) */
    uint32_t dc=(uint8_t)(f[i+5]-28u);
    uint32_t sp=(uint32_t)(uint8_t)(f[i+4]-28u)*10u+sub(&dc,10u);
    uint32_t crs=dc*100u+(uint8_t)(f[i+6]-28u);
    if(sp>=800u) sp-=800u;
    if(crs>=400u) crs-=400u;
    o=puti(str,(int32_t)((sp*1897u)>>10)); o=put(o,s+T_KMH);
    o=puti(o,(int32_t)crs); *o++=' ';
    *o++=safe(f[i+7]); *o++=safe(f[i+8]);
    g.symTable=f[i+8]; g.symCode=f[i+7];
    o=brk(o);
    unsigned idx=0;
    unsigned custom=0;
    for(unsigned k=0;k<3u;k++){
        idx=(idx<<1)|((c[k]>>4)&1u);
        custom|=c[k]&32u;
    }
    if(custom && idx){ o=put(o,s+T_CUSTOM); *o++=(char)('0'+7u-idx); }
    else o=put(o,s+T_MSG+idx*T_MSG_STRIDE);
    emit(o);

    /* comment: trailing CR/LF, the device markers (Yaesu/other: '`' or '\'' +
     * text + 2 chars; Kenwood: '>' or ']' + text [+ '=' or '^']) and a leading
     * "xxx}" altitude (base 91, metres + 10000) */
    unsigned j=i+9u;                          /* the caller guarantees j <= end */
    while(end>j && (f[end-1]=='\r'||f[end-1]=='\n')) end--;
    if(j<end){
        uint8_t m=f[j];
        if(m=='`'||m=='\''){ j++; if(end-j>=2) end-=2u; }
        else if(m=='>'||m==']'){ j++; if(end>j && (f[end-1]=='='||f[end-1]=='^')) end--; }
    }
    o=str;
    if(end-j>=4 && f[j+3]=='}'){
        int32_t alt=(((int32_t)f[j]-33)*91+((int32_t)f[j+1]-33))*91+((int32_t)f[j+2]-33)-10000;
        o=puti(o,alt); *o++='m'; *o++=' ';
        j+=4u;
    }
    textRows(o,f,j,end);
}

/* ---- uncompressed position ('!' '=' or, after a 7-character timestamp, '/'
 * '@'; test/mice.py draw_pos is the reference): "49 21.07N 001 50.50E", then
 * the timestamp, the symbol and the comment. False for anything else (compressed
 * positions included), which is then shown as raw text. The position takes
 * two rows in the scroll view, "49 21.07N" / "001 50.50E", one when compact. ---- */
__attribute__((noinline))
static bool drawPos(const uint8_t *f,unsigned i,unsigned end){
    uint8_t t=f[i];
    unsigned p=i+1u;                         /* native-width offset; bounds checked below */
    if(t=='/'||t=='@') p+=7u;
    else if(t!='!'&&t!='=') return false;
    if(end<p+19u || f[p+4]!='.' || f[p+14]!='.') return false;
    const uint8_t *q=f+p;                     /* DDMM.hhN T DDDMM.hhE C */
    char *o=str;
    for(uint8_t k=0;k<18u;k++){
        if(k==8u){ o=brk(o); continue; }       /* symbol table: later */
        if(k==2u||k==12u) *o++=' ';
        *o++=safe(q[k]);
    }
    o=emit(o);
    if(p>i+1u){
        /* A timestamp always occupies the seven bytes after the data type. */
        for(unsigned k=0;k<7u;k++) *o++=safe(f[i+1u+k]);
        *o++=' ';
    }
    *o++=safe(q[8]); *o++=safe(q[18]); *o++=' ';
    g.symTable=q[8]; g.symCode=q[18];
    textRows(o,f,p+19u,end);
    return true;
}

/* ---- display ---- (not inlined: 16 B less) */
__attribute__((noinline))
static void draw(void){
    const app_api_t *A=g.A;
    /* The UI texts and Mic-E lookup live in the assets: one read into this word-aligned
     * stack block, so each text costs a 2-byte sp-relative add instead of a
     * literal and its pool word (gen_assets.py keeps every offset aligned). */
    char s[UI_SIZE] __attribute__((aligned(4)));
    char *o;
    frame_t *frame=g.history[g.cur];     /* read only when there is a frame */
    uint8_t *b=A->fb[0];
    A->asset_read(0,s,UI_SIZE);
    A->display_clear();
    A->status_clear();
    g.vrow=8;                            /* the body starts under the source */
    g.symTable=0;
    A->print_inverse(s+T_TITLE,2,0,true,true,(uint8_t)(2u+T_TITLE_CHARS*4u));
    A->draw_battery();

    if(!g.count)                         /* no frame yet: a capsule, as APRS TX's TRANSMIT */
        A->print_inverse(s+T_WAIT,WAIT_CAPS_X,0,true,true,(uint8_t)(WAIT_CAPS_X+T_WAIT_CHARS*4u));
    else {
        const uint8_t *f=frame->buf;
        unsigned end=frame->len-2u;            /* the FCS is not shown */

        /* ">DEST,DIGI*,..." while it fits 2 rows, then the rest of the
         * address field is skipped up to its end bit */
        o=str; *o++='>'; o=putCall(o,f);
        unsigned e=13;                        /* isUI() already checked the end marker and bounds */
        while(!(f[e]&1u)){
            e+=7;
            if(o<=str+20){ *o++=','; o=putCall(o,f+e-6); if(f[e]&0x80u) *o++='*'; }
        }
        emit(o);

        /* info field (after control and PID): Mic-E and uncompressed positions
         * decoded, anything else as text */
        unsigned i=e+3u;
        if(end>=i+9u && micType(f[i])) drawMicE(f,i,end,s);
        else if(i<end && !drawPos(f,i,end)) textRows(str,f,i,end);

        /* the source, fixed on line 0 over the body rows scrolled there */
        memset(b,0,128);
        *putCall(str,f+7)='\0';
        A->print_bold(str,0,0,0);
        /* at the right of the source, two capsules: once several frames are
         * kept, "2/5" at the edge (the frame shown / the frames kept, 1 =
         * newest), and left of it the frames received. A capsule runs from 2 px before its text to its end column. */
        unsigned capsEnd=CAPS_END;
        if(g.count>1u){
            o=str; *o++=(char)('1'+g.cur); *o++='/'; *o++=(char)('0'+g.count); *o='\0';
            A->print_inverse(str,CAPS_END-12u,0,false,true,CAPS_END);
            capsEnd-=16u;                 /* that capsule and a blank column */
        }
        o=puti(str,g.nOk); *o='\0';
        A->print_inverse(str,(uint8_t)(capsEnd-4u*(unsigned)(o-str)),0,false,true,(uint8_t)capsEnd);
    }
    /* The last glyph ends one pixel before its row height: the scroll stops
     * with it right above the separator. */
    unsigned lim=g.vrow>32u?g.vrow-32u:0u;
    g.lim=lim;
    /* Status bar from SPK_X: the speaker icon while on, an up mark while rows
     * or a newer frame hide above, a down mark while rows or an older frame hide
     * below: UP / DOWN has something to show. */
    unsigned t=g.spk;
    if(g.top || g.cur) t+=2u;
    if(g.top<lim || g.cur+1u<g.count) t+=4u;
    A->asset_read((uint16_t)(BMP_TAIL+t*TAIL_W),A->status_line+SPK_X,TAIL_W);

    /* dotted separator above the frequency: y = 31, bit 7 of line 3, over
     * whatever the shift brought there (the big digits start at y = 33: one
     * blank px between) */
    for(unsigned x=0;x<128u;x+=2u){
        b[384u+x]|=0x80u;
        b[385u+x]&=0x7Fu;
    }
    drawFreq(A->rx_freq());
    drawSymbol();

    /* bottom line: "-89dBm", RSSI of the frame shown (none captured yet: blank) */
    o=str;
    if(g.count){ o=puti(o,frame->rssi); o=put(o,s+T_DBM); }
    tiny(49,o);
}

/* ---- input ---- */
static void handleKeys(void){
    const app_api_t *A=g.A;
    uint8_t key=A->get_key();
    /* UP/DOWN, held: scroll the body 1 px per slot (20 px/s) while rows overflow.
     * Pressed again once at an end: the newer (UP) or older (DOWN) frame, from its
     * first row; holding the key never leaves the frame. Raw KEY_UP is UP on
     * K5 and LEFT on K1; KEY_DOWN is DOWN / RIGHT. */
    int d=(key==APP_KEY_DOWN)-(key==APP_KEY_UP);
    unsigned top=(unsigned)(g.top+d);     /* wraps past the first row */
    if(top<=g.lim){
        if(top!=g.top){ g.top=(uint16_t)top; g.redraw|=REDRAW_ON; }
    } else if(key!=g.prevKey && (unsigned)(g.cur+d)<g.count){
        g.cur=(uint8_t)(g.cur+d);         /* the new key redraws below */
        g.top=0;
    }
    if(key==APP_KEY_INVALID||key==g.prevKey){ g.prevKey=key; return; }
    g.prevKey=key;
    g.redraw|=REDRAW_ON;
    if(key==APP_KEY_EXIT) g.running=false;
    else if(key==APP_KEY_2){ g.count=g.cur=0; g.nOk=0; g.top=0; }   /* g.lim: 0 at the redraw that follows */
    else if(key==APP_KEY_1){ g.spk^=1u; A->audio_path(g.spk); }   /* speaker, as FoxHunt's audio */
    else if(key==APP_KEY_STAR){ g.cw^=CW_COMPACT; g.top=0; }   /* the view (saved on exit) */
}

/* ---- keys and screen, between frames ---- */
static void house(void){
    const app_api_t *A=g.A;
    handleKeys();
    if(!g.running) return;
    if(g.redraw&REDRAW_FRAME) A->backlight_on();   /* wake on a new frame */
    A->backlight_update();     /* normal BLTime timeout; keys re-arm it in get_key() */
    if(++g.refresh>=REFRESH_SLOTS) g.redraw|=REDRAW_ON;
    if(!g.redraw) return;
    g.redraw=0;
    g.refresh=0;
    adcRestore();                /* the battery is on ADC channel 8 */
    A->battery_sample();
    adcSelPA4();
    draw();
    A->blit_status();
    A->blit_full();
}

/* ---- the receiver: PA4 at 9.6 kHz, continuously, until EXIT ---- */
/* Keep decoder stack offsets independent of the five history buffers. */
__attribute__((noinline))
static void listen(void){
    const app_api_t *A=g.A;
    dem_t d;
    sl_t sl[NSL];
    memset(sl,0,sizeof sl);
    A->asset_read(DEMOD_INIT,&d,sizeof d);  /* initial state, then both cosine tables */
    sl[0].wa=2; sl[0].wb=3;      /* favours space */
    sl[1].wa=1; sl[1].wb=1;
    sl[2].wa=3; sl[2].wb=2;      /* favours mark  */
    /* hdlcBit initializes the CRC at the opening flag, before collecting bytes. */

    adcSelPA4();
    clkStart();
    uint32_t next=0;                    /* the first sample at once */
    uint16_t cnt=0;
    uint8_t busyFor=0;
    g.redraw=REDRAW_ON;
    while(g.running){
        while((int32_t)(clkCyc()-next)<0){}
        next+=CYC_PER_SAMPLE;
        int32_t a,b;
        front(&d,adcRead(),&a,&b);
        for(uint8_t k=0;k<NSL;k++) slice(&sl[k],a,b);
        if(++cnt<HOUSE_EVERY) continue;
        cnt=0;
        bool bz=false;                  /* only the slot's own sample decides */
        for(uint8_t k=0;k<NSL;k++) bz|=busy(&sl[k]);
        if(bz && ++busyFor<BUSY_MAX) continue;
        busyFor=0;
        house();
        next=clkCyc();                  /* skip the samples the slot took */
    }
    adcRestore();
}

__attribute__((section(".text.entry"),used))
void app_main(const app_api_t *api){
    frame_t frames[HISTORY];    /* on the stack: the 4 KiB overlay also holds .bss */
    frame_t *history[HISTORY];
    for(unsigned k=0;k<HISTORY;k++) history[k]=&frames[k];
    char text[34];
    g.A=api;
    g.text=text;
    g.history=history;
    /* The overlay loader zeroes g; the first idle key scan records APP_KEY_INVALID. */

    g.savedSqr3=ADC_SQR3; g.savedSmpr3=ADC_SMPR3;
    /* Only app_main needs these snapshots; keep them outside the overlay .bss. */
    const uint32_t savedModer=GPIOA_MODER, savedDac=DAC_CR;
    const uint32_t savedRcc=RCC_APBENR1, savedDhr=DAC_DHR12R1;
    biasOn(savedModer,savedRcc);
    api->backlight_on();
    api->cfg_load(&g.cw,2);      /* view and speaker; erased flash (0xFF) or junk:
                                    scroll, speaker off */
    if(g.cw!=CW_COMPACT) g.cw=0;
    g.spk=(uint8_t)(g.spk==1u);
    /* Speaker amplifier (PA8) as saved, off by default: the decoder does not
     * need it (tested on the radio, 2026-09-30): PA4, the voice-prompt DAC pin,
     * joins the audio before the amplifier; only the BK4829 AF output must be
     * on. Key 1 toggles the speaker to listen to the channel. */
    api->audio_path(g.spk);
    api->set_af(APP_AF_FM);
    api->delay_ms(50);

    g.running=true;
    listen();

    biasOff(savedDac,savedDhr,savedRcc,savedModer);
    api->set_af(APP_AF_MUTE);
    api->audio_path(false);
    api->cfg_save(&g.cw,2);      /* staged: flash is written only after a change */
}

/* Copyright 2026 Armel F4HWN
 * https://github.com/armel
 *
 * Licensed under the Apache License, Version 2.0 (the "License");
 * you may not use this file except in compliance with the License.
 * You may obtain a copy of the License at
 *
 *     http://www.apache.org/licenses/LICENSE-2.0
 *
 *     Unless required by applicable law or agreed to in writing, software
 *     distributed under the License is distributed on an "AS IS" BASIS,
 *     WITHOUT WARRANTIES OR CONDITIONS OF ANY KIND, either express or implied.
 *     See the License for the specific language governing permissions and
 *     limitations under the License.
 */

/*
 * AF Spectro - the spectrum of the demodulated RX audio, not of RF: the
 * BK4829 AF output, sampled on PA4 (the voice DAC pin) as APRS RX does, at
 * 9.6, 19.2 or 38.4 kHz. The spectral half of an instrument whose other half
 * is AF Scope (oscilloscope, tuner): MENU on the last view hands off to it.
 *   SPECTRO  the spectrum (0 to fs/2) with peak hold, the two main peaks and
 *            their level difference (TW; for Bell 202, the twist), a 16-row
 *            sonogram strip (1.3 s);
 *   SONO     the sonogram over the screen: 40 rows, 3.2 s.
 * Both sonograms scroll down, the newest row at the top. A row stays blank while the squelch is closed (STD only: in RAW its bit stays
 * closed): the hiss between packets would otherwise fill them as much as a
 * signal.
 * It names nothing it hears.
 *
 * Analysis (test/model.py is the reference, keep the two in step): blocks of
 * 256 samples, nothing else running while one is taken but, while the
 * speaker is on, the LCD bytes sent with the samples (lcd_feed); a Hann window,
 * a 256-point FFT in block floating point, levels in tenths of dB. A block is
 * a steady tone when its second peak lies 15 dB under the first: its
 * interpolated frequency counts for the MIN / MAX of the header. A frame is
 * about 80 ms of blocks (3, 6 or 12): the smoothed spectrum (1/4 of each
 * block) gives the bars, the peaks and the sonogram row, all scaled on its
 * mean level. Bell 202 AFSK (a plateau with 1200 and 2200 Hz near its peak,
 * over 800 and 2700 Hz) shows as 1200 / 2200 Hz, its twist the energy ratio
 * of the bands around them (+-2 bins), averaged over about 1.7 s of Bell 202
 * (the hiss between packets left out).
 * The fixed parts of the screens (status-bar capsules, axis) are asset
 * bitmaps drawn by gen_assets.py.
 *
 * Keys (UV-K5 and UV-K1): MENU next view, then AF Scope · UP/DOWN range of
 *   the bars and contrast of the sonogram (80, 60, 40 dB) · * hold · 1 audio
 *   path STD / RAW · 2 speaker · 3 sample rate · 0 clear (peak hold,
 *   sonogram, MIN / MAX, twist) · EXIT quit (view, path, speaker,
 *   rate and range saved).
 * The status bar shows RAW when the filters are off, a lock while held (else
 * a clipped wave while samples reach the ADC limits) and the speaker while
 * it is on. STD keeps the VFO's AF output and filters (USB
 * for USB, else FM, which AM also uses: its demodulator is REG_31 bit 0);
 * RAW turns the RX audio filters and the AFC off and, in FM only, selects the
 * discriminator bypass (REG_47 AF 9, as the radiosonde apps). The registers
 * are restored on exit, and the loader re-runs RADIO_SetupRegisters.
 */

#include <stdint.h>
#include <stdbool.h>
#include <stddef.h>
#include "../app_api.h"
#include "../af_handoff.h"
#include "afspectro_assets.h"   /* generated by gen_assets.py */

/* ---- sampling ---- */
#define N           256u
#define BINS        128u
#define CYC_9K6     5000u      /* 48 MHz / 9.6 kHz, halved per rate step     */
#define BLOCKS_9K6  3u         /* blocks per frame at 9.6 kHz: 80 ms         */
#define FS_COUNT    3u
#define CLIP_LO     (16 - 2048)
#define CLIP_HI     (4079 - 2048)

/* ---- analysis (test/model.py) ---- */
#define FFT_LIMIT   8192       /* below it a butterfly stage cannot overflow */
#define PEAK_LO     2u
#define PEAK_HI     125u
#define PEAK_GUARD  6u         /* bins between the two peaks                 */
#define PURE_DB     150        /* a steady tone: the second peak 15 dB under */
#define TWO_DB      300        /* two tones: the second within 30 dB ...     */
#define OVER_DB     120        /* ... both 12 dB over the mean level, ...    */
#define VALLEY_DB   100        /* ... and 10 dB over the level between them  */
#define FLOOR_DB    50         /* bars: the mean level 5 dB over the bottom  */
#define BELL_DB     150        /* Bell 202: 1200, 2200 Hz 15 dB under the peak, */
#define EDGE_DB     60         /* 6 dB over 800 and 2700 Hz (voice is not)   */
#define BELL_HOLD   8u         /* frames a detection lasts                   */
#define BAND        2u         /* twist bands: +-2 bins                       */
#define TW_SHIFT    6u         /* twist average: 1/64 per block at 9.6 kHz    */

/* ---- BK4829 ---- */
#define REG_0C      0x0C       /* bit 1: squelch open                         */
#define REG_2B      0x2B       /* bits 10:8 off: RX HPF 300, LPF 3k, de-emph. */
#define REG_31      0x31       /* bit 0: the AM demodulator, set by the VFO   */
#define REG_47      0x47       /* bits 11:8: AF output                        */
#define REG_73      0x73       /* bit 4: AFC disabled                         */
#define RAW_2B      0x0700u
#define RAW_73      0x0010u
#define AF_USB      5u         /* BK4819_AF_BASEBAND2, the firmware's USB AF  */
#define AF_BYPASS   9u         /* discriminator bypass, as the sonde apps     */

/* ---- screen (gen_assets.py draws the fixed parts with the same values) ---- */
#define BAR_BASE    31u        /* SPECTRO bars, 24 px up to y = 8             */
#define BAR_H       24
#define SON_PAGES   5u         /* sonogram: 40 rows ...                       */
#define STRIP_PAGES 2u         /* ... and SPECTRO's strip, 16 rows            */
#define CFG_LEN     5u         /* view, raw, spk, fsi, range                  */

enum { V_SPECTRO = 0, V_SONO, V_COUNT };
enum { M_FM = 0, M_AM, M_USB };         /* the VFO's demodulation: the AF path */

/* The quarter sine table, then the mantissa of lg(): one read at launch. */
_Static_assert(LOGT == SINQ + SINQ_LEN && LOGT_LEN == 32u, "LOGT must follow SINQ");
#define LOGT_TAB    ((const uint8_t *)(g.sinq + SINQ_LEN / 2u))
#define RANGES      3u
/* the saved settings: their limits (a value at or over it reads as 0, the
 * range as 1: 60 dB) */
static const uint8_t CFG_LIM[CFG_LEN] = { V_COUNT, 2, 2, FS_COUNT, RANGES };
static const uint8_t RANGE[RANGES] = { 80, 60, 40 };    /* dB over the bars   */
static const uint8_t KHI[FS_COUNT] = { 59, 29, 15 };    /* 2200 Hz bin        */
/* REG_47's AF output per mode and path (mode * 2 + raw): FM, FM RAW (the
 * discriminator bypass), AM (the FM output, the AM demodulator on), AM RAW,
 * USB, USB RAW */
static const uint8_t AF_OUT[6] = { APP_AF_FM, AF_BYPASS, APP_AF_FM, APP_AF_FM, AF_USB, AF_USB };

/* The app state in one struct: one base address per function instead of a
 * literal per global. Bytes (the saved settings first, in cfg order), then
 * halfwords, then words, then the 64-bit sums. The loader zeroes the overlay
 * (.bss) at every launch. */
static struct {
    union {                             /* the saved settings, cfg order */
        uint8_t set[CFG_LEN];
        struct { uint8_t view, raw, spk, fsi, range; };
    };
    uint8_t  prevKey, held, fresh, mode, kHi, bellFor, sq;   /* sq: squelch open */
    uint8_t  sono;                      /* frame parity: dotted rows          */
    bool     lcd;                       /* lcd_feed: a frame being sent       */
    uint8_t  frames;                    /* lcd_feed frames: K5Viewer every 16 */
    bool     running, two, bell;
    uint16_t r2B, r73, tmin, tmax;
    int32_t  clip, mean, l1, l2, f1, f2, fs;
    const app_api_t *A;
    int16_t  *smp, *S, *im;             /* samples/FFT real, smoothed, FFT imag */
    uint8_t  *hold;                     /* peak hold (px), then the sonogram   */
    const int16_t *sinq;                /* then LOGT_TAB                      */
    char     *text;                     /* formatting buffer (app_main's stack) */
    uint64_t elo, ehi;                  /* Bell 202 band energies             */
} g;
#define str g.text
#define SON (g.hold + BINS)             /* sonogram: SON_PAGES after the hold, */
#define STRIP (SON + SON_PAGES * BINS)  /* then the strip                      */

/* ---- tiny freestanding helpers: GCC may turn small loops into calls ---- */
void *memset(void *d, int c, size_t n) {
    uint8_t *p = d; while (n--) *p++ = (uint8_t)c; return d;
}
void *memcpy(void *d, const void *s, size_t n) {
    uint8_t *p = d; const uint8_t *q = s; while (n--) *p++ = *q++; return d;
}
/* Divisions through the resident helpers (API level 2). GCC leaves an
 * undefined __aeabi_uidiv in the object even without a call: defining it
 * here keeps libgcc's 276-byte one out. */
uint64_t __aeabi_idivmod(int32_t n, int32_t d){ return g.A->idivmod(n, d); }
uint64_t __aeabi_idiv(int32_t n, int32_t d) __attribute__((alias("__aeabi_idivmod")));
uint64_t __aeabi_uidivmod(uint32_t n, uint32_t d){ return g.A->uidivmod(n, d); }
uint64_t __aeabi_uidiv(uint32_t n, uint32_t d) __attribute__((alias("__aeabi_uidivmod")));

/* ---- formatting ---- */
static char *put(char *o, const char *s){ while (*s) *o++ = *s++; return o; }
/* The resident formatter (API level 3), behind one local stub: every call
 * stays a plain bl. */
__attribute__((noinline))
static char *puti(char *o, int32_t v){ return g.A->append_i32(o, v); }
/* o0..o right-aligned in w characters (spaces before), so that the fields of
 * a line stay put; longer, left as it is */
__attribute__((noinline))
static char *rjust(char *o0, char *o, unsigned w){
    char *e = o0 + w;
    if (o >= e) return o;
    while (o > o0) *--e = *--o;
    while (e > o0) *--e = ' ';
    return o0 + w;
}
/* v with leading zeros to 4 digits: "0410" */
static char *put04(char *o, int32_t v){
    char *e = rjust(o, puti(o, v), 4u);
    for (char *p = o; *p == ' '; p++) *p = '0';
    return e;
}
/* tenths: "-5.1" */
static char *putTenths(char *o, int32_t v){
    if (v < 0) { *o++ = '-'; v = -v; }
    uint64_t qr = __aeabi_idivmod(v, 10);
    o = puti(o, (int32_t)qr); *o++ = '.';
    *o++ = (char)('0' + (int32_t)(qr >> 32));
    return o;
}
/* str..end in the tiny font at x, y, cut at the screen edge (print_tiny
 * does not clip) */
static void tiny(uint8_t x, uint8_t y, char *end){
    unsigned room = (128u - x) >> 2;
    if ((unsigned)(end - str) > room) end = str + room;
    *end = '\0'; g.A->print_tiny(str, x, y, false, true);
}
static void dot(unsigned x, unsigned y){ g.A->fb[y >> 3][x] |= (uint8_t)(1u << (y & 7u)); }
/* asset_read lies past the ldr immediate range of the table: one stub */
__attribute__((noinline))
static void asset(unsigned off, void *dst, unsigned len){
    g.A->asset_read((uint16_t)off, dst, (uint16_t)len);
}

/* ---- the analysis (test/model.py) ---- */
/* sin(2 pi k / 256), Q14, from the quarter table */
static int32_t sn(unsigned k){
    int32_t s = 1;
    k &= 255u;
    if (k >= 128u) { k -= 128u; s = -1; }
    if (k > 64u) k = 128u - k;
    return s * g.sinq[k];
}

/* 10 log10(p) in tenths of dB */
static int32_t lg(uint32_t p){
    unsigned e = 0;
    if (!p) return 0;
    while (p >> (e + 1u)) e++;
    return (int32_t)(e * 30u + ((e * 13u) >> 7) + LOGT_TAB[(p << (31u - e)) >> 26 & 31u]);
}

/* The 64-bit averages: e loses 1/2^sh of itself and gains v at the block's
 * scale (2 exp). */
__attribute__((noinline))
static void ema(uint64_t *e, uint32_t v, unsigned sh, unsigned exp){
    *e = *e - (*e >> sh) + ((uint64_t)v << (2u * exp));
}

/* 10 log10(a / b) in tenths of dB */
static int32_t ratio(uint64_t a, uint64_t b){
    while ((a | b) >> 32) { a >>= 1; b >>= 1; }
    return lg((uint32_t)a) - lg((uint32_t)b);
}

/* In-place 256-point FFT, im all zero on entry; block floating point: a
 * stage starts with every value under FFT_LIMIT. Returns the right shifts
 * made (6.02 dB each). */
__attribute__((noinline))
static unsigned fft(int16_t *re, int16_t *im){
    unsigned exp = 0;
    for (unsigned i = 1, j = 0; i < N; i++) {      /* bit reversal */
        unsigned b = N >> 1;
        while (j & b) { j ^= b; b >>= 1; }
        j |= b;
        if (i < j) { int16_t t = re[i]; re[i] = re[j]; re[j] = t; }
    }
    for (unsigned half = 1, step = N >> 1; half < N; half <<= 1, step >>= 1) {
        int32_t m = 0;
        unsigned sh = 0;
        for (unsigned k = 0; k < N; k++) {
            int32_t a = re[k], b = im[k];
            m |= (a < 0 ? -a : a) | (b < 0 ? -b : b);
        }
        while (m >= FFT_LIMIT) { m >>= 1; sh++; }
        if (sh) {
            for (unsigned k = 0; k < N; k++) { re[k] >>= sh; im[k] >>= sh; }
            exp += sh;
        }
        for (unsigned i = 0; i < N; i += 2u * half)
            for (unsigned j = 0; j < half; j++) {
                int32_t wr = sn(j * step + 64u), wi = -sn(j * step);
                int16_t *pr = re + i + j, *pi = im + i + j;
                int32_t xr = pr[half], xi = pi[half];
                int32_t tr = (wr * xr - wi * xi) >> 14, ti = (wr * xi + wi * xr) >> 14;
                pr[half] = (int16_t)(*pr - tr); pi[half] = (int16_t)(*pi - ti);
                *pr = (int16_t)(*pr + tr);      *pi = (int16_t)(*pi + ti);
            }
    }
    return exp;
}

/* The strongest bin of L in PEAK_LO..PEAK_HI, PEAK_GUARD bins away from ex. */
static unsigned peak(const int16_t *L, unsigned ex){
    unsigned bk = PEAK_LO;
    int32_t best = -32768;
    for (unsigned k = PEAK_LO; k <= PEAK_HI; k++) {
        if (k - ex + PEAK_GUARD <= 2u * PEAK_GUARD) continue;
        if (L[k] > best) { best = L[k]; bk = k; }
    }
    return bk;
}

/* Parabolic interpolation of the peak at k on the dB levels: the frequency
 * in Hz (rounded), the peak level in *lev. */
static int32_t interp(const int16_t *L, unsigned k, int32_t *lev){
    int32_t a = L[k - 1], b = L[k], c = L[k + 1], num = c - a, den = 2 * b - a - c, d8 = 0;
    if (den > 0) {
        d8 = num * 128 / den;
        if (d8 > 128) d8 = 128;
        if (d8 < -128) d8 = -128;
    }
    *lev = b + num * d8 / 1024;
    return (((int32_t)k * 256 + d8) * g.fs + 32768) >> 16;
}

/* One block of samples, paced by the 48 MHz cycle clock.
 * While the speaker is on, the screen goes out with it, k bytes after each
 * sample (lcd_feed): the LCD SPI spread over the capture instead of an 11 ms
 * blit, which the speaker plays as a flutter (the "helicopter"). k is 5 at
 * 9.6 kHz, 3 at 19.2 kHz, 1 at 38.4 kHz (10.7 us a byte): a screen, 1048
 * bytes, goes out within every frame (768 samples or more). */
static void capture(void){
    uint32_t (*const clk)(void) = g.A->cycles_48mhz;
    uint16_t (*const sample)(void) = g.A->af_capture_sample;
    bool (*const feed)(unsigned) = g.A->lcd_feed;
    uint32_t cyc = CYC_9K6 >> g.fsi, next = clk();
    unsigned k = (5u >> g.fsi) | 1u;                /* LCD bytes per sample: 5, 3, 1 */
    for (unsigned n = 0; n < N; n++) {
        while ((int32_t)(clk() - next) < 0) {}
        next += cyc;
        g.smp[n] = (int16_t)(sample() - 2048u);
        if (g.lcd) g.lcd = feed(k);
    }
}

/* Statistics, window, FFT, levels; the smoothed spectrum, the steady-tone
 * MIN / MAX and the twist bands of one block. */
__attribute__((noinline))
static void analyze(void){
    int16_t *re = g.smp, *im = g.im;
    const int16_t *x = re;
    int32_t sum = 0, clip = 0;
    for (unsigned n = 0; n < N; n++) {
        int32_t v = x[n];
        sum += v;
        if (v < CLIP_LO || v > CLIP_HI) clip++;
    }
    int32_t dc = sum >> 8;
    g.clip = clip;
    for (unsigned n = 0; n < N; n++) {
        re[n] = (int16_t)(((x[n] - dc) * ((16384 - sn(n + 64u)) >> 1)) >> 12);
        im[n] = 0;
    }
    unsigned exp = fft(re, im);
    /* the levels replace im[], each bin read before it is written */
    int16_t *L = im;
    uint32_t elo = 0, ehi = 0;
    unsigned kLo = 32u >> g.fsi;
    for (unsigned k = 0; k < BINS; k++) {
        uint32_t p = (uint32_t)(re[k] * re[k]) + (uint32_t)(im[k] * im[k]);
        if (k - kLo + BAND <= 2u * BAND) elo += p;
        if (k - g.kHi + BAND <= 2u * BAND) ehi += p;
        int32_t l = lg(p) + (int32_t)exp * 60;
        L[k] = (int16_t)l;
        if (g.fresh) g.S[k] = (int16_t)l;
        g.S[k] = (int16_t)(g.S[k] + ((l - g.S[k]) >> 2));
    }
    g.fresh = 0;
    /* the twist bands, only while the last frame heard Bell 202: the hiss
     * between packets would pull them toward its own slope */
    if (g.bellFor == BELL_HOLD) {
        ema(&g.elo, elo, TW_SHIFT + g.fsi, exp);
        ema(&g.ehi, ehi, TW_SHIFT + g.fsi, exp);
    }

    unsigned k1 = peak(L, 0xFFu);
    if (L[k1] - L[peak(L, k1)] >= PURE_DB) {
        int32_t lev, f = interp(L, k1, &lev);
        if (f < g.tmin) g.tmin = (uint16_t)f;
        if (f > g.tmax) g.tmax = (uint16_t)f;
    }
}

/* bar height of a level, 0..BAR_H: the range above a bottom 5 dB under
 * the mean level, which stays near the noise floor */
static int32_t px(int32_t l){
    int32_t v = (l - (g.mean - FLOOR_DB)) * BAR_H / (RANGE[g.range] * 10);
    return v < 0 ? 0 : v > BAR_H ? BAR_H : v;
}

/* Bin k of a sonogram of n pages (BINS bytes each, LSB the top row) moved
 * one row down, c its new top row: each page's bottom bit goes to the top of
 * the next one. */
static void scroll(uint8_t *son, unsigned n, unsigned k, unsigned c){
    for (uint8_t *p = son + k; n; n--, p += BINS) {
        unsigned v = *p;
        *p = (uint8_t)(v << 1 | c);
        c = v >> 7;
    }
}

/* End of a frame: the peaks of the smoothed spectrum, its mean level, the
 * peak hold and a new sonogram row. */
static void frame(void){
    const int16_t *S = g.S;
    unsigned k1 = peak(S, 0xFFu), k2 = peak(S, k1);
    g.f1 = interp(S, k1, &g.l1);
    g.f2 = interp(S, k2, &g.l2);
    int32_t mean = 0;
    for (unsigned k = PEAK_LO; k <= PEAK_HI; k++) mean += S[k];
    g.mean = mean / (int32_t)(PEAK_HI + 1u - PEAK_LO);
    g.two = g.l2 >= g.l1 - TWO_DB && g.l2 >= g.mean + OVER_DB &&
            g.l2 >= S[(k1 + k2) >> 1] + VALLEY_DB;
    /* Bell 202 AFSK spreads into a plateau from about 1050 to 2350 Hz with
     * spikes at its ends: it is told by the levels at 1200 and 2200 Hz, near
     * the peak and over 800 and 2700 Hz; they then name the pair. A
     * detection lasts BELL_HOLD frames. */
    unsigned kLo = 32u >> g.fsi;
    int32_t sl = S[kLo], sh = S[g.kHi];
    if (sl >= g.l1 - BELL_DB && sh >= g.l1 - BELL_DB &&
        sl >= S[(kLo * 21u) >> 5] + EDGE_DB && sh >= S[g.kHi + (g.kHi >> 2)] + EDGE_DB)
        g.bellFor = BELL_HOLD;
    else if (g.bellFor) g.bellFor--;
    g.bell = g.bellFor != 0;
    if (g.bell) { g.f1 = 1200; g.f2 = 2200; g.two = true; }
    /* a new sonogram row at the top, the older ones a row down. (They were
     * wiped in place while the LCD went out one byte per sample, 109 ms a
     * screen at 9.6 kHz: a scroll tore. lcd_feed sends one in 22 to 27 ms.)
     * A level a quarter of the range over the mean is a pixel, a sixth a
     * grid of one pixel in four that scrolls with the rows (even bins of
     * every other row: a checkerboard alternating per row drew diagonals).
     * Squelch closed (the main loop's last reading): blank. */
    int32_t on = RANGE[g.range] * 10 / 4, half = (on * 21) >> 5;
    g.sono ^= 1u;
    for (unsigned k = 0; k < BINS; k++) {
        int32_t v = px(S[k]);
        if (g.hold[k]) g.hold[k]--;
        if (v > g.hold[k]) g.hold[k] = (uint8_t)v;
        v = S[k] - g.mean;
        unsigned c = g.sq && (v >= on || (v >= half && g.sono && !(k & 1u)));
        scroll(SON, SON_PAGES, k, c);
        scroll(STRIP, STRIP_PAGES, k, c);
    }
}

/* A new rate, path or clear: the analysis starts over. */
static void reset(void){
    g.fs = 9600 << g.fsi;
    g.kHi = KHI[g.fsi];
    g.fresh = 1; g.bellFor = 0;
    g.elo = g.ehi = 0;
    memset(g.hold, 0, (1u + SON_PAGES + STRIP_PAGES) * BINS);   /* hold, sonogram, strip */
    g.tmin = 0xFFFFu; g.tmax = 0;
}

/* STD: the VFO's AF output and filters. RAW: no RX audio filter, no AFC,
 * the discriminator bypass in FM. */
static void path(void){
    void (*const w)(uint8_t, uint16_t) = g.A->bk_write;
    w(REG_2B, (uint16_t)(g.r2B | RAW_2B * g.raw));
    w(REG_73, (uint16_t)(g.r73 | RAW_73 * g.raw));
    g.A->set_af(AF_OUT[g.mode * 2u + g.raw]);
}

/* ---- display ---- */
/* line 0, the tiny font in fixed columns (frequencies on 4 digits, leading
 * zeros): "1200 / 2200Hz         TW  -5.1dB" (TW on the right edge), or
 * "PK 1180Hz   MIN 0410    MAX 1590" */
static void header(const char *s){
    char *o, *t;
    int32_t lo = g.f1, hi = g.f2, tw = g.l2 - g.l1;
    if (g.two) {
        if (lo > hi) { lo = g.f2; hi = g.f1; tw = -tw; }
        if (g.bell) tw = ratio(g.ehi, g.elo);
        o = put04(str, lo); *o++ = ' '; *o++ = '/'; *o++ = ' '; o = put04(o, hi);
        o = put(rjust(str, o, 11u), s + T_HZ);
        t = put(o, s + T_TW);
        o = put(rjust(t, putTenths(t, tw), 5u), s + T_DB);
    } else {
        o = put(put04(put(str, s + T_PK), lo), s + T_HZ);
        if (g.tmax) {
            o = put04(put(o, s + T_MIN), g.tmin);
            o = put04(put(o, s + T_MAX), g.tmax);
        }
    }
    tiny(0, 1, o);
}

__attribute__((noinline))
static void draw(void){
    char s[UI_SIZE] __attribute__((aligned(4)));
    const app_api_t *A = g.A;
    uint8_t *st = A->status_line;
    asset(0, s, UI_SIZE);
    A->display_clear();
    A->status_clear();
    /* "AF SPECTRO", RAW, then the lock (held) or the clip mark, the speaker:
     * left of the battery text */
    asset(STATUS + g.raw * STATUS_W, st, STATUS_W);
    if (g.held | g.clip) asset(g.held ? BMP_LOCK : BMP_CLIP, st + LOCK_X, BMP_LOCK_LEN);
    if (g.spk) asset(BMP_SPK, st + SPK_X, BMP_SPK_LEN);
    A->draw_battery();
    unsigned axis = AXIS + g.fsi * 128u;
    if (g.view == V_SONO) {
        header(s);
        memcpy(A->fb[1], SON, SON_PAGES * BINS);     /* 40 rows, the newest on top */
        asset(axis, A->fb[6], 128);
    } else {
        /* bars of the smoothed spectrum, peak hold dots, the axis, the
         * 16-row sonogram strip */
        header(s);
        for (unsigned k = 0; k < BINS; k++) {
            int32_t v = px(g.S[k]);
            if (v) A->draw_line(A->fb, (int16_t)k, (int16_t)(BAR_BASE + 1 - v), (int16_t)k, BAR_BASE, true);
            if (g.hold[k] > v) dot(k, BAR_BASE - g.hold[k]);
        }
        asset(axis, A->fb[4], 128);
        memcpy(A->fb[5], STRIP, STRIP_PAGES * BINS);
    }
    if (g.spk) {                      /* lcd_feed sends it with the samples */
        if (!(++g.frames & 15u)) A->viewer_update();   /* no blit_full here */
        g.lcd = A->lcd_feed(0);
    } else {
        A->blit_status();
        A->blit_full();
    }
}

/* ---- input ---- */
static void keys(void){
    const app_api_t *A = g.A;
    uint8_t key = A->get_key();
    if (key == g.prevKey) return;
    g.prevKey = key;
    if (key == APP_KEY_INVALID || key >= APP_KEY_SAVER) return;
    A->backlight_on();
    int8_t d = A->nav_dir(key);
    if (d) {                                     /* range: up is a closer look */
        int32_t v = g.range + d;
        if (v >= 0 && v < (int32_t)RANGES) g.range = (uint8_t)v;
    }
    else if (key == APP_KEY_EXIT) g.running = false;
    else if (key == APP_KEY_MENU) {
        if (g.view + 1u < V_COUNT) g.view++;
        else {                                   /* the last view: AF Scope */
            af_handoff_t m = { AF_HANDOFF_MAGIC, g.raw, g.spk, { 0 }, g.elo, g.ehi };
            if (A->handoff(AF_SCOPE_APP_NAME, &m, sizeof m)) g.running = false;
            else g.view = 0;
        }
    }
    else if (key == APP_KEY_STAR) g.held ^= 1u;
    else if (key == APP_KEY_2) g.spk ^= 1u;
    else if (key <= APP_KEY_3) {                 /* 0 clear, 1 path, 3 rate */
        if (key == APP_KEY_1) { g.raw ^= 1u; path(); A->delay_ms(20); }
        if (key == APP_KEY_3) g.fsi = (uint8_t)(g.fsi + 1u < FS_COUNT ? g.fsi + 1u : 0u);
        reset();
    }
}

__attribute__((section(".text.entry"), used))
void app_main(const app_api_t *api){
    int16_t smp[N], im[N], S[BINS];
    uint8_t hs[(1u + SON_PAGES + STRIP_PAGES) * BINS];   /* hold, sonogram, strip */
    int16_t sinq[(SINQ_LEN + LOGT_LEN + 1u) / 2u];  /* then LOGT_TAB */
    char text[36];
    af_handoff_t m;
    g.A = api;
    g.smp = smp; g.im = im; g.S = S; g.hold = hs; g.sinq = sinq; g.text = text;
    g.prevKey = APP_KEY_INVALID;
    asset(SINQ, sinq, SINQ_LEN + LOGT_LEN);

    /* the settings straight into g; erased flash or junk: the defaults */
    api->cfg_load(g.set, CFG_LEN);
    for (unsigned i = 0; i < CFG_LEN; i++)
        if (g.set[i] >= CFG_LIM[i]) g.set[i] = i == CFG_LEN - 1u;
    /* from AF Scope: its path and speaker, the twist kept, the first view */
    bool from = api->handoff_read(&m, sizeof m, NULL) >= (int16_t)sizeof m &&
                m.magic == AF_HANDOFF_MAGIC;
    if (from) { g.raw = m.raw & 1u; g.spk = m.spk & 1u; g.view = V_SPECTRO; }
    /* before anything touches the AF: the VFO's demodulation, USB if its AF
     * output is, else AM if its demodulator is on, else FM */
    g.mode = ((api->bk_read(REG_47) >> 8) & 0x0Fu) == AF_USB ? M_USB : (uint8_t)(api->bk_read(REG_31) & 1u);
    g.r2B = api->bk_read(REG_2B);
    g.r73 = api->bk_read(REG_73);
    api->af_capture_open();                      /* PA4 bias and ADC channel 4 */
    api->backlight_on();
    path();
    api->delay_ms(50);
    reset();
    if (from) { g.elo = m.elo; g.ehi = m.ehi; }

    g.running = true;
    while (g.running) {
        /* held, the blocks are still taken: they pace the screen's bytes */
        for (unsigned b = BLOCKS_9K6 << g.fsi; b; b--) { capture(); if (!g.held) analyze(); }
        if (!g.held) frame();
        keys();
        /* the speaker follows key 2 and the squelch, which also gates the
         * next sonogram row; in RAW the squelch bit stays closed on a strong
         * signal (APRS heard on PA4, the speaker silent): taken as open, as
         * the radiosonde apps play RAW */
        g.sq = (uint8_t)(g.raw | ((api->bk_read(REG_0C) >> 1) & 1u));
        api->audio_path(g.spk && g.sq);
        api->battery_sample();                   /* yields the capture's ADC itself */
        api->backlight_update();
        /* a new screen once the last one is out */
        if (g.running && !g.lcd) draw();
    }

    api->bk_write(REG_2B, g.r2B);
    api->bk_write(REG_73, g.r73);
    api->af_capture_close();
    api->set_af(APP_AF_MUTE);
    api->audio_path(false);
    api->cfg_save(g.set, CFG_LEN);
}

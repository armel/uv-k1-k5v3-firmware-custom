/* Copyright 2026 Johan Denoyer F4WAT
 * https://github.com/jdenoy
 *
 * Demodulator and modulator from the APRS RX and APRS TX apps,
 * Copyright 2026 Armel F4HWN
 * https://github.com/armel
 *
 * Licensed under the Apache License, Version 2.0 (the "License");
 * you may not use this file except in compliance with the License.
 * You may obtain a copy of the License at
 *
 *     http://www.apache.org/licenses/LICENSE-2.0
 *
 *     Unless required by applicable law or agreed to in writing, software
 *     distributed under the License is distributed on an "AS IS" BASIS,
 *     WITHOUT WARRANTIES OR CONDITIONS OF ANY KIND, either express or implied.
 *     See the License for the specific language governing permissions and
 *     limitations under the License.
 */

/*
 * KISS TNC - the radio as the TNC of APRSdroid (or any KISS client) over the
 * USB serial port (API level 3, serial_*): Bell 202 AFSK 1200 bauds on the
 * VFO, KISS over USB. See README.md.
 *
 * RX: the APRS RX demodulator, unchanged (PA4 sampled at 9.6 kHz, band-pass,
 * 1200/2200 Hz correlators, AGC, 3 slicers with their DPLL, NRZI, HDLC, FCS;
 * aprsrx/test/model_rx.py is the reference). Every good AX.25 frame (FCS
 * checked, then stripped; the same frame from another slicer dropped) is queued
 * and sent as a KISS data frame in the next housekeeping slot, never inside the
 * sampling loop (the USB send waits for the transfer).
 *
 * TX: KISS bytes are read from USB every 10 ms inside the sampling loop (the
 * receive ring holds 256 bytes). A complete data frame waits until no slicer is
 * inside a preamble or a frame (DCD), then is sent with p-persistence: the APRS
 * TX modulator (BK4829 tone generator, 1200 / 2200 Hz switched at each NRZI
 * transition, bits timed from SysTick), TXDELAY flags, the frame bit-stuffed
 * with its FCS, tail flags. KISS TXDELAY and P are honoured; the other
 * parameters are accepted and ignored.
 *
 * USB link events, counted on screen (line 5) to tell why a link stops:
 * "to" writes the host did not take within 50 ms (data dropped, link kept),
 * "ov" receive ring lapped (host data lost), "re" the host enumerated the
 * radio again (a USB reset: RF on the cable, or the cable replugged).
 *
 * Keys: 1 speaker on/off (saved) · 2 send a test frame to the host over USB
 * (checks the link without RF) · 3 RX only: frames from the host are dropped,
 * never transmitted (not saved) · EXIT quit.
 */

#include <stdint.h>
#include <stdbool.h>
#include <stddef.h>
#include "../app_api.h"
#include "kisstnc_assets.h"     /* generated by gen_assets.py */

/* ---- MCU registers (PY32F071, core and SysTick at 48 MHz, 10 ms period), as
 * APRS RX. The host build (test/) maps them to plain variables. ---- */
#ifndef HOST_TEST
static inline volatile uint32_t *hw(uint32_t a){
    volatile uint32_t *p=(volatile uint32_t *)a;
    __asm__("" : "+l"(p));
    return p;
}
#define SYST_LOAD   (*(volatile uint32_t *)0xE000E014u)
#define SYST_VAL    (*(volatile uint32_t *)0xE000E018u)
#define ADC_SR      (hw(0x40012400u)[0x00/4])
#define ADC_CR2     (hw(0x40012400u)[0x08/4])
#define ADC_SMPR3   (hw(0x40012400u)[0x14/4])
#define ADC_SQR3    (hw(0x40012400u)[0x38/4])
#define ADC_DR      (hw(0x40012400u)[0x50/4])
#define GPIOA_MODER (*(volatile uint32_t *)0x50000000u)
#define DAC_CR      (hw(0x40007400u)[0x00/4])
#define DAC_SWTRIGR (hw(0x40007400u)[0x04/4])
#define DAC_DHR12R1 (hw(0x40007400u)[0x08/4])
#define RCC_APBENR1 (*(volatile uint32_t *)0x4002103Cu)
/* Interrupts masked while the bits play: nothing may delay a tone switch (a USB
 * interrupt storm when RF reaches the cable, the 10 ms tick). The bit loop needs
 * none: SysTick is read as a counter and the BK4829 writes poll it too. */
#define IRQ_OFF()   __asm__ volatile("cpsid i" ::: "memory")
#define IRQ_ON()    __asm__ volatile("cpsie i" ::: "memory")
#else
#include "host_hw.h"
#define IRQ_OFF()
#define IRQ_ON()
#endif
#define RCC_DACEN   (1u << 29)
#define DAC_CR_BIAS ((1u << 0) | (1u << 1) | (1u << 2) | (7u << 3))
#define BIAS_CODE   2048u
#define ADC_SR_EOC     (1u << 1)
#define ADC_CR2_START  ((1u << 22) | (1u << 20))   /* SWSTART | EXTTRIG */
#define SMP8_POS       24u
#define SMP4_POS       12u
#define ADC_CH_PA4     4u
#define FS             9600u
#define CYC_PER_SAMPLE (48000000u / FS)            /* 5000 */
#define CYC_PER_BIT    (48000000u / 1200u)         /* 40000: exact */
#define HOUSE_EVERY    480u    /* samples between housekeeping slots (50 ms)      */
#define SERIAL_EVERY   96u     /* samples between USB reads (10 ms)               */
#define BUSY_MAX       60u     /* serve housekeeping anyway after 3 s busy        */
#define DRAW_SLOTS     20u     /* redraw every second                             */
#define DUP_MS         1000u   /* the same frame from another slicer              */

/* ---- demodulator (APRS RX, test/model_rx.py class Demod) ---- */
#define BP_B0       5356
#define BP_A1     (-10714)
#define BP_A2       5673
#define AGC_ATT     5
#define AGC_DEC     10
#define PK_MIN      16
#define PLL_STEP    8192
#define PLL_CTR     36864
#define PLL_SHIFT   2
#define NSL         3
#define PRE_BITS    24u

/* ---- AX.25 / KISS ---- */
#define FRAME_MAX   330u   /* 10 addresses + control + PID + 256 info + FCS */
#define FRAME_MIN   18u
#define FCS_GOOD    0xF0B8u
#define RXQ         2u     /* received frames waiting for the next slot */
#define FEND        0xC0u
#define FESC        0xDBu
#define TFEND       0xDCu
#define TFESC       0xDDu
#define K_DATA      0u
#define K_TXDELAY   1u
#define K_P         2u

/* ---- modulator (APRS TX) ---- */
#define REG_51      0x51   /* sub-audio: 0 = no CTCSS/DCS               */
#define REG_70      0x70   /* tone 1: <15> enable, <14:8> gain           */
#define REG_71      0x71   /* tone 1 frequency, Hz x 10.32444            */
#define F_MARK      12389u /* 1200 Hz */
#define F_SPACE     22714u /* 2200 Hz */
#define LVL_DEF     66u    /* BK4819_TransmitTone's tone gain (APRS TX default) */
#define TXDELAY_DEF 40u    /* flags before the frame: 267 ms (APRS TX)   */
#define TAIL_FLAGS  3u
#define P_DEF       63u    /* KISS default persistence: 1 chance in 4 per slot */

typedef struct { uint16_t len; uint8_t buf[FRAME_MAX]; } frame_t;

typedef struct {
    int32_t  dc;
    int32_t  x1, x2, y1, y2;
    int32_t  im, qm, is, qs;
    int32_t  pm, ps;
    uint32_t r, ks;
    int16_t  ring[8][4];
    int8_t   cm[8], cs[48];
} dem_t;
_Static_assert(COS2200==COS1200+COS1200_LEN && offsetof(dem_t,cm)==DEMOD_INIT_LEN &&
               COS1200==DEMOD_INIT+DEMOD_INIT_LEN &&
               sizeof(dem_t)==DEMOD_INIT_LEN+COS1200_LEN+COS2200_LEN,
               "demodulator initialization asset must match dem_t");

typedef struct {
    int32_t  dprev, phase;
    uint16_t n, crc;
    uint8_t  wa, wb, last;
    uint8_t  sr, ones, byte, nb;
    uint8_t  inframe, hdr;
    uint8_t  bits;
    bool     pre;
    uint8_t  buf[FRAME_MAX];
} sl_t;

/* All the state in one struct, bytes first (Thumb immediate ranges). The
 * loader zeroes the overlay at every launch. */
static struct {
    uint8_t  prevKey, spk, rxn, txFlags, persist;
    uint8_t  slot;                     /* housekeeping slots since the last redraw */
    uint8_t  space, ones;              /* modulator: tone, 1 run (bit stuffing)   */
    bool     quit, host, txReady, kIn, kEsc, redraw, sending, rxOnly;
    uint16_t kLen, nRx, nTx, nLost;
    uint16_t nTo, nOv, nRe;            /* USB link events (serial_ctl)            */
    int16_t  rssi;
    uint16_t dupLen;                   /* the last frame accepted: length, FCS, time */
    uint8_t  dupF0, dupF1;
    const app_api_t *A;
    frame_t *rxq;                      /* RXQ frames (app_main's stack)           */
    uint8_t *tx;                       /* the frame from the host (app_main's stack) */
    uint32_t tPrev, tCyc, next;
    uint32_t tDup;
    uint32_t savedSqr3, savedSmpr3;
    char     call[10];                 /* the last source heard                   */
} g;

/* ---- freestanding helpers: GCC may turn loops into these calls (the host
 * build uses its C library's) ---- */
#ifndef HOST_TEST
void *memset(void *d, int c, size_t n) {
    uint8_t *p = d; while (n) p[--n] = (uint8_t)c; return d;
}
void *memcpy(void *d, const void *s, size_t n) {
    uint8_t *p = d; const uint8_t *q = s;
    while (n) { --n; p[n] = q[n]; } return d;
}
#endif

/* ---- formatting, no division ---- */
__attribute__((noinline))
static char *put(char *o,const char *s){ while(*s)*o++=*s++; return o; }
static unsigned sub(uint32_t *v,uint32_t d){ unsigned q=0; while(*v>=d){ *v-=d; q++; } return q; }
static char *putu(char *o,uint32_t u){
    uint32_t p10[PLACE_LEN/4u];               /* 10^8 .. 1, from the assets */
    g.A->asset_read(PLACE,p10,sizeof p10);
    bool lead=false;
    for(unsigned i=0;i<PLACE_LEN/4u;i++){
        unsigned c=sub(&u,p10[i]);
        if(c||lead||i==PLACE_LEN/4u-1u){ *o++=(char)('0'+c); lead=true; }
    }
    return o;
}
/* AX.25 address -> "N0CALL-7" */
static char *putCall(char *o,const uint8_t *a){
    for(uint8_t i=0;i<6u;i++){ char c=(char)(a[i]>>1); if(c!=' ') *o++=c; }
    uint8_t ssid=(uint8_t)((a[6]>>1)&15u);
    if(ssid){ *o++='-'; o=putu(o,ssid); }
    return o;
}
static char *T(char *buf,uint16_t off){ g.A->asset_read(off,buf,TEXT_MAX); return buf; }

/* ---- SysTick cycle counter (call at least every 10 ms) ---- */
static void clkStart(void){ g.tPrev=SYST_VAL; g.tCyc=0; }
static uint32_t clkCyc(void){
    uint32_t v=SYST_VAL;
    g.tCyc += (v<=g.tPrev) ? g.tPrev-v : g.tPrev+(SYST_LOAD+1u-v);
    g.tPrev=v;
    return g.tCyc;
}
static void waitCyc(uint32_t t){ while((int32_t)(clkCyc()-t)<0){} }

/* ---- PA4 bias and ADC (APRS RX) ---- */
static void biasOn(uint32_t moder,uint32_t rcc){
    GPIOA_MODER=moder|(3u<<8);
    RCC_APBENR1=rcc|RCC_DACEN;
    DAC_CR=DAC_CR_BIAS;
    DAC_DHR12R1=BIAS_CODE;
    DAC_SWTRIGR=1u;
}
static void adcSelPA4(void){
    ADC_SMPR3=(g.savedSmpr3&~(7u<<SMP4_POS))|(((g.savedSmpr3>>SMP8_POS)&7u)<<SMP4_POS);
    ADC_SQR3=(g.savedSqr3&~0x1Fu)|ADC_CH_PA4;
}
static void adcRestore(void){ ADC_SQR3=g.savedSqr3; ADC_SMPR3=g.savedSmpr3; }
static uint16_t adcRead(void){
    ADC_CR2|=ADC_CR2_START;
    for(uint16_t n=0; !(ADC_SR&ADC_SR_EOC) && n<2000u; n++){}
    return (uint16_t)(ADC_DR&0x0FFFu);
}

/* ---- USB link state: host present, and the events since the last call ---- */
static void usbState(void){
    uint8_t st=g.A->serial_ctl(APP_SERIAL_USB,0);
    g.host=(st&APP_SERIAL_HOST)!=0;
    if(st&APP_SERIAL_TIMEOUT) g.nTo++;
    if(st&APP_SERIAL_LOST)    g.nOv++;
    if(st&APP_SERIAL_ENUM)    g.nRe++;
    if(st&(APP_SERIAL_TIMEOUT|APP_SERIAL_LOST|APP_SERIAL_ENUM)) g.redraw=true;
}

/* ---- KISS out: one data frame, escaped, in 64-byte USB writes. A write the
 * host does not take ends the frame there: the next one starts with FEND, so
 * the host drops the cut frame and resyncs. ---- */
static void kissSend(const uint8_t *f,uint16_t n){
    const app_api_t *A=g.A;
    uint8_t out[64];
    uint8_t k=0;
    out[k++]=FEND; out[k++]=K_DATA;
    for(uint16_t i=0;i<=n;i++){
        if(k>=sizeof(out)-2u){
            if(!A->serial_write(APP_SERIAL_USB,out,k)){ usbState(); return; }
            k=0;
        }
        if(i==n){ out[k++]=FEND; break; }
        uint8_t b=f[i];
        if(b==FEND){ out[k++]=FESC; b=TFEND; }
        else if(b==FESC){ out[k++]=FESC; b=TFESC; }
        out[k++]=b;
    }
    if(!A->serial_write(APP_SERIAL_USB,out,k)) usbState();
}

/* ---- KISS in: bytes from the host into g.tx (command byte first); a data
 * frame sets txReady, and what follows is dropped until it is sent ---- */
static void kissByte(uint8_t b){
    if(b==FEND){
        if(g.kIn && g.kLen>1u){
            uint8_t cmd=(uint8_t)(g.tx[0]&0x0Fu), v=g.tx[1];
            if(cmd==K_DATA){ if(g.kLen>=16u){ g.txReady=true; g.redraw=true; } }
            else if(cmd==K_TXDELAY){ uint32_t f=v+(v>>1u); g.txFlags=(uint8_t)(f<8u?8u:f>255u?255u:f); }
            else if(cmd==K_P) g.persist=v;
        }
        g.kIn=!g.txReady; g.kEsc=false;
        if(!g.txReady) g.kLen=0;
        return;
    }
    if(!g.kIn) return;
    if(g.kEsc){
        g.kEsc=false;
        if(b==TFEND) b=FEND;
        else if(b==TFESC) b=FESC;
        else { g.kIn=false; return; }
    } else if(b==FESC){ g.kEsc=true; return; }
    if(g.kLen>=FRAME_MAX-2u){ g.kIn=false; return; }   /* room for the FCS */
    g.tx[g.kLen++]=b;
}
static void kissPoll(void){
    uint8_t buf[16];
    uint16_t n=g.A->serial_read(APP_SERIAL_USB,buf,sizeof buf);
    for(uint16_t i=0;i<n;i++) kissByte(buf[i]);
}

/* CRC-16/X.25 (the AX.25 FCS), one byte: shared by the receiver and the sender. */
__attribute__((noinline))
static uint16_t crcByte(uint16_t c,uint8_t v){
    c^=v;
    for(uint8_t i=0;i<8u;i++) c=(c&1u)?(uint16_t)((c>>1)^0x8408u):(uint16_t)(c>>1);
    return c;
}

/* ---- modulator (APRS TX): NRZI, a 0 changes the tone, from the next bit edge ---- */
static void setTone(void){
    const app_api_t *A=g.A;
    A->bk_write(REG_71,(uint16_t)(g.space?F_SPACE:F_MARK));
    A->bk_write(REG_70,(uint16_t)(0x8000u|(LVL_DEF<<8)));
}
static void sendBit(uint8_t b){
    waitCyc(g.next);
    if(!b){ g.space^=1u; setTone(); }
    g.next+=CYC_PER_BIT;
}
__attribute__((noinline))
static void sendByte(uint8_t v,bool stuff){
    for(uint8_t i=0;i<8u;i++){
        uint8_t b=(uint8_t)(v&1u);
        v>>=1;
        sendBit(b);
        if(stuff){
            if(!b) g.ones=0;
            else if(++g.ones==5u){ sendBit(0); g.ones=0; }
        }
    }
}
static uint16_t crc16(const uint8_t *f,uint16_t n){
    uint16_t c=0xFFFFu;
    for(uint16_t i=0;i<n;i++) c=crcByte(c,f[i]);
    return (uint16_t)~c;
}

static void draw(void);

/* The host's frame on the air, then back to RX. */
static void transmit(void){
    const app_api_t *A=g.A;
    uint8_t *f=g.tx+1;                        /* after the KISS command byte */
    uint16_t n=(uint16_t)(g.kLen-1u);
    g.txReady=false; g.kIn=false; g.kLen=0;
    if(g.rxOnly || A->tx_state()){ g.nLost++; g.redraw=true; return; }   /* RX only, or TX not allowed on this VFO */
    uint16_t c=crc16(f,n);
    f[n]=(uint8_t)c; f[n+1u]=(uint8_t)(c>>8);
    g.sending=true;
    draw();
    A->tx_set_params();
    A->bk_write(REG_51,0);                    /* no CTCSS/DCS under the AFSK */
    A->tx_tone(1200);
    g.space=0;
    setTone();
    IRQ_OFF();
    clkStart();
    g.next=CYC_PER_BIT;
    for(uint8_t i=0;i<g.txFlags;i++) sendByte(0x7E,false);
    g.ones=0;
    for(uint16_t i=0;i<n+2u;i++) sendByte(f[i],true);
    for(uint8_t i=0;i<TAIL_FLAGS;i++) sendByte(0x7E,false);
    waitCyc(g.next);
    IRQ_ON();
    A->tx_mute(true);
    A->tx_end();
    A->set_af(APP_AF_FM);                     /* back to listening */
    A->audio_path(g.spk);
    g.sending=false;
    g.nTx++;
    g.redraw=true;
}

/* ---- demodulator (APRS RX) ---- */
static bool callChar(uint8_t c){ return (c>='A'&&c<='Z')||(c>='0'&&c<='9')||c==' '; }

/* A good frame from a slicer, queued for the host unless another slicer just
 * gave it. The FCS is checked, then stripped. */
static void accept(const sl_t *m){
    const app_api_t *A=g.A;
    uint16_t n=m->n;
    uint32_t t=A->ticks_ms();
    if(!(n==g.dupLen && m->buf[n-1]==g.dupF1 && m->buf[n-2]==g.dupF0 && t-g.tDup<DUP_MS)){
        if(g.rxn<RXQ){
            frame_t *f=&g.rxq[g.rxn++];
            memcpy(f->buf,m->buf,n-2u);
            f->len=(uint16_t)(n-2u);
            g.rssi=A->rssi_dbm();
        } else g.nLost++;
        g.dupLen=n; g.dupF0=m->buf[n-2]; g.dupF1=m->buf[n-1];
    }
    g.tDup=t;
}

/* HDLC: one bit after NRZI. A TNC passes every AX.25 frame with a good FCS
 * whose address field ends (no APRS-only UI check). */
__attribute__((noinline))
static void hdlcBit(sl_t *m,uint8_t b){
    if(m->bits<255u) m->bits++;
    m->sr=(uint8_t)((m->sr>>1)|(b<<7));
    if(m->sr==0x7Eu){
        bool ok = m->inframe && m->n>=FRAME_MIN && m->crc==FCS_GOOD;
        if(ok){
            uint16_t e=13;
            while(!(m->buf[e]&1u) && e+7u<m->n-2u) e+=7;
            ok=(m->buf[e]&1u) && e+1u<m->n-2u;
        }
        m->pre = m->bits==8u;
        m->bits=0;
        if(ok) accept(m);
        m->inframe=1; m->hdr=1; m->n=0; m->crc=0xFFFFu;
        m->ones=m->byte=m->nb=0;
        return;
    }
    if(b){
        if(++m->ones>6u){ m->ones=7; m->inframe=0; return; }
    } else {
        if(m->ones==5u){ m->ones=0; return; }
        m->ones=0;
    }
    if(!m->inframe) return;
    m->byte|=(uint8_t)(b<<m->nb);
    if(++m->nb==8u){
        if(m->n<FRAME_MAX){
            m->crc=crcByte(m->crc,m->byte);
            if(m->n<6u && ((m->byte&1u) || !callChar((uint8_t)(m->byte>>1)))) m->hdr=0;
            m->buf[m->n++]=m->byte;
        } else m->inframe=0;
        m->byte=m->nb=0;
    }
}

__attribute__((noinline))
static bool busy(const sl_t *m){
    return (m->pre && m->bits<PRE_BITS) || (m->inframe && m->n && m->hdr);
}

static int32_t mag(int32_t i,int32_t q){
    if(i<0) i=-i;
    if(q<0) q=-q;
    if(i<q){ int32_t t=i; i=q; q=t; }
    return i+(q>>2)+(q>>3);
}
__attribute__((noinline))
static int32_t tone(int32_t i,int32_t q,int32_t *pk){
    int32_t mt=mag(i,q), p=*pk;
    p+= mt>p ? (mt-p)>>AGC_ATT : -(p>>AGC_DEC);
    if(p<PK_MIN) p=PK_MIN;
    *pk=p;
    return mt;
}
static void front(dem_t *m,int32_t adc,int32_t *a,int32_t *b){
    m->dc+=((adc<<4)-m->dc)>>6;
    int32_t x=adc-(m->dc>>4);
    int32_t y=(BP_B0*(x-m->x2)-BP_A1*m->y1-BP_A2*m->y2)>>14;
    m->x2=m->x1; m->x1=x; m->y2=m->y1; m->y1=y;
    int16_t *o=m->ring[m->r];
    uint32_t k=m->ks+12u; if(k>=48u) k-=48u;
    int32_t p;
    p=(y*m->cm[m->r])>>8;               m->im+=p-o[0]; o[0]=(int16_t)p;
    p=(y*m->cm[(m->r+6u)&7u])>>8;       m->qm+=p-o[1]; o[1]=(int16_t)p;
    p=(y*m->cs[m->ks])>>8;              m->is+=p-o[2]; o[2]=(int16_t)p;
    p=(y*m->cs[k])>>8;                  m->qs+=p-o[3]; o[3]=(int16_t)p;
    m->r=(m->r+1u)&7u;
    if(++m->ks>=48u) m->ks=0;
    int32_t mm=tone(m->im,m->qm,&m->pm), ms=tone(m->is,m->qs,&m->ps);
    *a=mm*m->ps;
    *b=ms*m->pm;
}
static void slice(sl_t *m,int32_t a,int32_t b){
    int32_t d=a*m->wa-b*m->wb;
    m->phase+=PLL_STEP;
    if((d>0)!=(m->dprev>0)) m->phase+=(PLL_CTR-m->phase)>>PLL_SHIFT;
    m->dprev=d;
    if(m->phase>=65536){
        m->phase-=65536;
        uint8_t lv=d>0;
        hdlcBit(m,lv==m->last);
        m->last=lv;
    }
}

/* ---- screen ---- */
__attribute__((noinline))
static void draw(void){
    const app_api_t *A=g.A;
    char s[24], t[TEXT_MAX], *o;
    A->display_clear();
    A->status_clear();
    A->print_inverse(T(t,T_TITLE),2,0,true,true,34);
    /* one capsule: TX, RX ONLY, USB or NO USB, 4 px per character */
    { uint8_t k=g.sending?0u:g.rxOnly?1u:g.host?2u:3u, w=0;
      T(t,(uint16_t)(T_CAPS+k*T_CAPS_STRIDE));
      while(t[w]) w++;
      A->print_inverse(t,40,0,true,true,(uint8_t)(40u+4u*w)); }
    A->draw_battery();

    o=putu(put(s,T(t,T_RX)),g.nRx);
    *putu(put(o,T(t,T_TXN)),g.nTx)='\0';
    A->print_normal(s,0,0,0);
    if(g.call[0]){                            /* "N0CALL-9 -89dBm" */
        o=put(s,g.call); *o++=' ';
        if(g.rssi<0){ *o++='-'; o=putu(o,(uint32_t)-g.rssi); } else o=putu(o,(uint32_t)g.rssi);
        *put(o,T(t,T_DBM))='\0';
        A->print_normal(s,0,0,2);
    }
    if(g.nLost){ *putu(put(s,T(t,T_DROP)),g.nLost)='\0'; A->print_normal(s,0,0,3); }
    if(g.nTo|g.nOv|g.nRe){                    /* "to 0 ov 0 re 1" */
        o=putu(put(s,T(t,T_TO)),g.nTo);
        o=putu(put(o,T(t,T_OV)),g.nOv);
        *putu(put(o,T(t,T_RE)),g.nRe)='\0';
        A->print_normal(s,0,0,5);
    }
    /* the RX frequency (10 Hz units) as MHz with 3 decimals (f >= 1 MHz) */
    { char *e=putu(s,A->rx_freq())-2;
      e[1]='\0';
      for(uint8_t k=0;k<3u;k++,e--) e[0]=e[-1];
      e[0]='.'; }
    A->print_normal(s,0,0,4);
    A->print_normal(T(t,T_KEYS),0,0,6);
    A->blit_status();
    A->blit_full();
}

/* ---- a test frame to the host (key 2): checks the USB link without RF.
 * The frame is in the assets (APZK1, a blank source, UI, the info field);
 * only the boot-message callsign is written into the source address. ---- */
static void sendTest(void){
    uint8_t f[TESTF_LEN];
    char call[8];
    g.A->asset_read(TESTF,f,TESTF_LEN);
    g.A->boot_callsign(call,sizeof call);
    if(call[0]){                              /* else NOCALL stays */
        uint8_t i=0;
        for(;i<6u && call[i];i++) f[7+i]=(uint8_t)(call[i]<<1);
        for(;i<6u;i++) f[7+i]=' '<<1;
    }
    kissSend(f,TESTF_LEN);
}

/* ---- housekeeping, between frames: keys, frames to the host, TX, screen ---- */
static void house(bool bz){
    const app_api_t *A=g.A;
    uint8_t key=A->get_key();
    if(key!=APP_KEY_INVALID && key!=g.prevKey){
        g.redraw=true;
        A->backlight_on();
        if(key==APP_KEY_EXIT) g.quit=true;
        else if(key==APP_KEY_1){ g.spk^=1u; A->audio_path(g.spk); }
        else if(key==APP_KEY_2) sendTest();
        else if(key==APP_KEY_3) g.rxOnly=!g.rxOnly;
    }
    g.prevKey=key;
    if(g.quit) return;

    for(uint8_t k=0;k<g.rxn;k++){
        frame_t *f=&g.rxq[k];
        kissSend(f->buf,f->len);
        *putCall(g.call,f->buf+7)='\0';
        g.nRx++;
        g.redraw=true;
    }
    g.rxn=0;

    /* p-persistence on a clear channel, one try per slot */
    if(g.txReady && !bz && (A->rand32()&255u)<=g.persist) transmit();

    A->backlight_update();
    if(++g.slot>=DRAW_SLOTS){ g.slot=0; g.redraw=true; usbState(); }
    if(!g.redraw) return;
    g.redraw=false;
    adcRestore();                /* the battery is on ADC channel 8 */
    A->battery_sample();
    adcSelPA4();
    draw();
}

/* ---- the receiver: PA4 at 9.6 kHz until EXIT ---- */
__attribute__((noinline))
static void listen(void){
    const app_api_t *A=g.A;
    dem_t d;
    sl_t sl[NSL];
    memset(sl,0,sizeof sl);
    A->asset_read(DEMOD_INIT,&d,sizeof d);
    sl[0].wa=2; sl[0].wb=3;
    sl[1].wa=1; sl[1].wb=1;
    sl[2].wa=3; sl[2].wb=2;

    adcSelPA4();
    clkStart();
    uint32_t next=0;
    uint16_t cnt=0;
    uint8_t busyFor=0, ser=0;
    g.redraw=true;
    while(!g.quit){
        waitCyc(next);
        next+=CYC_PER_SAMPLE;
        int32_t a,b;
        front(&d,adcRead(),&a,&b);
        for(uint8_t k=0;k<NSL;k++) slice(&sl[k],a,b);
        if(++ser>=SERIAL_EVERY){ ser=0; kissPoll(); }
        if(++cnt<HOUSE_EVERY) continue;
        cnt=0;
        bool bz=false;
        for(uint8_t k=0;k<NSL;k++) bz|=busy(&sl[k]);
        if(bz && ++busyFor<BUSY_MAX) continue;
        busyFor=0;
        house(bz);
        next=clkCyc();                  /* skip the samples the slot took */
    }
    adcRestore();
}

__attribute__((section(".text.entry"),used))
void app_main(const app_api_t *api){
    frame_t rxq[RXQ];           /* on the stack: the 4 KiB overlay also holds .bss */
    uint8_t tx[FRAME_MAX];
    g.A=api; g.rxq=rxq; g.tx=tx;
    g.txFlags=TXDELAY_DEF; g.persist=P_DEF;
    g.prevKey=APP_KEY_INVALID;
    g.kIn=true;                 /* a first frame without its leading FEND still parses */

    g.savedSqr3=ADC_SQR3; g.savedSmpr3=ADC_SMPR3;
    const uint32_t savedModer=GPIOA_MODER, savedDac=DAC_CR;
    const uint32_t savedRcc=RCC_APBENR1, savedDhr=DAC_DHR12R1;
    biasOn(savedModer,savedRcc);
    api->backlight_on();
    api->cfg_load(&g.spk,1);
    g.spk=(uint8_t)(g.spk==1u);
    api->audio_path(g.spk);
    api->set_af(APP_AF_FM);
    api->delay_ms(50);
    usbState();
    g.nTo=g.nOv=g.nRe=0;        /* count from launch, not the first claim */

    listen();

    DAC_CR=savedDac; DAC_DHR12R1=savedDhr; RCC_APBENR1=savedRcc; GPIOA_MODER=savedModer;
    api->set_af(APP_AF_MUTE);
    api->audio_path(false);
    api->cfg_save(&g.spk,1);
}

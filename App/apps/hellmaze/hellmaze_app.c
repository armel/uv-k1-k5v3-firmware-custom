/* Copyright 2026 Johan F4WAT
 *
 * Licensed under the Apache License, Version 2.0 (the "License");
 * you may not use this file except in compliance with the License.
 * You may obtain a copy of the License at
 *
 *     http://www.apache.org/licenses/LICENSE-2.0
 *
 * Unless required by applicable law or agreed to in writing, software
 * distributed under the License is distributed on an "AS IS" BASIS,
 * WITHOUT WARRANTIES OR CONDITIONS OF ANY KIND, either express or implied.
 * See the License for the specific language governing permissions and
 * limitations under the License.
 */

/*
 * Hell Maze - first-person maze shooter on the 1-bit 128x64 LCD.
 *
 * A grid raycaster: one ray per screen column walks the 16x16 tile map with a DDA in Q8 tile units, and the perpendicular
 * distance gives the wall height. Everything is integer: Q14 direction
 * vectors from a sine quadrant read from the assets (twice a frame), and the few divisions per ray go through the
 * resident divider helpers. Walls are textured per type (brick, stone,
 * pillar) from the hit position along the wall and the row inside it, then
 * dithered with a 4x4 Bayer matrix by distance, the E/W faces one step darker
 * than the N/S faces; the floor gets sparse dots that thicken towards the
 * player. The view uses the 56 framebuffer rows, the status line the HUD.
 *
 * Demons (0.2) are 16x16 sprites with a mask, scaled by distance, drawn far
 * to near and hidden column by column behind walls through a depth buffer
 * filled by the raycaster. A demon that sees the player (a ray-march through
 * the map) walks to him and claws when close; it dies after two shots. The
 * shot hits the nearest live demon across the centre column, in front of the
 * wall there. PTT fires (read on its pin, so it works while a move key is
 * held), as does key 5. All demons dead clears the maze; no health left ends
 * the game; key 5 then starts again.
 *
 * Sound (0.3): the BK4829 tone generator is set up once on entry and the
 * speaker amplifier stays on, so each effect (shot, empty click, death growl,
 * claw, end of game) only writes a frequency and unmutes; a sweep is followed
 * once a frame and muted at its end, without blocking the game.
 *
 * Movement is scaled by the measured frame time (48 MHz cycle counter), so
 * the speed does not depend on the frame rate. Walls are solid with a quarter
 * tile margin, each axis checked apart so the player slides along them.
 *
 * Credits: the raycasting method (camera plane, DDA, perpendicular wall
 * distance, sprite transform) follows Lode Vandevenne's raycasting tutorial,
 * https://lodev.org/cgtutor/raycasting.html, reimplemented here in fixed
 * point; no code was copied from it. The dither is the classic 4x4 Bayer
 * ordered-dither matrix. The sine quadrant with symmetry is the scheme of
 * Armel F4HWN's Cube3D app. The tone register values (REG_50 mute and
 * unmute words, the REG_71 Hz scale) come from App/driver/bk4829.c
 * (BK4819_EnterTxMute / ExitTxMute, scale_freq; Dual Tachyon, muzkr). The
 * help page capsules follow CW Keyer's layout. The maze, sprites and gun are
 * original drawings: no id Software code or assets are used.
 *
 * Keys: 2 / 8 forward / back, 4 / 6 turn left / right, 1 / 3 strafe left /
 * right, PTT or 5 fire, MENU key list (the game pauses while it is shown),
 * EXIT quit.
 */

#include <stdint.h>
#include <stdbool.h>
#include "../app_api.h"
#include "hellmaze_assets.h"   /* generated by gen_assets.py */

#ifndef APP_VERSION
#define APP_VERSION "dev"
#endif

#define GPIOB_IDR (*(const volatile uint32_t *)0x50000410u)
#define PTT_PIN   10u        /* PB10, low while pressed */

#define W        128
#define VIEW_H   56          /* framebuffer rows under the status line     */
#define HORIZON  28
#define LH_K     96          /* wall height in px at one tile: (W/2)/0.66 */
#define ANG_Q    (ANG_FULL / 4u)
#define ANG_MASK (ANG_FULL * 16u - 1u)   /* heading kept in Q4 steps      */
#define MAX_STEPS 40u
#define DELTA_MAX (1u << 20)
#define MARGIN   64          /* collision margin, Q8 tile units            */
#define MOVE_K   6           /* Q8 per 16 time units: ~2 tiles/s           */
#define FOE_K    3           /* demons walk at half that                   */
#define TURN_K   3           /* Q4 heading steps per time unit: ~190 deg/s */
#define DT_SHIFT 15          /* time unit = 2^15 cycles = 0.68 ms          */
#define DT_MAX   150u
#define SIGHT    (8 * 256)   /* demons notice the player within 8 tiles    */
#define REACH    140         /* claw distance, Q8                          */
#define CLAW_HP  10
#define CLAW_DT  700         /* time units between claws: ~0.5 s           */
#define FOE_HP   2
#define START_HP 100
#define START_AMMO 30
#define SHOT_MS  250u
#define FLASH_MS 100u

#define REG_TX_MUTE 0x50u     /* BK4829: 0xBB18 muted, 0x3B18 tone heard */
#define REG_TONE1   0x71u     /* BK4829 tone 1 frequency, Hz * 10.32     */
#define TONE_MUTE   0xBB18u
#define TONE_ON     0x3B18u

enum { PLAY, DIED, CLEARED };

_Static_assert(FOES == START + 6u, "reset() reads START and FOES in one go");

typedef struct {
    int16_t x, y;            /* Q8 */
    int16_t depth;           /* Q8, along the view, this frame */
    int16_t cool;            /* time units to the next claw */
    int16_t x0, x1;          /* screen columns a shot hits, this frame */
    uint8_t hp;
} foe_t;

static const app_api_t *A;

static struct {
    uint8_t  map[MAP_W * MAP_H / 2u];   /* two tiles per byte */
    uint8_t  zbuf[W / 2];    /* wall distance per column pair, Q4 tiles */
    foe_t    foe[FOE_N];
    uint16_t spr[IMP_ROWS * 2u];
    int16_t  px, py;         /* Q8 tile units */
    int32_t  dx, dy;         /* Q14 heading vector */
    uint32_t now;            /* ms */
    uint32_t shotT, hurtT;
    uint32_t sndT;           /* sound start, ms */
    uint16_t sndMs, sndF0, sndF1;   /* length, start and end Hz (0 = silent) */
    int16_t  hp;
    uint16_t ang;            /* Q4 heading    */
    uint8_t  ammo, kills, state;
    bool     help;           /* MENU: key list shown, game paused */
} g;

static const uint8_t BAYER[16] = {
    0, 8, 2, 10, 12, 4, 14, 6, 3, 11, 1, 9, 15, 7, 13, 5
};

static uint32_t udiv(uint32_t n, uint32_t d)
{
    return (uint32_t)A->uidivmod(n, d);
}

static int32_t sdiv(int32_t n, int32_t d)
{
    return (int32_t)A->idivmod(n, d);
}

static int32_t iabs(int32_t v)
{
    return v < 0 ? -v : v;
}

static int32_t isin(uint16_t a)
{
    a &= ANG_FULL - 1u;
    const uint16_t i = a & (ANG_Q - 1u);
    const uint16_t q = a / ANG_Q;
    int16_t v;
    A->asset_read((uint16_t)(SIN_Q + 2u * ((q & 1u) ? ANG_Q - i : i)), &v, 2u);
    return q >= 2u ? -v : v;
}

static uint8_t tile(int32_t mx, int32_t my)
{
    const uint32_t i = (uint32_t)my * MAP_W + (uint32_t)mx;
    return (uint8_t)((g.map[i >> 1] >> ((i & 1u) << 2)) & 15u);
}

static bool wall(int32_t x, int32_t y)
{
    return tile(x >> 8, y >> 8) != 0u;
}

static void setpix(int16_t x, int16_t y, bool on)
{
    uint8_t *b = &A->fb[y >> 3][x];
    const uint8_t bit = (uint8_t)(1u << (y & 7));
    *b = on ? (uint8_t)(*b | bit) : (uint8_t)(*b & ~bit);
}

/* One screen column: wall rows [top, bot) of the given type (either may lie
 * off screen), texture column u (0..255 along the wall), texture rows by dv
 * (Q8 per pixel), dither level lvl (0..16). The wall's first and last rows
 * are outlined when visible. */
static void column(uint8_t x, int16_t top, int16_t bot, uint8_t type,
                   uint8_t u, uint32_t dv, uint8_t lvl)
{
    const uint8_t *bayer = &BAYER[x & 3u];
    uint32_t v = top < 0 ? (uint32_t)(-top) * dv : 0u;
    for (uint8_t p = 0; p < VIEW_H / 8u; p++) {
        uint8_t byte = 0;
        for (uint8_t b = 0; b < 8u; b++) {
            const int16_t y = (int16_t)(p * 8u + b);
            const uint8_t t = bayer[(y & 3) * 4];
            bool on;
            if (y < top) {
                on = false;
            } else if (y < bot) {
                const uint8_t tv = (uint8_t)(v >> 8);
                v += dv;
                bool mortar;
                if (type == 1u)
                    mortar = (tv & 63u) < 6u || (uint8_t)(u + ((tv & 64u) ? 64u : 0u)) % 128u < 8u;
                else if (type == 2u)
                    mortar = (tv & 127u) < 6u || (uint8_t)(u + ((tv & 128u) ? 128u : 0u)) < 8u;
                else
                    mortar = (u & 63u) < 16u;
                on = y == top || y == bot - 1 || (!mortar && t < lvl);
            } else {
                on = t < (uint8_t)((y - HORIZON) >> 2);
            }
            if (on)
                byte |= (uint8_t)(1u << b);
        }
        A->fb[p][x] = byte;
    }
}

static void render(void)
{
    const int32_t dx = g.dx, dy = g.dy;
    const int32_t plx = -dy * 43 / 64;     /* camera plane, FOV ~66 deg */
    const int32_t ply = dx * 43 / 64;
    for (uint8_t x = 0; x < W; x++) {
        const int32_t cam = ((int32_t)(2 * x + 1) - W) << 7;        /* Q14 */
        const int32_t rx = dx + ((plx * cam) >> 14);
        const int32_t ry = dy + ((ply * cam) >> 14);
        const uint32_t ax = (uint32_t)iabs(rx);
        const uint32_t ay = (uint32_t)iabs(ry);
        const uint32_t ddx = ax ? udiv(1u << 22, ax) : DELTA_MAX;
        const uint32_t ddy = ay ? udiv(1u << 22, ay) : DELTA_MAX;
        const uint32_t deltaX = ddx < DELTA_MAX ? ddx : DELTA_MAX;
        const uint32_t deltaY = ddy < DELTA_MAX ? ddy : DELTA_MAX;
        int32_t mx = g.px >> 8, my = g.py >> 8;
        const uint32_t fx = (uint32_t)g.px & 255u, fy = (uint32_t)g.py & 255u;
        const int32_t sx = rx < 0 ? -1 : 1, sy = ry < 0 ? -1 : 1;
        uint32_t sideX = ((rx < 0 ? fx : 256u - fx) * deltaX) >> 8;
        uint32_t sideY = ((ry < 0 ? fy : 256u - fy) * deltaY) >> 8;
        uint8_t side = 0, type = 1;
        for (uint8_t s = 0; s < MAX_STEPS; s++) {
            if (sideX < sideY) {
                sideX += deltaX;
                mx += sx;
                side = 0;
            } else {
                sideY += deltaY;
                my += sy;
                side = 1;
            }
            type = tile(mx, my);
            if (type)
                break;
        }
        uint32_t perp = side ? sideY - deltaY : sideX - deltaX;
        if (perp < 16u)
            perp = 16u;

        const uint32_t lh = udiv((uint32_t)LH_K << 8, perp);
        const int16_t top = (int16_t)(HORIZON - (int32_t)(lh >> 1));
        const int16_t bot = (int16_t)(HORIZON + (int32_t)(lh >> 1));
        const uint8_t u = (uint8_t)(side
            ? g.px + (((int32_t)perp * rx) >> 14)
            : g.py + (((int32_t)perp * ry) >> 14));
        const uint32_t dv = lh ? udiv(256u << 8, lh) : 0u;
        int32_t lvl = 16 - (int32_t)(perp >> 6) - (side ? 4 : 0);
        if (lvl < 2)
            lvl = 2;
        column(x, top, bot, type, u, dv, (uint8_t)lvl);
        g.zbuf[x >> 1] = (uint8_t)(perp >> 4 > 255u ? 255u : perp >> 4);
    }
}

/* Start a tone sweeping from f0 to f1 Hz over ms; it replaces any sound
 * still playing. The tone generator was set up on entry, so this only writes
 * the frequency and unmutes: nothing blocks. */
static void sound(uint16_t f0, uint16_t f1, uint16_t ms)
{
    g.sndT = g.now;
    g.sndMs = ms;
    g.sndF0 = f0;
    g.sndF1 = f1;
    A->bk_write(REG_TX_MUTE, TONE_ON);
}

/* Once a frame: follow the sweep, mute at its end. */
static void soundUpdate(void)
{
    if (!g.sndMs)
        return;
    const uint32_t t = g.now - g.sndT;
    if (t >= g.sndMs) {
        g.sndMs = 0;
        A->bk_write(REG_TX_MUTE, TONE_MUTE);
        return;
    }
    const int32_t f = g.sndF0 + sdiv(((int32_t)g.sndF1 - g.sndF0) * (int32_t)t, g.sndMs);
    A->bk_write(REG_TONE1, (uint16_t)((f * 661) >> 6));
}

/* Move a body at (*x, *y) by (mx, my) Q8, each axis on its own so walls are
 * slid along. */
static void slide(int16_t *x, int16_t *y, int32_t mx, int32_t my)
{
    const int32_t nx = *x + mx;
    const int32_t ex = nx + (mx < 0 ? -MARGIN : MARGIN);
    if (!wall(ex, *y - MARGIN) && !wall(ex, *y + MARGIN))
        *x = (int16_t)nx;
    const int32_t ny = *y + my;
    const int32_t ey = ny + (my < 0 ? -MARGIN : MARGIN);
    if (!wall(*x - MARGIN, ey) && !wall(*x + MARGIN, ey))
        *y = (int16_t)ny;
}

/* Clear line of sight from (x, y) to the player, sampled 16 times. */
static bool sees(int32_t x, int32_t y)
{
    const int32_t sx = (g.px - x) >> 4, sy = (g.py - y) >> 4;
    for (uint8_t i = 1; i < 16u; i++) {
        x += sx;
        y += sy;
        if (wall(x, y))
            return false;
    }
    return true;
}

static void foesThink(uint32_t dt)
{
    for (uint8_t i = 0; i < FOE_N; i++) {
        foe_t *f = &g.foe[i];
        if (!f->hp)
            continue;
        if (f->cool > 0)
            f->cool = (int16_t)(f->cool - (int16_t)dt);
        const int32_t rx = g.px - f->x, ry = g.py - f->y;
        const int32_t ax = iabs(rx), ay = iabs(ry);
        const int32_t dist = (ax > ay ? ax + (ay >> 1) : ay + (ax >> 1));
        if (dist > SIGHT || !sees(f->x, f->y))
            continue;
        if (dist > REACH) {
            const int32_t step = (int32_t)dt * FOE_K;
            slide(&f->x, &f->y, sdiv(rx * step, dist << 4), sdiv(ry * step, dist << 4));
        } else if (f->cool <= 0) {
            f->cool = CLAW_DT;
            g.hp = (int16_t)(g.hp - CLAW_HP);
            g.hurtT = g.now;
            sound(150u, 220u, 90u);
        }
    }
}

/* Demons far to near, each column clipped by the wall depth buffer. */
static void drawFoes(void)
{
    uint8_t order[FOE_N];
    for (uint8_t i = 0; i < FOE_N; i++) {
        foe_t *f = &g.foe[i];
        const int32_t rx = f->x - g.px, ry = f->y - g.py;
        f->depth = (int16_t)((g.dx * rx + g.dy * ry) >> 14);
        f->x1 = -1;
        uint8_t j = i;
        while (j && g.foe[order[j - 1u]].depth < f->depth) {
            order[j] = order[j - 1u];
            j--;
        }
        order[j] = i;
    }
    for (uint8_t n = 0; n < FOE_N; n++) {
        foe_t *f = &g.foe[order[n]];
        if (f->depth < 24)
            continue;
        const int32_t lat = (g.dx * (f->y - g.py) - g.dy * (f->x - g.px)) >> 14;
        const int32_t cx = W / 2 + sdiv(lat * 95, f->depth);
        const int32_t lh = (int32_t)udiv((uint32_t)LH_K << 8, (uint32_t)f->depth);
        int32_t s = (lh * 5) >> 3;
        if (s < 2 || cx < -60 || cx > W + 60)
            continue;
        if (s > 120)
            s = 120;
        const int32_t bot = HORIZON + (lh >> 1), top = bot - s, x0 = cx - (s >> 1);
        const uint8_t frame = f->hp ? (uint8_t)(((g.now >> 8) + order[n]) & 1u) : 2u;
        A->asset_read((uint16_t)(SPR_IMP + frame * IMP_ROWS * 4u), g.spr, sizeof(g.spr));
        const uint32_t step = udiv(16u << 8, (uint32_t)s);
        const uint8_t d8 = (uint8_t)(f->depth >> 4 > 255 ? 255 : f->depth >> 4);
        if (f->hp) {
            f->x0 = (int16_t)(x0 + (s >> 2));
            f->x1 = (int16_t)(x0 + s - (s >> 2));
            if (d8 >= g.zbuf[W / 4])
                f->x1 = -1;
        }
        for (int32_t c = x0 < 0 ? 0 : x0; c < x0 + s && c < W; c++) {
            if (d8 >= g.zbuf[c >> 1])
                continue;
            const uint16_t bit = (uint16_t)(0x8000u >> (((uint32_t)(c - x0) * step) >> 8));
            for (int32_t y = top < 0 ? 0 : top; y < bot && y < VIEW_H; y++) {
                const uint32_t ty = ((uint32_t)(y - top) * step) >> 8;
                if (g.spr[ty * 2u + 1u] & bit)
                    setpix((int16_t)c, (int16_t)y, (g.spr[ty * 2u] & bit) != 0u);
            }
        }
    }
}

/* The gun at 2x, bobbing while walking, with the muzzle flash after a shot. */
static void drawGun(bool walking)
{
    const uint8_t frame = g.now - g.shotT < FLASH_MS ? 1u : 0u;
    A->asset_read((uint16_t)(SPR_GUN + frame * GUN_ROWS * 4u), g.spr, GUN_ROWS * 4u);
    const int16_t y0 = (int16_t)(VIEW_H - GUN_ROWS * 2 + (walking ? (int16_t)((g.now >> 6) & 2u) : 0));
    for (uint8_t ty = 0; ty < GUN_ROWS; ty++) {
        for (uint8_t tx = 0; tx < 16u; tx++) {
            const uint16_t bit = (uint16_t)(0x8000u >> tx);
            if (!(g.spr[ty * 2u + 1u] & bit))
                continue;
            const bool ink = (g.spr[ty * 2u] & bit) != 0u;
            for (uint8_t k = 0; k < 4u; k++) {
                const int16_t y = (int16_t)(y0 + ty * 2 + (k >> 1));
                if (y < VIEW_H)
                    setpix((int16_t)(W / 2 - 16 + tx * 2 + (k & 1u)), y, ink);
            }
        }
    }
}

static void fire(void)
{
    if (g.now - g.shotT < SHOT_MS)
        return;
    if (!g.ammo) {
        sound(1500u, 1500u, 20u);     /* empty click */
        return;
    }
    g.ammo--;
    g.shotT = g.now;
    foe_t *hit = 0;
    for (uint8_t i = 0; i < FOE_N; i++) {
        foe_t *f = &g.foe[i];
        if (f->hp && f->x0 <= W / 2 && W / 2 <= f->x1 && (!hit || f->depth < hit->depth))
            hit = f;
    }
    if (hit && !--hit->hp) {
        g.kills++;
        sound(320u, 60u, 300u);       /* death growl */
    } else {
        sound(900u, 120u, 100u);      /* bang */
    }
}

static void reset(void)
{
    uint16_t v[3u + FOE_N * 2u];   /* START, then FOES right after it */
    A->asset_read(START, v, sizeof(v));
    g.px = v[0];
    g.py = v[1];
    g.ang = (uint16_t)(v[2] << 4);
    for (uint8_t i = 0; i < FOE_N; i++) {
        g.foe[i].x = v[3u + i * 2u];
        g.foe[i].y = v[4u + i * 2u];
        g.foe[i].hp = FOE_HP;
        g.foe[i].cool = 0;
    }
    g.hp = START_HP;
    g.ammo = START_AMMO;
    g.kills = 0;
    g.state = PLAY;
}

static char *item(char *o, char label, uint32_t v)
{
    *o++ = label;
    o = A->append_u32(o, v);
    *o++ = ' ';
    return o;
}

/* Health, ammo and kills on the status line. */
static void hud(void)
{
    char s[24];
    for (uint8_t i = 0; i < W; i++)
        A->status_line[i] = 0;
    char *o = item(s, 'H', (uint32_t)(g.hp < 0 ? 0 : g.hp));
    o = item(o, 'A', g.ammo);
    o = item(o, 'K', g.kills);
    o[-1] = '/';
    o = A->append_u32(o, FOE_N);
    *o = '\0';
    A->print_tiny(s, 2u, 1u, true, true);
}

static void clearRows(uint8_t p0, uint8_t p1)
{
    for (uint8_t p = p0; p < p1; p++)
        for (uint8_t x = 0; x < W; x++)
            A->fb[p][x] = 0;
}

/* An asset text centred on framebuffer line `line`. */
static void say(uint16_t text, uint8_t line)
{
    char s[TEXT_MAX];
    A->asset_read(text, s, sizeof(s));
    A->print_normal(s, 0u, W - 1u, line);
}

/* MENU: the title, then the keys in two columns, each key in a capsule
 * (CW Keyer style) with its action beside it. The game is paused meanwhile. */
static void drawHelp(void)
{
    char s[TEXT_MAX];
    clearRows(0u, VIEW_H / 8u);
    say(T_TITLE, 0u);
    for (uint8_t i = 0; i < 10u; i++) {
        const uint8_t x = i < 5u ? 4u : 68u;
        const uint8_t line = (uint8_t)(2u + (i < 5u ? i : i - 5u));
        A->asset_read((uint16_t)(T_HELP + i * T_HELP_STRIDE), s, sizeof(s));
        A->print_inverse(s, x, line, false, true, (uint8_t)(x + 15u));
        A->print_tiny(s + HELP_ACT, (uint8_t)(x + 20u), (uint8_t)(line * 8u + 1u), false, true);
    }
}

__attribute__((section(".text.entry"), used))
void app_main(const app_api_t *api)
{
    A = api;
    A->asset_read(MAP, g.map, sizeof(g.map));
    reset();
    A->prepare_tone();                /* tone 1 on, muted, AF to the beep */
    A->audio_path(true);
    A->backlight_on();

    uint8_t prevKey = APP_KEY_INVALID;
    bool prevFire = true;
    uint32_t last = A->cycles_48mhz();
    uint32_t acc = 0;

    for (;;) {
        const uint8_t key = A->get_key();
        if (key == APP_KEY_SAVER) {
            prevKey = key;
            g.sndMs = 0;
            A->bk_write(REG_TX_MUTE, TONE_MUTE);
            A->delay_ms(10);
            A->backlight_update();
            last = A->cycles_48mhz();
            continue;
        }
        const bool trigger = key == APP_KEY_5 || !(GPIOB_IDR & (1u << PTT_PIN));
        const bool pressed = trigger && !prevFire;
        prevFire = trigger;
        if (key != prevKey) {
            if (key == APP_KEY_EXIT)
                break;
            if (key == APP_KEY_MENU)
                g.help = !g.help;
            if (key <= APP_KEY_PTT)
                A->backlight_on();
        }
        prevKey = key;
        g.now = A->ticks_ms();

        const uint32_t cyc = A->cycles_48mhz();
        acc += cyc - last;
        last = cyc;
        uint32_t dt = acc >> DT_SHIFT;
        acc &= (1u << DT_SHIFT) - 1u;
        if (dt > DT_MAX)
            dt = DT_MAX;

        soundUpdate();
        if (g.help) {
            drawHelp();
        } else {
            bool walking = false;
            if (g.state != PLAY) {
                if (key == APP_KEY_5 && pressed)
                    reset();
            } else {
                if (key == APP_KEY_4)
                    g.ang = (uint16_t)((g.ang - dt * TURN_K) & ANG_MASK);
                else if (key == APP_KEY_6)
                    g.ang = (uint16_t)((g.ang + dt * TURN_K) & ANG_MASK);
                else if (key == APP_KEY_2 || key == APP_KEY_8 || key == APP_KEY_1 || key == APP_KEY_3) {
                    const int32_t step = (int32_t)(dt * MOVE_K);       /* Q8 x 16 */
                    int32_t vx, vy;
                    if (key == APP_KEY_2 || key == APP_KEY_8) {
                        vx = g.dx;
                        vy = g.dy;
                    } else {
                        vx = -g.dy;                                    /* right */
                        vy = g.dx;
                    }
                    if (key == APP_KEY_8 || key == APP_KEY_1) {
                        vx = -vx;
                        vy = -vy;
                    }
                    slide(&g.px, &g.py, (vx * step) >> 18, (vy * step) >> 18);
                    walking = true;
                }
                if (pressed)
                    fire();
                foesThink(dt);
                if (g.hp <= 0) {
                    g.state = DIED;
                    sound(240u, 40u, 700u);
                } else if (g.kills == FOE_N) {
                    g.state = CLEARED;
                    sound(400u, 1200u, 500u);
                }
            }
            g.dx = isin((uint16_t)((g.ang >> 4) + ANG_Q));
            g.dy = isin((uint16_t)(g.ang >> 4));

            render();
            drawFoes();
            drawGun(walking);
            if (g.now - g.hurtT < FLASH_MS)
                for (uint8_t p = 0; p < VIEW_H / 8u; p++)
                    for (uint8_t x = 0; x < W; x++)
                        A->fb[p][x] = (uint8_t)~A->fb[p][x];
            if (g.state != PLAY) {
                clearRows(2u, 5u);
                say(g.state == DIED ? T_DIED : T_CLEAR, 2u);
                say(T_AGAIN, 4u);
            }
        }

        hud();
        A->blit_status();
        A->blit_full();
        A->backlight_update();
    }
    /* Amplifier off first: tones_off_rx moves the AF and restarts the RX
     * chain, which clicks in the speaker while the amplifier is on. */
    A->bk_write(REG_TX_MUTE, TONE_MUTE);
    A->audio_path(false);
    A->tones_off_rx();
}

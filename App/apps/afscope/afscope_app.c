/* Copyright 2026 Armel F4HWN
 * https://github.com/armel
 *
 * Licensed under the Apache License, Version 2.0 (the "License");
 * you may not use this file except in compliance with the License.
 * You may obtain a copy of the License at
 *
 *     http://www.apache.org/licenses/LICENSE-2.0
 *
 *     Unless required by applicable law or agreed to in writing, software
 *     distributed under the License is distributed on an "AS IS" BASIS,
 *     WITHOUT WARRANTIES OR CONDITIONS OF ANY KIND, either express or implied.
 *     See the License for the specific language governing permissions and
 *     limitations under the License.
 */

/*
 * AF Scope - an oscilloscope and a tuner for the demodulated RX audio, not
 * for RF: the BK4829 AF output, sampled on PA4 (the voice DAC pin) as APRS RX
 * does. The time half of an instrument whose other half is AF Spectro
 * (spectrum, sonogram, twist): MENU on the last view hands off to it.
 *   SCOPE  the trace over the screen, triggered on a rising or falling zero
 *          crossing, 0.8 to 13 ms per division (peak detect when a pixel
 *          holds several samples), gain AUTO / x1 / x2 / x4 / x8 / x16,
 *          persistence;
 *          the frequency counter (one frequency, or the two of an FSK), pp,
 *          DC, the RF frequency;
 *   TUNE   the frequency of a steady tone in big digits, its stability, a
 *          needle against the nearest known tone (1750 Hz call tone, DTMF,
 *          Bell 202, SSTV, CW...), the period folded over two cycles.
 * It names nothing it hears: the tone names are labels of the needle.
 *
 * Measurement (test/model.py is the reference, keep the two in step): a
 * block of samples is taken with nothing else running but, while the speaker
 * is on, the LCD bytes sent with the samples (lcd_feed). Its rising zero
 * crossings (hysteresis pp/8, interpolated to 1/256 sample) give the mean
 * period; a second pass sums the periods more than 1/8 longer and shorter
 * than it. With fewer than 1/8 of them the block is a steady tone, one
 * frequency; else the two are shown (FSK: 1200/2200). TUNE takes 640 samples
 * at 19.2 kHz (33 ms) and smooths its reading over about four blocks; its
 * stability is the last block's distance to it.
 * The fixed parts of the screens (status-bar capsules, grid, needle scale)
 * are asset bitmaps drawn by gen_assets.py.
 *
 * Keys (UV-K5 and UV-K1): MENU next view, then AF Spectro · UP/DOWN SCOPE
 *   timebase, TUNE needle span (+-50, 20, 10 Hz) · * hold · 1 audio path STD / RAW · 2 speaker · 3 gain · 4 trigger edge ·
 *   5 persistence · 0 clear the persistence · EXIT quit (view, path, speaker,
 *   timebase, gain, edge, persistence and span saved).
 * The status bar shows RAW when the filters are off, a lock while held (else
 * a clipped wave while samples reach the ADC limits) and the speaker while
 * it is on. STD keeps the VFO's AF output and filters (USB
 * for USB, else FM, which AM also uses: its demodulator is REG_31 bit 0);
 * RAW turns the RX audio filters and the AFC off and, in FM only, selects the
 * discriminator bypass (REG_47 AF 9, as the radiosonde apps). The registers
 * are restored on exit, and the loader re-runs RADIO_SetupRegisters.
 */

#include <stdint.h>
#include <stdbool.h>
#include <stddef.h>
#include "../app_api.h"
#include "../af_handoff.h"
#include "afscope_assets.h"     /* generated by gen_assets.py */

/* ---- sampling ---- */
#define NMAX        640u       /* the trigger window, then 128 points x 4    */
#define TRIG_WIN    128u       /* samples searched for the trigger           */
#define TUNE_N      640u       /* TUNE: 33 ms ...                            */
#define TUNE_FSI    1u         /* ... at 19.2 kHz                            */
#define CYC_9K6     5000u      /* 48 MHz / 9.6 kHz, halved per rate step     */
#define CLIP_LO     (16 - 2048)
#define CLIP_HI     (4079 - 2048)
#define HYST_MIN    4
#define SPREAD_SH   3          /* FSK: periods 1/8 off the mean; a steady
                                  tone: fewer than 1/8 of them               */

/* ---- BK4829 ---- */
#define REG_0C      0x0C       /* bit 1: squelch open                         */
#define REG_2B      0x2B       /* bits 10:8 off: RX HPF 300, LPF 3k, de-emph. */
#define REG_31      0x31       /* bit 0: the AM demodulator, set by the VFO   */
#define REG_47      0x47       /* bits 11:8: AF output                        */
#define REG_73      0x73       /* bit 4: AFC disabled                         */
#define RAW_2B      0x0700u
#define RAW_73      0x0010u
#define AF_USB      5u         /* BK4819_AF_BASEBAND2, the firmware's USB AF  */
#define AF_BYPASS   9u         /* discriminator bypass, as the sonde apps     */

/* ---- the bottom lines: fixed fields, numbers right-aligned (characters) ---- */
#define F_FREQ      11u        /* "1750", "1227 / 2079", then "Hz": with PP and
                                  DC, the 32 characters of the line          */
#define F_PP        4u         /* up to 4095                                  */
#define F_DC        5u         /* "   +9" .. "-2048": DC ends on the right edge */
#define F_RF        8u         /* "145.500", "1300.000"                       */
#define F_RSSI      4u         /* "-130"                                      */

/* ---- screen (gen_assets.py draws the fixed parts with the same values) ---- */
#define TUNE_MID    63         /* needle scale centre, 1 px per span/50       */
#define SCALE_Y     19         /* needle scale line (fb y), the needle under  */
#define WAVE_MID    39u        /* TUNE waveform, +-7 px                       */
#define SCOPE_MID   19u        /* SCOPE trace, +-18 px                        */
#define PERS_LEN    (5u * 128u)  /* persistence: the trace lines 0-4         */
#define CFG_LEN     8u         /* view, raw, spk, tb, gain, edge, pers, span  */
#define C_TB        3u
#define TB_DEF      2u         /* 3.3 ms per division                         */

enum { V_SCOPE = 0, V_TUNE, V_COUNT };
enum { M_FM = 0, M_AM, M_USB };         /* the VFO's demodulation: the AF path */

#define SPANS       3u
/* the saved settings: their limits (a value at or over it reads as 0, the
 * timebase as TB_DEF) */
static const uint8_t CFG_LIM[CFG_LEN] = { V_COUNT, 2, 2, TB_COUNT, GAIN_COUNT, 2, 2, SPANS };
static const uint8_t SPAN[SPANS] = { 50, 20, 10 };      /* TUNE: +-Hz        */
/* timebases: the rate (9.6 kHz << fsi) and the samples per pixel (1 << dsh) */
static const uint8_t TB_FSI[TB_COUNT] = { 2, 1, 0, 0, 0 };
static const uint8_t TB_DSH[TB_COUNT] = { 0, 0, 0, 1, 2 };
/* REG_47's AF output per mode and path (mode * 2 + raw): FM, FM RAW (the
 * discriminator bypass), AM (the FM output, the AM demodulator on), AM RAW,
 * USB, USB RAW */
static const uint8_t AF_OUT[6] = { APP_AF_FM, AF_BYPASS, APP_AF_FM, APP_AF_FM, AF_USB, AF_USB };

/* The app state in one struct: one base address per function instead of a
 * literal per global. Bytes (the saved settings first, in cfg order), then
 * halfwords, then words, then the 64-bit twist sums carried for AF Spectro.
 * The loader zeroes the overlay (.bss) at every launch. */
static struct {
    union {                             /* the saved settings, cfg order */
        uint8_t set[CFG_LEN];
        struct { uint8_t view, raw, spk, tb, gain, edge, pers, span; };
    };
    uint8_t  prevKey, held, mode, fsi, dsh, dirty;
    bool     lcd;                       /* lcd_feed: a frame being sent       */
    uint8_t  frames;                    /* lcd_feed frames: K5Viewer every 16 */
    bool     running, steady;
    uint16_t r2B, r73, ftone, stab;
    int32_t  dc, mn, mx, pp, clip, fs, n, favg;
    int32_t  fmean, flo, fhi;           /* the counter's frequencies          */
    int32_t  cnt, t0, tl, p8;           /* crossings, first, last, mean period (Q8) */
    int32_t  nlo, nhi, slo, shi;        /* periods over / under p8: count, sum */
    int32_t  i0;                        /* the trigger sample                 */
    const app_api_t *A;
    int16_t  *smp;                      /* the block                          */
    uint8_t  *pbuf;                     /* persistence, then the TUNE fold    */
    char     *text;                     /* formatting buffer (app_main's stack) */
    uint64_t elo, ehi;                  /* AF Spectro's twist, passed through */
} g;
#define str g.text

/* ---- tiny freestanding helpers: GCC may turn small loops into calls ---- */
void *memset(void *d, int c, size_t n) {
    uint8_t *p = d; while (n--) *p++ = (uint8_t)c; return d;
}
void *memcpy(void *d, const void *s, size_t n) {
    uint8_t *p = d; const uint8_t *q = s; while (n--) *p++ = *q++; return d;
}
/* Divisions through the resident helpers (API level 2). GCC leaves an
 * undefined __aeabi_uidiv in the object even without a call: defining it
 * here keeps libgcc's 276-byte one out. */
uint64_t __aeabi_idivmod(int32_t n, int32_t d){ return g.A->idivmod(n, d); }
uint64_t __aeabi_idiv(int32_t n, int32_t d) __attribute__((alias("__aeabi_idivmod")));
uint64_t __aeabi_uidivmod(uint32_t n, uint32_t d){ return g.A->uidivmod(n, d); }
uint64_t __aeabi_uidiv(uint32_t n, uint32_t d) __attribute__((alias("__aeabi_uidivmod")));

/* ---- formatting ---- */
static char *put(char *o, const char *s){ while (*s) *o++ = *s++; return o; }
/* The resident formatter (API level 3), behind one local stub: every call
 * stays a plain bl. */
__attribute__((noinline))
static char *puti(char *o, int32_t v){ return g.A->append_i32(o, v); }
static char *putSigned(char *o, int32_t v){ if (v > 0) *o++ = '+'; return puti(o, v); }
/* o0..o right-aligned in w characters (spaces before), so that the fields of
 * a line stay put; longer, left as it is */
__attribute__((noinline))
static char *rjust(char *o0, char *o, unsigned w){
    char *e = o0 + w;
    if (o >= e) return o;
    while (o > o0) *--e = *--o;
    while (e > o0) *--e = ' ';
    return o0 + w;
}
/* v with leading zeros to 4 digits: "0300" */
static char *put04(char *o, int32_t v){
    char *e = rjust(o, puti(o, v), 4u);
    for (char *p = o; *p == ' '; p++) *p = '0';
    return e;
}
/* str..end in the tiny font at x, y, cut at the screen edge (print_tiny
 * does not clip) */
static void tiny(uint8_t x, uint8_t y, char *end){
    unsigned room = (128u - x) >> 2;
    if ((unsigned)(end - str) > room) end = str + room;
    *end = '\0'; g.A->print_tiny(str, x, y, false, true);
}
static void dot(unsigned x, unsigned y){ g.A->fb[y >> 3][x] |= (uint8_t)(1u << (y & 7u)); }
/* asset_read lies past the ldr immediate range of the table: one stub */
__attribute__((noinline))
static void asset(unsigned off, void *dst, unsigned len){
    g.A->asset_read((uint16_t)off, dst, (uint16_t)len);
}

/* ---- the measurement (test/model.py) ---- */
/* One block of g.n samples at 9.6 kHz << g.fsi, paced by the 48 MHz cycle
 * clock.
 * While the speaker is on, the screen goes out with it, k bytes after each
 * sample (lcd_feed): the LCD SPI spread over the capture instead of an 11 ms
 * blit, which the speaker plays as a flutter (the "helicopter"). k is 5 at
 * 9.6 kHz, 3 at 19.2 kHz, 1 at 38.4 kHz (10.7 us a byte): a frame, 1048
 * bytes, goes out within a block at the two low rates. */
static void capture(void){
    uint32_t (*const clk)(void) = g.A->cycles_48mhz;
    uint16_t (*const sample)(void) = g.A->af_capture_sample;
    bool (*const feed)(unsigned) = g.A->lcd_feed;
    uint32_t cyc = CYC_9K6 >> g.fsi, next = clk();
    unsigned k = (5u >> g.fsi) | 1u;                /* LCD bytes per sample: 5, 3, 1 */
    for (int32_t n = 0; n < g.n; n++) {
        while ((int32_t)(clk() - next) < 0) {}
        next += cyc;
        g.smp[n] = (int16_t)(sample() - 2048u);
        if (g.lcd) g.lcd = feed(k);
    }
}

/* The rising zero crossings of the block (hysteresis pp/8, interpolated,
 * Q8 samples). pbar 0: their count, the first and the last. Else the periods
 * 1/8 longer than pbar (the lower frequency) and 1/8 shorter, counted and
 * summed. */
__attribute__((noinline))
static void crossings(int32_t pbar){
    const int16_t *s = g.smp;
    int32_t h = g.pp >> 3, prev = s[0] - g.dc, last = -1;
    bool armed = false;
    if (h < HYST_MIN) h = HYST_MIN;
    for (int32_t n = 1; n < g.n; n++) {
        int32_t v = s[n] - g.dc;
        if (v < -h) armed = true;
        else if (armed && prev < 0 && v >= 0) {
            int32_t t = ((n - 1) << 8) + (-prev << 8) / (v - prev);
            armed = false;
            if (!pbar) { if (!g.cnt++) g.t0 = t; }
            else if (last >= 0) {
                int32_t p = t - last, e = pbar >> SPREAD_SH;
                if (p > pbar + e) { g.slo += p; g.nlo++; }
                else if (p < pbar - e) { g.shi += p; g.nhi++; }
            }
            last = t;
        }
        prev = v;
    }
    g.tl = last;
}

/* Statistics, the frequency counter, the trigger. */
__attribute__((noinline))
static void analyze(void){
    const int16_t *s = g.smp;
    int32_t sum = 0, mn = 2047, mx = -2048, clip = 0;
    for (int32_t n = 0; n < g.n; n++) {
        int32_t v = s[n];
        sum += v;
        if (v < mn) mn = v;
        if (v > mx) mx = v;
        if (v < CLIP_LO || v > CLIP_HI) clip++;
    }
    int32_t dc = sum / g.n;
    g.dc = dc; g.mn = mn; g.mx = mx; g.pp = mx - mn; g.clip = clip;

    g.cnt = g.nlo = g.nhi = g.slo = g.shi = 0;
    g.fmean = 0;
    crossings(0);
    bool steady = false;
    if (g.cnt >= 3) {
        int32_t c1 = g.cnt - 1, fs8 = g.fs << 8;
        g.p8 = (g.tl - g.t0 + (c1 >> 1)) / c1;
        g.fmean = (fs8 + (g.p8 >> 1)) / g.p8;
        crossings(g.p8);
        g.flo = g.nlo ? fs8 / (g.slo / g.nlo) : g.fmean;
        g.fhi = g.nhi ? fs8 / (g.shi / g.nhi) : g.fmean;
        steady = (g.nlo + g.nhi) << SPREAD_SH < g.cnt;
    }
    g.steady = steady;
    /* TUNE: about four blocks of a steady tone, in 1/16 Hz; the stability is
     * this block's distance to the average before it */
    int32_t prev = g.favg, dv = (g.fmean << 4) - prev;
    if (steady) g.favg = prev ? prev + (dv >> 2) : g.fmean << 4;
    else g.favg = 0;
    g.ftone = (uint16_t)((g.favg + 8) >> 4);
    g.stab = (uint16_t)(steady && prev ? (dv < 0 ? -dv : dv) >> 4 : 0);

    /* the trigger: the first crossing on the chosen edge after the signal
     * went the other way by pp/8, in the first TRIG_WIN samples */
    int32_t h = g.pp >> 3, sg = g.edge ? -1 : 1;
    bool armed = false;
    prev = (s[0] - dc) * sg;
    if (h < HYST_MIN) h = HYST_MIN;
    g.i0 = 0;
    for (int32_t n = 1; n < (int32_t)TRIG_WIN; n++) {
        int32_t v = (s[n] - dc) * sg;
        if (v < -h) armed = true;
        else if (armed && prev < 0 && v >= 0) { g.i0 = n; break; }
        prev = v;
    }
}

/* The view or the timebase sets the rate, the samples per pixel and the
 * block; the persistence and the TUNE average start over. */
static void setup(void){
    unsigned tb = g.tb, v = g.view;
    g.fsi = v ? TUNE_FSI : TB_FSI[tb];
    g.dsh = v ? 0u : TB_DSH[tb];
    g.n = v ? (int32_t)TUNE_N : (int32_t)(TRIG_WIN + (128u << g.dsh));
    g.fs = 9600 << g.fsi;
    g.favg = 0;
    memset(g.pbuf, 0, PERS_LEN);
}

/* STD: the VFO's AF output and filters. RAW: no RX audio filter, no AFC,
 * the discriminator bypass in FM. */
static void path(void){
    void (*const w)(uint8_t, uint16_t) = g.A->bk_write;
    w(REG_2B, (uint16_t)(g.r2B | RAW_2B * g.raw));
    w(REG_73, (uint16_t)(g.r73 | RAW_73 * g.raw));
    g.A->set_af(AF_OUT[g.mode * 2u + g.raw]);
}

/* ---- display ---- */
/* Column x from value a to value b (centred samples), amp over half px. */
static void col(unsigned x, int32_t a, int32_t b, unsigned mid, unsigned half, int32_t amp){
    int32_t ya = (int32_t)mid - a * (int32_t)half / amp, yb = (int32_t)mid - b * (int32_t)half / amp;
    int32_t top = (int32_t)(mid - half), bot = (int32_t)(mid + half);
    if (ya < top) ya = top;
    if (ya > bot) ya = bot;
    if (yb < top) yb = top;
    if (yb > bot) yb = bot;
    g.A->draw_line(g.A->fb, (int16_t)x, (int16_t)ya, (int16_t)x, (int16_t)yb, true);
}

/* the block's own peak, half the height in AUTO */
static int32_t peakAmp(void){
    int32_t amp = g.mx - g.dc;
    if (g.dc - g.mn > amp) amp = g.dc - g.mn;
    return amp < 8 ? 8 : amp;
}

/* "145.500": the kHz ("145500", 5 digits or more from 18 MHz up), a point
 * slipped in before the last 3 */
static char *putRf(char *o){
    o = puti(o, (int32_t)g.A->rx_freq() / 100);
    o[0] = o[-1]; o[-1] = o[-2]; o[-2] = o[-3]; o[-3] = '.';
    return o + 1;
}

/* the main screen's big digits from str..end ('-' allowed), at x on lines
 * 0-1 */
static unsigned big(unsigned x, const char *end){
    const app_api_t *A = g.A;
    for (const char *t = str; t < end; t++) {
        unsigned i = BIG + (*t == '-' ? 10u : (unsigned)(*t - '0')) * 20u;
        asset(i, A->fb[0] + x, 10);
        asset(i + 10u, A->fb[1] + x, 10);
        x += 12u;
    }
    return x;
}

static void drawScope(const char *s){
    const app_api_t *A = g.A;
    unsigned d = 1u << g.dsh;
    int32_t amp = g.gain ? 2048 >> (g.gain - 1u) : peakAmp();     /* x1 .. x16 */
    asset(SCOPE_GRID, A->fb[0], PERS_LEN);
    /* one column per pixel: the samples it holds (peak detect), joined to
     * the last sample of the previous one */
    const int16_t *p = g.smp + g.i0;
    int32_t last = p[0] - g.dc;
    for (unsigned x = 0; x < 128u; x++) {
        int32_t lo = last, hi = last;
        for (unsigned j = 0; j < d; j++) {
            int32_t v = *p++ - g.dc;
            if (v < lo) lo = v;
            if (v > hi) hi = v;
            last = v;
        }
        col(x, lo, hi, SCOPE_MID, 18, amp);
    }
    if (g.pers) {                                /* the traces add up */
        uint8_t *f = A->fb[0], *q = g.pbuf;
        for (unsigned i = 0; i < PERS_LEN; i++) { q[i] |= f[i]; f[i] = q[i]; }
    }
    /* "       1750Hz  PP 1088  DC    +9", "1227 / 2079Hz ..." (4 digits, leading
     * zeros: a steady tone or an FSK pair; blank
     * without three crossings): every field in its own columns, the numbers
     * right-aligned */
    char *o = str, *t;
    if (!g.fmean) o = rjust(str, str, F_FREQ + 2u);
    else {
        if (g.steady) o = put04(o, g.fmean);
        else { o = put04(o, g.flo); *o++ = ' '; *o++ = '/'; *o++ = ' '; o = put04(o, g.fhi); }
        o = put(rjust(str, o, F_FREQ), s + T_HZ);
    }
    t = put(o, s + T_PP); o = rjust(t, puti(t, g.pp), F_PP);
    t = put(o, s + T_DC); o = rjust(t, putSigned(t, g.dc), F_DC);
    tiny(0, 41, o);
    /* " 145.500 3.3ms/d AUTO / PERS": the timebase and gain names are padded
     * to one width in the assets */
    o = rjust(str, putRf(str), F_RF); *o++ = ' ';
    o = put(o, s + T_TB + g.tb * T_TB_STRIDE); *o++ = ' ';
    o = put(o, s + T_GAIN + g.gain * T_GAIN_STRIDE);
    o = put(o, s + T_EDGE + g.edge * T_EDGE_STRIDE);
    if (g.pers) o = put(o, s + T_PERS);
    tiny(0, 49, o);
}

static void drawTune(const char *s){
    const app_api_t *A = g.A;
    bool tone = g.favg != 0;
    char *o = tone ? puti(str, g.ftone) : put(str, s + T_NONE);
    unsigned x = big(2, o), z = g.span;
    A->print_normal(s + T_HZ, (uint8_t)(x + 1u), 0, 1);
    A->print_tiny(s + T_STAB, 98, 0, false, true);
    asset(TUNE_SCALE + z * 128u, A->fb[2], 128);
    if (tone) {
        o = put(str, "+-"); o = puti(o, g.stab > 99u ? 99 : g.stab); *o = '\0';
        A->print_bold(str, 98, 0, 1);
        /* the nearest known tone names the needle, +-span Hz over +-50 px */
        const uint16_t *hz = (const uint16_t *)(const void *)(s + TONE_HZ);
        int32_t f = g.ftone, dd = f - hz[0];
        unsigned best = 0;
        for (unsigned i = 1; i < TONE_COUNT; i++) {
            int32_t e = f - hz[i];
            if ((e < 0 ? -e : e) < (dd < 0 ? -dd : dd)) { dd = e; best = i; }
        }
        int32_t n = dd * 50 / SPAN[z];
        if (n > 50) n = 50;
        if (n < -50) n = -50;
        A->draw_rect(A->fb, (int16_t)(TUNE_MID - 1 + n), SCALE_Y + 1,
                     (int16_t)(TUNE_MID + 1 + n), SCALE_Y + 4, true);
        o = put(str, s + T_TONES + best * T_TONES_STRIDE); *o++ = ' ';
        o = putSigned(o, dd);
        tiny((uint8_t)(64u - (unsigned)(o - str) * 2u), 25, o);
    }
    for (unsigned i = 0; i < 128u; i += 4u) dot(i, WAVE_MID);
    /* the period folded over two cycles from the first crossing: 64 phase
     * bins (sums, then counts, in the persistence buffer); without a steady
     * tone, the block itself */
    int32_t *sum = (int32_t *)(void *)g.pbuf, amp = 8, prev = 0;
    uint8_t *num = (uint8_t *)(sum + 64);
    memset(sum, 0, 64u * 5u);
    if (tone) {
        int32_t p8 = g.p8, inv = (64 << 16) / p8, ph = 256 - (g.t0 & 255);
        for (int32_t n2 = (g.t0 >> 8) + 1; n2 < g.n; n2++, ph += 256) {
            while (ph >= p8) ph -= p8;
            unsigned b = (unsigned)((ph * inv) >> 16);
            sum[b] += g.smp[n2] - g.dc; num[b]++;
        }
        for (unsigned b = 0; b < 64u; b++) {
            if (num[b]) sum[b] /= num[b];
            else if (b) sum[b] = sum[b - 1];          /* an empty bin: the last */
            int32_t v = sum[b] < 0 ? -sum[b] : sum[b];
            if (v > amp) amp = v;
        }
    } else amp = peakAmp();
    for (unsigned i = 0; i < 128u; i++) {
        int32_t v = tone ? sum[i & 63u] : g.smp[i] - g.dc;
        col(i, i ? prev : v, v, WAVE_MID, 7, amp);
        prev = v;
    }
    /* " 145.500  RSSI  -87dBm   PP  812": fixed fields, as under SCOPE, PP on
     * the right edge */
    char *t = put(rjust(str, putRf(str), F_RF), s + T_RSSI);
    o = put(rjust(t, puti(t, A->rssi_dbm()), F_RSSI), s + T_DBM);
    t = put(o, s + T_PP); o = rjust(t, puti(t, g.pp), F_PP);
    tiny(0, 49, o);
}

__attribute__((noinline))
static void draw(void){
    char s[UI_SIZE] __attribute__((aligned(4)));
    const app_api_t *A = g.A;
    uint8_t *st = A->status_line;
    asset(0, s, UI_SIZE);
    A->display_clear();
    A->status_clear();
    /* "AF SCOPE", RAW, then the lock (held) or the clip mark, the speaker:
     * left of the battery text */
    asset(STATUS + g.raw * STATUS_W, st, STATUS_W);
    if (g.held | g.clip) asset(g.held ? BMP_LOCK : BMP_CLIP, st + LOCK_X, BMP_LOCK_LEN);
    if (g.spk) asset(BMP_SPK, st + SPK_X, BMP_SPK_LEN);
    A->draw_battery();
    if (g.view) drawTune(s);
    else drawScope(s);
    if (g.spk && !g.held) {                      /* lcd_feed sends it with the samples */
        if (!(++g.frames & 15u)) A->viewer_update();   /* no blit_full here */
        g.lcd = A->lcd_feed(0);
    } else {
        A->blit_status();
        A->blit_full();
    }
}

/* ---- input ---- */
static void keys(void){
    const app_api_t *A = g.A;
    uint8_t key = A->get_key();
    if (key == g.prevKey) return;
    g.prevKey = key;
    if (key == APP_KEY_INVALID || key >= APP_KEY_SAVER) return;
    A->backlight_on();
    g.dirty = 1;
    int8_t d = A->nav_dir(key);
    if (d) {           /* up: a closer look, a shorter timebase or a narrower span */
        if (g.view) {
            int32_t v = g.span + d;
            if (v >= 0 && v < (int32_t)SPANS) g.span = (uint8_t)v;
        } else {
            int32_t v = g.tb - d;
            if (v >= 0 && v < (int32_t)TB_COUNT) g.tb = (uint8_t)v;
        }
    }
    else if (key == APP_KEY_EXIT) { g.running = false; return; }
    else if (key == APP_KEY_STAR) {              /* the screen stays, sent whole */
        g.held ^= 1u; g.lcd = false; return;
    }
    else if (key == APP_KEY_2) { g.spk ^= 1u; return; }
    else if (key == APP_KEY_MENU) {
        if (g.view + 1u < V_COUNT) g.view++;
        else {                                   /* the last view: AF Spectro */
            af_handoff_t m = { AF_HANDOFF_MAGIC, g.raw, g.spk, { 0 }, g.elo, g.ehi };
            if (A->handoff(AF_SPECTRO_APP_NAME, &m, sizeof m)) g.running = false;
            else g.view = 0;
        }
    }
    else if (key == APP_KEY_1) { g.raw ^= 1u; path(); A->delay_ms(20); }
    else if (key == APP_KEY_3) g.gain = (uint8_t)(g.gain + 1u < GAIN_COUNT ? g.gain + 1u : 0u);
    else if (key == APP_KEY_4) g.edge ^= 1u;
    else if (key == APP_KEY_5) g.pers ^= 1u;
    else if (key != APP_KEY_0) return;
    setup();               /* a new view, timebase, path, gain or edge; 0: clear */
}

__attribute__((section(".text.entry"), used))
void app_main(const app_api_t *api){
    int16_t smp[NMAX];
    uint8_t pbuf[PERS_LEN] __attribute__((aligned(4)));   /* also the TUNE fold sums */
    char text[36];
    af_handoff_t m;
    g.A = api;
    g.smp = smp; g.pbuf = pbuf; g.text = text;
    g.prevKey = APP_KEY_INVALID;

    /* the settings straight into g; erased flash or junk: the defaults */
    api->cfg_load(g.set, CFG_LEN);
    for (unsigned i = 0; i < CFG_LEN; i++)
        if (g.set[i] >= CFG_LIM[i]) g.set[i] = i == C_TB ? TB_DEF : 0u;
    /* from AF Spectro: its path and speaker, the twist kept, the first view */
    if (api->handoff_read(&m, sizeof m, NULL) >= (int16_t)sizeof m && m.magic == AF_HANDOFF_MAGIC) {
        g.raw = m.raw & 1u; g.spk = m.spk & 1u; g.view = V_SCOPE;
        g.elo = m.elo; g.ehi = m.ehi;
    }
    /* before anything touches the AF: the VFO's demodulation, USB if its AF
     * output is, else AM if its demodulator is on, else FM */
    g.mode = ((api->bk_read(REG_47) >> 8) & 0x0Fu) == AF_USB ? M_USB : (uint8_t)(api->bk_read(REG_31) & 1u);
    g.r2B = api->bk_read(REG_2B);
    g.r73 = api->bk_read(REG_73);
    api->af_capture_open();                      /* PA4 bias and ADC channel 4 */
    api->backlight_on();
    path();
    api->delay_ms(50);
    setup();

    g.running = true;
    while (g.running) {
        if (!g.held) { capture(); analyze(); g.dirty = 1; }
        else api->delay_ms(40);
        keys();
        /* the speaker follows key 2 and, in STD, the squelch: in RAW the
         * squelch bit stays closed on a strong signal (APRS heard on PA4,
         * the speaker silent), so RAW plays all, as the radiosonde apps */
        api->audio_path(g.spk && (g.raw || (api->bk_read(REG_0C) & 2u)));
        api->battery_sample();                   /* yields the capture's ADC itself */
        api->backlight_update();
        /* a new screen once the last one is out; held, after a key only */
        if (g.running && g.dirty && !g.lcd) { g.dirty = 0; draw(); }
    }

    api->bk_write(REG_2B, g.r2B);
    api->bk_write(REG_73, g.r73);
    api->af_capture_close();
    api->set_af(APP_AF_MUTE);
    api->audio_path(false);
    api->cfg_save(g.set, CFG_LEN);
}

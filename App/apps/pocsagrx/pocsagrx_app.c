/* Copyright 2026 Armel F4HWN
 * https://github.com/armel
 *
 * Licensed under the Apache License, Version 2.0 (the "License");
 * you may not use this file except in compliance with the License.
 * You may obtain a copy of the License at
 *
 *     http://www.apache.org/licenses/LICENSE-2.0
 *
 *     Unless required by applicable law or agreed to in writing, software
 *     distributed under the License is distributed on an "AS IS" BASIS,
 *     WITHOUT WARRANTIES OR CONDITIONS OF ANY KIND, either express or implied.
 *     See the License for the specific language governing permissions and
 *     limitations under the License.
 */

/*
 * POCSAG RX - receives POCSAG pager transmissions at 1200 bauds (as the
 * amateur DAPNET network sends them) and at 512 bauds, both at once, in
 * software, and keeps the last ten pages, shown one at a time: address (RIC),
 * text, function. The rate of each preamble heard (512, 1200 or 2400, the
 * last not decoded) is shown with key 3. Tune the VFO (FM; 439.9875 MHz for
 * DAPNET, or 433.650 MHz for the Flipper Zero bench files of
 * test/flipper_pocsag.py), then launch.
 *
 * POCSAG keys the carrier frequency with the bits themselves: the discriminator
 * outputs the NRZ bit stream, not tones. The receiver is switched to RAW (RX
 * HPF300 / LPF3K / de-emphasis and AFC off, as EPIRB 406) and the audio is read
 * as APRS RX does: PA4 held at mid-scale by the MCU DAC, ADC channel 4 at
 * 9.6 kHz, timed from SysTick, continuously. Each sample goes through the
 * demodulator modelled and tested in test/model_rx.py: two lanes, 1200 and
 * 512 bauds, each a box filter of about half a bit then 3 hysteresis
 * slicers. The audio path cuts the low frequencies, so a
 * run of equal bits droops back to zero and a slicer comparing the level with
 * a threshold reads noise there (the first build did, and found nothing): each
 * slicer flips its level on the pulse a change of bit leaves and holds in
 * between, at 1/4, 3/8 and 1/2 of the peak. Each has its DPLL, the sync
 * codeword in either polarity, the BCH check with one bit corrected, and the
 * page assembly. Keep the two in step.
 * Keys and the screen cost sample time: they are served every 50 ms while no
 * slicer is inside a batch, and during the sync codeword of each batch
 * otherwise (twice a second), where no page bit is lost; the bit clocks are
 * run over the samples not taken, so the codeword alignment survives. The
 * redraw follows a new page, a key, or every 5 s. A new page also blinks the
 * green LED twice (0.4 s): a GPIO write, no sample lost.
 * A codeword that cannot be corrected does not end a page: its characters are
 * marked '?' and filled from another slicer's copy when one read them.
 *
 * Keys (UV-K5 and UV-K1): UP/DOWN scroll the text a row when it overflows;
 *   pressed again at either end: the newer / older page · * normal view /
 *   compact view (saved) · 1 speaker on/off (saved, off by default; not gated
 *   by the squelch: the receiver's hiss is heard) · 2 clear · 3 bottom line:
 *   level and age of the page / preamble rate and what each lane reads ·
 *   EXIT quit.
 * The loader re-runs RADIO_SetupRegisters on exit; the resident capture
 * (af_capture_close) restores the ADC, PA4, the DAC and its clock.
 */

#include <stdint.h>
#include <stdbool.h>
#include <stddef.h>
#include "../app_api.h"
#include "pocsagrx_assets.h"   /* generated by gen_assets.py */

/* ---- sampling: the PA4 capture and the 48 MHz cycle clock are resident
 * (API level 3); the capture holds PA4 at mid-scale (ADC code 2048). ---- */
#define BIAS_CODE      2048u
#define FS             9600u
#define CYC_PER_SAMPLE (48000000u / FS)            /* 5000 */
#define HOUSE_EVERY    480u    /* samples between key/screen slots (50 ms)       */
#define BUSY_MAX       19200u  /* serve a due slot anyway after 2 s of samples
                                  inside batches                                */
#define LED_STEP       960u    /* samples per step of the LED blink (100 ms)     */
#define LED_STEPS      4u      /* a new page: on, off, on, off                   */
#define SYNC_SLOT      8u      /* a due slot is served while the slicers have read
                                  less than 8 bits of a sync codeword: 20 ms left
                                  at 1200 bauds, 47 ms at 512, no page bit lost  */
#define REFRESH_SLOTS  100u    /* 100 housekeeping slots = 5 s (battery, age)    */
#define REDRAW_ON      1u      /* g.redraw: a key or the periodic refresh        */
#define REDRAW_FRAME   2u      /* g.redraw: a page, also wakes the backlight     */

/* ---- BK4829 RAW receive (EPIRB 406) ---- */
#define REG_2B      0x2B   /* <10:8> = 1: RX HPF300, LPF3K, de-emphasis off  */
#define REG_73      0x73   /* <4> = 1: AFC off (it would follow the bits)    */

/* ---- demodulator (test/model_rx.py, classes Demod, Lane, Slicer, RateFinder).
 * Two lanes side by side, one per baud rate, each with its box filter (about
 * half a bit), its DPLL step and three slicers: the sync codeword tells which
 * one a transmission is at. ---- */
#define NLANE       2      /* lane 0: 1200 bauds, lane 1: 512 bauds          */
#define NSL         3      /* slicers per lane: thresholds at 2/8, 3/8, 4/8 of the peak */
#define STEP_1200   8192u  /* DPLL step, 65536 per bit: 8 samples per bit    */
#define STEP_512    3495u  /* 65536 x 512 / 9600: 18.75 samples per bit      */
#define DUP_1200    128u   /* address codewords this close (half a codeword,  */
#define DUP_512     300u   /* in samples) are the same page, from another slicer */
#define BOX_512     8u     /* box samples at 512 bauds (4 at 1200: half a bit) */
#define PLL_SHIFT   3      /* 1/8 of the error per transition               */
/* The rate of a preamble (1 0 1 0 ... for 576 bits or more): the samples
 * between two flips of the first 1200-baud slicer, classed; PRE_RUNS flips in
 * a row in the same class are a preamble at that rate. */
#define PRE_RUNS    32u
_Static_assert((BOX_512 & (BOX_512 - 1u)) == 0u && BOX_512 >= 4u,
               "the 512-baud box shares the 4-sample box's index: a power of two");
#define DIRTY_WORDS 8u     /* codewords a slicer is not trusted to correct
                              after a bad one                               */

/* ---- POCSAG (test/pocsag.py) ---- */
#define SYNC        0x7CD215D8u
#define IDLE        0x7A89C197u
#define GEN         0x769u /* BCH (31,21): x^10 + x^9 + x^8 + x^6 + x^5 + x^3 + 1 */
#define SYNC_ERR    2u     /* wrong bits tolerated in a sync codeword       */
#define BATCH_WORDS 16u
#define HUNT        0xFFu  /* sl_t.word: looking for the sync codeword      */
#define FUNC_NUMERIC 0u    /* by usage: function 0 numeric, the others text */
#define MSG_MAX     80u    /* characters kept per page (DAPNET: 80)         */
#define GAP         0x7Fu  /* a character lost with a bad codeword: shown as
                              '?', filled from another slicer's copy        */
#define BAD_RUN     3u     /* bad codewords in a row that end a page        */
#define HISTORY     10u    /* pages kept: 100 B of app_main's stack each (a
                              page_t and its pointer); two digits in the
                              "2/10" capsule at most */

typedef struct {
    uint32_t ric;                      /* 21-bit address                          */
    uint32_t t;                        /* ticks_ms when received                  */
    uint32_t at;                       /* sample its address codeword came at     */
    int16_t  rssi;
    uint8_t  func, len;
    char     text[MSG_MAX];                /* text[0] while len = 0: 1 = characters
                                              came but none was read ("Text Lost"),
                                              0 = an address alone ("Tone Only") */
} page_t;

/* one slicer: its decision, DPLL, batch decoder, the page being read */
typedef struct {
    int32_t  amp;                      /* peak of |y|                             */
    int32_t  rprev, phase;             /* last level (+1 / -1), DPLL phase (65536/bit) */
    uint32_t sr;                       /* the last 32 bits, the newest in bit 0   */
    uint32_t inv;                      /* polarity found at the sync codeword     */
    uint32_t ric;
    uint32_t at;                       /* sample the address of the page came at  */
    uint8_t  num;                      /* thresholds at +/- num/8 of the peak     */
    uint8_t  dirty;                    /* codewords left before a correction is
                                          trusted again                           */
    uint8_t  nb;                       /* bits of the codeword being read         */
    uint8_t  word;                     /* codeword of the batch, 16 = the next sync,
                                          HUNT = no batch                         */
    uint8_t  has;                      /* an address was read: a page is open     */
    uint8_t  func, len;
    uint8_t  acc, na;                  /* character being assembled, its bits     */
    uint8_t  taint;                    /* that character lost bits with a bad word */
    uint8_t  badrun;                   /* bad codewords in a row inside the page  */
    uint8_t  excuse;                   /* samples were skipped during this sync
                                          codeword: it is taken as found          */
    uint16_t ok;                       /* good codewords (key 3: per lane)        */
    uint16_t step;                     /* DPLL step of its lane (65536 per bit)    */
    uint16_t dup;                      /* half a codeword of its lane, in samples  */
    uint8_t  lane;                     /* 0: 1200 bauds, 1: 512 bauds             */
    char     text[MSG_MAX];
} sl_t;

/* The app state in one struct: a function loads one base address instead of one
 * literal-pool word per global. Bytes, then halfwords, then words. The loader
 * zeroes the overlay (.bss) at every launch. */
static struct {
    uint8_t  prevKey, redraw;
    bool     running;
    uint8_t  count, cur;               /* pages kept, page shown (0 = newest)     */
    uint8_t  cw, spk, tones;           /* the saved settings, in cfg order: view (0
                                          normal, CW_COMPACT compact), speaker,
                                          key 4: keep the pages without text      */
    uint8_t  refresh;                  /* housekeeping slots since the last redraw */
    uint8_t  top, lim;                 /* first text row shown, its limit         */
    uint16_t nOk;                      /* pages received                          */
    uint8_t  dbg;                      /* key 3: the bottom line shows the counters */
    uint8_t  led;                      /* steps left of the LED blink             */
    uint16_t ledCnt;                   /* samples of the current step             */
    uint16_t nSync[NLANE];             /* sync codewords found per lane            */
    uint16_t preRate;                  /* rate of the last preamble (0: none yet)  */
    uint16_t rfCls;                    /* rate class of the flips being counted    */
    uint8_t  rfRun, rfStreak;          /* samples since the last flip, flips in a
                                          row in class rfCls                      */
    uint16_t busyFor;                  /* samples a due slot has waited           */
    uint32_t n;                        /* samples since the launch, those the
                                          housekeeping skipped included           */
    const app_api_t *A;
    char *text;                        /* formatting buffer (app_main's stack)    */
    page_t **history;                  /* newest first; buffers on app_main's stack */
    sl_t *sl;                          /* the slicers (listen()'s stack), for draw() */
} g;
#define str g.text

/* ---- tiny freestanding helpers: GCC may turn the zeroing / copy loops into calls ---- */
void *memset(void *d, int c, size_t n) {
    uint8_t *p = d; while (n) p[--n] = (uint8_t)c; return d;
}
void *memcpy(void *d, const void *s, size_t n) {
    uint8_t *p = d; const uint8_t *q = s;
    while (n) { --n; p[n] = q[n]; } return d;
}

/* ---- formatting ---- */
__attribute__((noinline))
static char *put(char *o,const char *s){ while(*s)*o++=*s++; return o; }
/* Formatting by repeated subtraction: no division. Values printed stay below
 * 10000000 (a RIC is 21 bits: 2097151). */
static unsigned sub(uint32_t *v,uint32_t d){ unsigned q=0; while(*v>=d){ *v-=d; q++; } return q; }
/* The resident formatter (API level 3). One local stub keeps every call a
 * plain bl: the service lies past the ldr immediate range of the table. */
__attribute__((noinline))
static char *puti(char *o,int32_t v){ return g.A->append_i32(o,v); }
static char *put2(char *o,uint32_t v){ *o++=(char)('0'+sub(&v,10u)); *o++=(char)('0'+v); return o; }

#define SPK_X       59u    /* speaker icon (FoxHunt's, x = 59-68), then the scroll
                              marks at x = 72-76, as in APRS RX, before the battery
                              text (x >= 83): BMP_TAIL in the assets, both in one
                              read. No "WAIT" capsule before it here: until a first
                              page the bottom line shows the decoder's counters */
#define TONE_X      45u    /* key 4 on: the bell (BMP_TONE, x = 45-52), centred
                              between the title capsule (x <= 38) and SPK_X */
#define NOTEXT_X    ((128u-7u*NOTEXT_CHARS)/2u)   /* "Tone Only" / "Text Lost"
                              centred (7 px a character): text from x = 32,
                              its capsule x = 31-95 */
#define CAPS_END    127u   /* last column of the capsules at the right of the
                              address (x >= 81 with "65535" and "10/10") */
/* The text under the address, in one of two views (key *), as APRS RX:
 * - normal (g.cw = 0): 18 characters per row on lines 1-3, scrolled by rows;
 * - compact (g.cw = CW_COMPACT): 32 tiny characters per row, 6 px apart from
 *   y = 8: the 80 characters of a page fit in 3 rows, no scroll. */
#define ROW_CHARS   18u
#define CW_COMPACT  14u    /* compact rows: ROW_CHARS + 14 = 32 characters */
#define ROWS        3u     /* rows shown in the normal view */

/* ---- a page from a slicer. The three slicers read the same transmission: each
 * gives the same page. What tells the same page from another one is not its
 * text (two pages may share theirs, or its beginning) but where it sits: its
 * address codeword came at the same sample, within half a codeword, for every
 * slicer, and two pages are a codeword apart at least. The copies are merged:
 * a character one slicer lost (GAP) is taken from another that read it, and
 * the longer text extends the shorter. ---- */
static void closePage(sl_t *m){
    const app_api_t *A=g.A;
    if(!m->has) return;
    m->has=0;
    const uint8_t *t=(const uint8_t *)m->text;
    unsigned n=m->len, gaps=0, lost=0;
    /* the marks of bad words after the last character were the end of the page
     * itself; so is the padding of a numeric page. Nothing left after a mark:
     * the text was lost, not absent. */
    while(n && (t[n-1u]==GAP || (m->func==FUNC_NUMERIC && t[n-1u]==' '))) lost|=t[--n]==GAP;
    for(unsigned i=0;i<n;i++) gaps+=t[i]==GAP;
    /* A page without text is dropped unless key 4 keeps them: a slicer that
     * slipped a bit reads shifted codewords, which are valid ones as often as
     * not (the code is cyclic), and they come out as addresses without text.
     * A copy with more characters lost than read is always dropped; one with
     * nothing read at all is a page without text ("Text Lost"). */
    if((!n && !g.tones) || 2u*gaps>n) return;
    g.redraw|=REDRAW_FRAME;
    for(unsigned j=0;j<g.count;j++){
        page_t *q=g.history[j];
        /* |at - at'| < half a codeword, in one unsigned compare */
        if(q->ric!=m->ric || q->func!=m->func ||
           (uint32_t)(m->at-q->at+m->dup)>=2u*m->dup) continue;
        for(unsigned i=0;i<n;i++)
            if(i>=q->len || (uint8_t)q->text[i]==GAP) q->text[i]=(char)t[i];
        if(n>q->len) q->len=(uint8_t)n;
        return;
    }
    page_t *p=g.history[HISTORY-1u];
    for(unsigned k=HISTORY-1u;k;k--) g.history[k]=g.history[k-1u];
    g.history[0]=p;
    if(g.count<HISTORY) g.count++;
    g.nOk++;                               /* wraps after 65535: five digits in its capsule */
    p->rssi=A->rssi_dbm();                 /* capture while the carrier is still up */
    p->ric=m->ric;
    p->func=m->func;
    p->at=m->at;
    p->t=A->ticks_ms();
    p->len=(uint8_t)n;
    memcpy(p->text,t,n);
    if(!n) p->text[0]=(char)lost;          /* which of the two draw() shows */
    g.cur=0;                               /* show it, from its first row */
    g.led=LED_STEPS;                       /* and blink: listen() steps it */
    g.top=0;
}

/* number of 1 bits */
static unsigned ones(uint32_t v){
    unsigned n=0;
    for(;v;v&=v-1u) n++;
    return n;
}

/* Remainder of the 31 upper bits by the generator: 0 for a valid codeword. */
static uint32_t syndrome(uint32_t cw){
    uint32_t r=cw>>1;
    for(unsigned i=30;i>=10u;i--) if(r&(1u<<i)) r^=GEN<<(i-10u);
    return r;
}

/* The codeword with one wrong bit corrected; false when more are wrong. The
 * syndrome of a single wrong bit i (1..31) is x^(i-1) modulo the generator:
 * the powers of x are walked until one matches. The parity then tells a second
 * wrong bit or, with a null syndrome, that the parity bit itself is wrong. */
static unsigned fix(uint32_t *pcw){   /* 0 = bad, 1 = it was right, 2 = one bit corrected */
    uint32_t cw=*pcw, s=syndrome(cw);
    unsigned q=1;
    if(s){
        uint32_t t=1;
        unsigned i=1;
        while(t!=s){
            t<<=1;
            if(t&0x400u) t^=GEN;
            if(++i>31u) return 0;
        }
        cw^=1u<<i;
        q=2;
    }
    if(ones(cw)&1u){
        if(s) return 0;
        cw^=1u;
        q=2;
    }
    *pcw=cw;
    return q;
}

/* numeric pages: 4 bits per character */
static const char NUMERIC[16]={'0','1','2','3','4','5','6','7','8','9','*','U',' ','-',')','('};

/* a character of the page being read */
static void addc(sl_t *m,unsigned ch){
    if(m->len<MSG_MAX) m->text[m->len++]=(char)ch;
}

/* ---- one codeword of a batch: an address opens a page, the message words
 * that follow fill it (7-bit characters, or 4-bit ones for a numeric page,
 * least significant bit first, running across the 20-bit fields), an idle
 * word or another address closes it. ---- */
static void codeword(sl_t *m,uint32_t cw){
    /* A word with 3 wrong bits or more "corrects" into another codeword once
     * in 60: a slicer that just read a bad word is reading garbage, and only
     * its error-free codewords are taken for a while. */
    unsigned good=fix(&cw);
    if(!good) m->dirty=DIRTY_WORDS;
    else if(m->dirty){
        m->dirty--;
        if(good==2u) good=0;
    }
    unsigned n=m->func==FUNC_NUMERIC?4u:7u;
    /* The all-zero and all-one words are valid codewords (address 0, and a
     * message of 20 ones): they are what a slicer reads on a steady level, in
     * one polarity or the other, so they are refused as bad ones. */
    if(!good || cw+1u<2u){
        /* A bad word inside a page: most likely one of its message words. Its
         * 20 bits are skipped and the characters they held are marked (GAP),
         * so what follows stays in place; another slicer may have read them.
         * Three in a row: the page is over. */
        if(!m->has) return;
        if(++m->badrun>=BAD_RUN){ closePage(m); return; }
        unsigned left=m->na+20u;
        for(;left>=n;left-=n) addc(m,GAP);
        m->na=(uint8_t)left;
        m->acc=0;
        m->taint=left!=0u;
        return;
    }
    m->ok++;
    if(cw==IDLE){ closePage(m); return; }
    if(cw>>31){
        if(!m->has) return;
        m->badrun=0;
        for(unsigned i=30;i>10u;i--){
            m->acc|=(uint8_t)(((cw>>i)&1u)<<m->na);
            if(++m->na==n){
                unsigned ch=m->acc;
                if(n==4u) ch=(uint8_t)NUMERIC[ch];
                if(m->taint) addc(m,GAP);
                else if(ch-32u<95u) addc(m,ch);
                m->taint=0;
                m->acc=m->na=0;
            }
        }
        return;
    }
    closePage(m);
    /* the 3 low bits of the address are the frame the word came in */
    m->ric=(((cw>>13)&0x3FFFFu)<<3)|(m->word>>1);
    m->func=(uint8_t)((cw>>11)&3u);
    m->at=g.n;
    m->has=1;
    m->acc=m->na=m->len=m->taint=m->badrun=0;
}

/* ---- batch decoder, one bit (1 = the lower frequency). Hunting: the last 32
 * bits against the sync codeword and its complement (the polarity of the
 * discriminator is not known). Then 16 codewords, and the next sync codeword
 * or the end of the transmission. Not inlined: its m stays in a register. ---- */
__attribute__((noinline))
static void seqBit(sl_t *m,uint32_t b){
    uint32_t sr=(m->sr<<1)|b;
    m->sr=sr;
    if(m->word==HUNT){
        unsigned e=ones(sr^SYNC);
        if(e<=SYNC_ERR || e>=32u-SYNC_ERR){
            m->inv=e>16u?0xFFFFFFFFu:0u;
            m->word=0;
            m->nb=0;
            g.nSync[m->lane]++;
        }
        return;
    }
    if(++m->nb<32u) return;
    m->nb=0;
    uint32_t cw=sr^m->inv;
    if(m->word==BATCH_WORDS){
        /* The keys and the screen are served during a sync codeword, where no
         * page is lost: a sync that could not be read for that reason
         * (excuse, set by listen()) is taken as found. */
        if(ones(cw^SYNC)<=SYNC_ERR || m->excuse) m->word=0;
        else { closePage(m); m->word=HUNT; }
        m->excuse=0;
        return;
    }
    codeword(m,cw);
    m->word++;
}

/* ---- slicer, one filtered sample y: the level r flips when y passes
 * +/- num/8 of its peak (fast attack, slow decay) and holds in between,
 * whether y droops or not. The feedback slicers the first builds also ran
 * (baseline put back from the decisions) read nothing on the radio
 * (2026-10-13: "ok 0 0 0 32 32", only the 1/4 and 1/2 hysteresis ones) and
 * were removed; test/model_rx.py still has them ("q"). Then the DPLL: a bit
 * at each phase wrap (mid-bit), changes of level pulled to mid-phase. ---- */
static void slice(sl_t *m,int32_t y){
    int32_t a=y<0?-y:y;
    if(a>m->amp) m->amp+=(a-m->amp)>>2;
    else m->amp-=m->amp>>10;
    int32_t t=(m->amp*m->num)>>3;
    int32_t r=m->rprev;                   /* holds between the thresholds */
    if(y>t) r=1;
    else if(y<-t) r=-1;
    /* changes of level pulled to mid-bit + half a sample: 36864 at 1200 bauds */
    m->phase+=m->step;
    if((r>0)!=(m->rprev>0)) m->phase+=(32768+(m->step>>1)-m->phase)>>PLL_SHIFT;
    m->rprev=r;
    if(m->phase>=65536){
        m->phase-=65536;
        seqBit(m,r<=0);                   /* the lower frequency is a 1 */
    }
}

static int32_t cap(unsigned v,unsigned max){ return (int32_t)(v>max?max:v); }

/* ---- display ---- */
__attribute__((noinline))
static void draw(void){
    const app_api_t *A=g.A;
    /* The UI texts live in the assets: one read into this word-aligned stack
     * block, so each text costs a 2-byte sp-relative add instead of a literal
     * and its pool word (gen_assets.py keeps every offset aligned). */
    char s[UI_SIZE] __attribute__((aligned(4)));
    char *o;
    const page_t *p=g.history[g.cur];    /* read only when there is a page */
    uint8_t *b=A->fb[0];
    unsigned lim=0;
    A->asset_read(0,s,UI_SIZE);
    A->display_clear();
    A->status_clear();
    A->print_inverse(s+T_TITLE,2,0,true,true,(uint8_t)(2u+T_TITLE_CHARS*4u));
    A->draw_battery();
    if(g.tones) A->asset_read(BMP_TONE,A->status_line+TONE_X,BMP_TONE_LEN);   /* key 4 on */

    if(g.count){
        /* the address in bold on line 0, and at its right two capsules as in
         * APRS RX: once several pages are kept, "2/10" at the edge (the page
         * shown / the pages kept, 1 = newest), left of it the pages received.
         * A capsule of n characters starts its text at end - 4n. */
        *puti(str,(int32_t)p->ric)='\0';
        A->print_bold(str,0,0,0);
        unsigned capsEnd=CAPS_END;
        if(g.count>1u){
            o=puti(str,g.cur+1); *o++='/'; o=puti(o,g.count); *o='\0';
            capsEnd-=4u*(unsigned)(o-str);
            A->print_inverse(str,(uint8_t)capsEnd,0,false,true,CAPS_END);
            capsEnd-=4u;                  /* that capsule and a blank column */
        }
        o=puti(str,g.nOk); *o='\0';
        A->print_inverse(str,(uint8_t)(capsEnd-4u*(unsigned)(o-str)),0,false,true,(uint8_t)capsEnd);

        /* the text, wrapped every 18 or 32 characters; row r of the text goes
         * to screen row r - top, shown when that is one of the rows the view
         * has (the compact view never scrolls: top = 0) */
        unsigned w=ROW_CHARS+g.cw, rows=0;
        for(unsigned i=0;i<p->len;i+=w,rows++){
            unsigned n=p->len-i, r=rows-g.top;       /* wraps above the screen */
            if(n>w) n=w;
            for(unsigned j=0;j<n;j++){        /* a character no slicer read: '?' */
                char ch=p->text[i+j];
                str[j]=(uint8_t)ch==GAP?'?':ch;
            }
            str[n]='\0';
            if(g.cw){ if(r<4u) A->print_tiny(str,0,(uint8_t)(8u+r*6u),false,true); }
            else if(r<ROWS) A->print_normal(str,0,0,(uint8_t)(1u+r));
        }
        if(!p->len){
            /* No text: "Tone Only" (an address alone) or "Text Lost"
             * (characters came, none was read) in a capsule of the normal
             * font, centred under the address. Its rows are bit 7 of line 1
             * and the whole of line 2: a blank row above and below the 7-row
             * characters. Its ends are cut as print_inverse's. */
            unsigned x=NOTEXT_X;
            A->print_normal(s+(p->text[0]?T_LOST:T_TONE),(uint8_t)x,0,2);
            b[256u+x-1u]^=0x7Fu;
            for(;x<NOTEXT_X+7u*NOTEXT_CHARS;x++){ b[128u+x]^=0x80u; b[256u+x]^=0xFFu; }
            b[256u+x]^=0x7Fu;
        }
        if(!g.cw && rows>ROWS) lim=rows-ROWS;
    }
    g.lim=(uint8_t)lim;
    /* Status bar from SPK_X: the speaker icon while on, an up mark while rows
     * or a newer page hide above, a down mark while rows or an older page hide
     * below: UP / DOWN has something to show. */
    unsigned t=g.spk;
    if(g.top || g.cur) t+=2u;
    if(g.top<lim || g.cur+1u<g.count) t+=4u;
    A->asset_read((uint16_t)(BMP_TAIL+t*TAIL_W),A->status_line+SPK_X,TAIL_W);

    /* dotted separator above the frequency: y = 31, bit 7 of line 3 (the big
     * digits start at y = 33: one blank px between) */
    for(unsigned x=0;x<128u;x+=2u) b[384u+x]|=0x80u;
    g.A->draw_frequency(A->rx_freq(),0,4);   /* the main screen's big digits, lines 4-5 */

    /* bottom line: "-89dBm  func 3  last 02m15", the level of the page shown,
     * its function (0-3), the time since it came: "02m15" (minutes, seconds)
     * under an hour, then "03h07" (hours, minutes), as ATIS RX. print_tiny
     * does not clip: "-120dBm  func 3  last 1193h02" is 30 characters of 32. */
    o=str;
    if(g.count && !g.dbg){
        uint32_t age=A->ticks_ms()-p->t;
        uint32_t mn=sub(&age,60000u);
        o=puti(o,p->rssi); o=put(o,s+T_DBM);
        *o++=(char)('0'+p->func); o=put(o,s+T_LAST);
        if(mn>=60u){
            unsigned h=sub(&mn,60u);
            o=h<100u?put2(o,h):puti(o,(int32_t)h);
            *o++='h';
            o=put2(o,mn);
        } else {
            o=put2(o,mn); *o++='m';
            o=put2(o,sub(&age,1000u));
        }
    }
    else {
        /* no page yet, or key 3: the rate of the last preamble heard, then what
         * each lane reads, "pre 512 1200:0/0 512:3/96": sync codewords found
         * by its slicers / good codewords of its three slicers. "pre -" until
         * a preamble; 2400 is told, not decoded. 31 characters at most, the
         * values held at 99 and 999. */
        o=put(o,s+T_PRE);
        if(g.preRate) o=puti(o,g.preRate); else *o++='-';
        for(unsigned l=0;l<NLANE;l++){
            unsigned ok=0;
            for(unsigned k=0;k<NSL;k++) ok+=g.sl[l*NSL+k].ok;
            *o++=' ';
            o=puti(o,l?512:1200); *o++=':';
            o=puti(o,cap(g.nSync[l],99u)); *o++='/';
            o=puti(o,cap(ok,999u));
        }
    }
    *o='\0';
    A->print_tiny(str,0,49,false,true);
}

/* ---- input ---- */
static void handleKeys(void){
    uint8_t key=g.A->get_key();
    if(key==APP_KEY_INVALID||key==g.prevKey){ g.prevKey=key; return; }
    g.prevKey=key;
    g.redraw|=REDRAW_ON;
    /* UP/DOWN: the text a row up / down while it overflows; at an end: the
     * newer (UP) or older (DOWN) page, from its first row. Raw KEY_UP is UP on
     * K5 and LEFT on K1; KEY_DOWN is DOWN / RIGHT (as APRS RX). */
    int d=(key==APP_KEY_DOWN)-(key==APP_KEY_UP);
    if(d){
        unsigned top=(unsigned)(g.top+d);  /* wraps past the first row */
        if(top<=g.lim) g.top=(uint8_t)top;
        else if((unsigned)(g.cur+d)<g.count){ g.cur=(uint8_t)(g.cur+d); g.top=0; }
    }
    else if(key==APP_KEY_EXIT) g.running=false;
    else if(key==APP_KEY_2){
        g.count=g.cur=0; g.nOk=0; g.top=0;
        g.nSync[0]=g.nSync[1]=0; g.preRate=0;
        for(unsigned k=0;k<NLANE*NSL;k++) g.sl[k].ok=0;
    }
    else if(key==APP_KEY_3) g.dbg^=1u;   /* bottom line: the page's level and age / the counters */
    else if(key==APP_KEY_4) g.tones^=1u;   /* keep the pages without text (saved) */
    else if(key==APP_KEY_1) g.spk^=1u;   /* speaker: listen() switches it at the next slot */
    else if(key==APP_KEY_STAR){ g.cw^=CW_COMPACT; g.top=0; }   /* the view (saved on exit) */
}

/* ---- keys and screen, between batches ---- */
static void house(void){
    const app_api_t *A=g.A;
    handleKeys();
    if(!g.running) return;
    if(g.redraw&REDRAW_FRAME) A->backlight_on();   /* wake on a new page */
    A->backlight_update();     /* normal BLTime timeout; keys re-arm it in get_key() */
    if(++g.refresh>=REFRESH_SLOTS) g.redraw|=REDRAW_ON;
    if(!g.redraw) return;
    g.redraw=0;
    g.refresh=0;
    A->battery_sample();         /* yields the capture's ADC itself */
    draw();
    A->blit_status();
    A->blit_full();
}

/* ---- the rate of a preamble (model_rx.py, RateFinder): called each sample
 * with whether the first 1200-baud slicer flipped. The samples between two
 * flips are classed, 4, 8 and 18.75 a bit at 9.6 kHz: 3-5 for 2400 bauds,
 * 6-10 for 1200, 15-23 for 512; PRE_RUNS flips in a row in one class are a
 * preamble at that rate. Noise and data runs of several bits do not keep one
 * class that long. ---- */
static void rateFind(bool flipped){
    if(g.rfRun<255u) g.rfRun++;
    if(!flipped) return;
    unsigned r=g.rfRun, c=0;
    if(r-3u<=2u) c=2400u;
    else if(r-6u<=4u) c=1200u;
    else if(r-15u<=8u) c=512u;
    g.rfRun=0;
    if(c && c==g.rfCls){
        if(g.rfStreak<PRE_RUNS && ++g.rfStreak==PRE_RUNS) g.preRate=(uint16_t)c;
    } else {
        g.rfCls=(uint16_t)c;
        g.rfStreak=1;
    }
}

/* ---- the receiver: PA4 at 9.6 kHz, continuously, until EXIT ---- */
__attribute__((noinline))
static void listen(void){
    const app_api_t *A=g.A;
    sl_t sl[NLANE*NSL];
    int32_t box4[4], box8[BOX_512], sum4=0, sum8=0, dc=(int32_t)(BIAS_CODE<<4);
    unsigned bi=0;
    memset(sl,0,sizeof sl);
    memset(box4,0,sizeof box4);
    memset(box8,0,sizeof box8);
    for(unsigned k=0;k<NLANE*NSL;k++){
        sl_t *m=&sl[k];
        m->num=(uint8_t)(2u+k%NSL);       /* 2/8, 3/8, 4/8 in each lane */
        m->word=HUNT;
        m->lane=(uint8_t)(k>=NSL);
        m->step=(uint16_t)(m->lane?STEP_512:STEP_1200);
        m->dup=(uint16_t)(m->lane?DUP_512:DUP_1200);
    }

    g.sl=sl;
    /* The two per-sample services, held in registers: their table slots lie
     * past the ldr immediate range. */
    uint32_t (*const clk)(void)=g.A->cycles_48mhz;
    uint16_t (*const sample)(void)=g.A->af_capture_sample;
    uint32_t next=clk();             /* the first sample at once */
    uint16_t cnt=0;
    g.redraw=REDRAW_ON;
    while(g.running){
        while((int32_t)(clk()-next)<0){}
        next+=CYC_PER_SAMPLE;
        g.n++;
        /* DC removal, then the sum of the last 4 samples (half a bit at 1200
         * bauds) and of the last 8 (512 bauds: 18.75 samples a bit) */
        int32_t adc=sample();
        dc+=((adc<<4)-dc)>>8;
        int32_t x=adc-(dc>>4);
        sum4+=x-box4[bi&3u];
        box4[bi&3u]=x;
        sum8+=x-box8[bi];
        box8[bi]=x;
        bi=(bi+1u)&(BOX_512-1u);
        int32_t before=sl[0].rprev;
        for(unsigned k=0;k<NSL;k++) slice(&sl[k],sum4);
        for(unsigned k=NSL;k<NLANE*NSL;k++) slice(&sl[k],sum8);
        rateFind(sl[0].rprev!=before);
        /* green LED: two blinks for a new page, a step every 100 ms, ending off */
        if(++g.ledCnt>=LED_STEP){
            g.ledCnt=0;
            if(g.led){ g.led--; A->led(g.led&1u); }
        }
        if(cnt<HOUSE_EVERY){ cnt++; continue; }
        /* A slot (keys, screen: up to ~15 ms) is due. Outside a batch it is
         * served at once. Inside one it waits for the sync codeword that opens
         * the next batch: every slicer in a batch must have read less than
         * SYNC_SLOT bits of it, so the slot fits in what is left and no page
         * bit is lost; the keys are then read twice a second (once at 512
         * bauds, whose batches last 1.06 s). After BUSY_MAX
         * samples of waiting (slicers that disagree) it is served anyway. */
        bool wait=false;
        for(unsigned k=0;k<NLANE*NSL;k++){
            unsigned w=sl[k].word;
            if(w!=HUNT && (w!=BATCH_WORDS || sl[k].nb>=SYNC_SLOT)) wait=true;
        }
        if(wait && ++g.busyFor<BUSY_MAX) continue;
        g.busyFor=0;
        cnt=0;
        /* Speaker amplifier as key 1 left it, not gated by the squelch (as
         * EPIRB 406, the other RAW app): the hiss tells the RAW audio is there
         * and a transmission is heard as it is. */
        A->audio_path(g.spk);
        house();
        /* The samples the slot took were not read: the bit clocks run on over
         * them and the missing bits are read as zeros, so a slicer inside a
         * batch keeps its codeword alignment; one inside a sync codeword is
         * excused for not finding it (model_rx.py, Demod.skip). */
        while((int32_t)(clk()-next)>=0){
            next+=CYC_PER_SAMPLE;
            g.n++;
            for(unsigned k=0;k<NLANE*NSL;k++){
                if(sl[k].word==BATCH_WORDS) sl[k].excuse=1;
                sl[k].phase+=sl[k].step;
                if(sl[k].phase>=65536){ sl[k].phase-=65536; seqBit(&sl[k],0); }
            }
        }
    }
}

__attribute__((section(".text.entry"),used))
void app_main(const app_api_t *api){
    page_t pages[HISTORY];      /* on the stack: the 4 KiB overlay also holds .bss */
    page_t *history[HISTORY];
    for(unsigned k=0;k<HISTORY;k++) history[k]=&pages[k];
    char text[34];
    g.A=api;
    g.text=text;
    g.history=history;
    /* The overlay loader zeroes g; the first idle key scan records APP_KEY_INVALID. */

    api->af_capture_open();      /* PA4 bias and ADC channel 4, restored by close */
    api->backlight_on();
    /* RAW receive, as EPIRB 406: the bits are the baseband itself, down to a
     * few tens of hertz. RADIO_SetupRegisters puts both registers back on exit. */
    api->bk_write(REG_2B,(uint16_t)((api->bk_read(REG_2B)|0x0700u)&~0x0007u));
    api->bk_write(REG_73,(uint16_t)(api->bk_read(REG_73)|0x0010u));
    api->cfg_load(&g.cw,3);      /* view, speaker, tone-only pages; erased flash
                                    (0xFF) or junk: normal view, speaker off,
                                    tone-only pages dropped */
    if(g.cw!=CW_COMPACT) g.cw=0;
    g.spk=(uint8_t)(g.spk==1u);
    g.tones=(uint8_t)(g.tones==1u);   /* a 2-byte config from an older version: off */
    /* Speaker amplifier (PA8) as saved, off by default: PA4 joins the audio
     * before the amplifier (APRS RX); only the BK4829 AF output must be on.
     * Key 1 switches the speaker, through listen(). */
    api->set_af(APP_AF_FM);
    api->delay_ms(50);

    g.running=true;
    listen();

    api->af_capture_close();
    api->set_af(APP_AF_MUTE);
    api->audio_path(false);
    api->led(false);             /* not left on in the middle of a blink */
    api->cfg_save(&g.cw,3);      /* staged: flash is written only after a change */
}

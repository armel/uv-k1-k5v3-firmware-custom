/* Copyright 2026 Johan Denoyer F4WAT
 * https://github.com/jdenoy
 *
 * Licensed under the Apache License, Version 2.0 (the "License");
 * you may not use this file except in compliance with the License.
 * You may obtain a copy of the License at
 *
 *     http://www.apache.org/licenses/LICENSE-2.0
 *
 *     Unless required by applicable law or agreed to in writing, software
 *     distributed under the License is distributed on an "AS IS" BASIS,
 *     WITHOUT WARRANTIES OR CONDITIONS OF ANY KIND, either express or implied.
 *     See the License for the specific language governing permissions and
 *     limitations under the License.
 */

/* QR Map: a position handed off by another app, shown as a QR code that a
 * phone scans to open it on a map.
 *
 * Hand-off message (API level 3, handoff / handoff_read), little-endian:
 *   bytes 0-3   latitude,  int32, centi-arcseconds, north positive (+-90 degrees)
 *   bytes 4-7   longitude, int32, centi-arcseconds, east positive (+-180 degrees)
 *   bytes 8-31  optional label, ASCII, up to the message end or a NUL
 * Centi-arcseconds are the unit the sonde decoders and EPIRB 406 keep their
 * positions in: a sender hands its own latS / lonS over unchanged. The
 * label (a beacon ID, a callsign...) is shown beside the code, not encoded.
 * Shorter than 8 bytes, out of range, or launched from the Apps menu: a
 * "no position" page.
 *
 * The code holds the position in the format chosen with UP/DOWN (or 1-5),
 * remembered: a Google Maps link (the default: Android and iOS), an Apple
 * Maps link (iOS), a geo: URI (Android map apps), an OpenStreetMap link with
 * a marker, or the bare decimal degrees. Version 3-L
 * (qr.c), 2 pixels per module: 58 x 58 pixels over the whole LCD height,
 * status line included, about 13 mm wide.
 *
 * EXIT launches the sender again (handoff, no payload), which is how EPIRB
 * 406 comes back. A long EXIT press ends the chain on the main screen.
 *
 * Keys: UP/DOWN  format   1-5  format directly   EXIT  back to the sender
 */
#include <stdint.h>
#include <stdbool.h>
#include <stddef.h>
#include "../app_api.h"
#include "qrmap_assets.h"     /* generated by gen_assets.py */

#include "qr.c"

#define POS_LEN    8u                          /* latitude, longitude    */
#define LABEL_MAX  (APP_HANDOFF_MAX-POS_LEN)
#define LABEL_SHOW 15u                         /* 60 px of tiny font     */
#define CAS_DEG    360000u                     /* centi-arcseconds per degree */
#define LAT_MAX    (90*(int32_t)CAS_DEG)
#define LON_MAX    (180*(int32_t)CAS_DEG)
#define QR_X       4u                          /* left column of the code */
#define QR_Y       3u                          /* top row, status line = rows 0-7 */
#define PANEL_X    68u                         /* text beside the code   */
#define TICK_MS    20u
#define SLOW_TICKS 50u                         /* battery and backlight: 1 s */

static struct {
    const app_api_t *A;
    int32_t lat, lon;
    uint8_t fmt, prevKey;
    bool pos;
    char label[LABEL_MAX+1u];
    char from[APP_NAME_LEN+1u];                /* the sender, "" from the menu */
} g;

/* ---- formatting ---- */
static char *put(char *o, const char *s){ while (*s) *o++ = *s++; return o; }
static const char *next(const char *s){ while (*s++) {} return s; }

/* Centi-arcseconds to decimal degrees, 6 decimals rounded: "-48.123456".
 * 0.01" is 2.8e-6 degree, so the text is within 0.5e-6 degree (5 cm) of the
 * position received, far below what a beacon or a sonde resolves. */
static char *putDeg(char *o, int32_t v){
    const uint64_t q = g.A->uidivmod((uint32_t)(v < 0 ? -v : v), CAS_DEG);
    const uint32_t deg = (uint32_t)q;
    /* rest x 1e6 / 360000 = rest x 25 / 9, to the nearest (9 is odd: no tie);
     * at most 999997 for a rest of 359999: never a carry into the degrees */
    const uint32_t micro = (uint32_t)g.A->uidivmod((uint32_t)(q >> 32) * 25u + 4u, 9u);
    if (v < 0 && (deg || micro)) *o++ = '-';
    o = g.A->append_u32(o, deg);
    o = g.A->append_u32(o, micro + 1000000u);             /* "1" + 6 digits */
    o[-7] = '.';
    return o;
}

/* The text the code holds, from a T_FMT entry: name, prefix, separator. */
static unsigned qrText(char *t, const char *e){
    const char *pre = next(e), *mid = next(pre);
    char *o = put(t, pre);
    o = putDeg(o, g.lat);
    o = put(o, mid);
    o = putDeg(o, g.lon);
    return (unsigned)(o - t);
}

/* ---- drawing ---- */
/* Screen rows 0-7 are the status line, 8-63 the frame buffer. */
static void pixel(unsigned x, unsigned y){
    uint8_t *p = y < 8u ? g.A->status_line : g.A->fb[(y >> 3) - 1u];
    p[x] |= (uint8_t)(1u << (y & 7u));
}

static void text(uint16_t at, uint16_t len, uint8_t y){
    char b[TEXT_MAX];
    g.A->asset_read(at, b, len);
    g.A->print_tiny(b, PANEL_X, y, false, true);
}

static void noPosition(void){
    char b[T_NOPOS_LEN];
    const char *p = b;
    g.A->asset_read(T_NOPOS, b, sizeof b);
    for (uint8_t y = 0; y < NOPOS_LINES * 7u; y += 7u, p = next(p))
        g.A->print_tiny(p, 0, y, false, true);
}

static void draw(void){
    const app_api_t *A = g.A;
    A->display_clear();
    A->status_clear();
    if (!g.pos) {
        noPosition();
    } else {
        char e[T_FMT_STRIDE], t[QR_MAX + 1u], line[24];   /* t: the longest is 49 */
        uint32_t m[QR_N];
        A->asset_read((uint16_t)(T_FMT + g.fmt * T_FMT_STRIDE), e, sizeof e);
        qr_encode((const uint8_t *)t, qrText(t, e), m);
        for (unsigned y = 0; y < QR_N; y++)
            for (unsigned x = 0; x < QR_N; x++)
                if ((m[y] >> x) & 1u)
                    for (unsigned k = 0; k < 4u; k++)
                        pixel(QR_X + 2u * x + (k & 1u), QR_Y + 2u * y + (k >> 1));

        /* "2/4 GOOGLE", the position, the label, the keys */
        char *o = A->append_u32(line, g.fmt + 1u);
        *o++ = '/'; *o++ = (char)('0' + N_FMT); *o++ = ' ';
        *put(o, e) = '\0';
        A->print_tiny(line, PANEL_X, 0, false, true);
        for (unsigned i = 0; i < 2u; i++) {
            A->asset_read(i ? T_LON : T_LAT, line, T_LAT_LEN);
            *putDeg(line + T_LAT_LEN - 1u, i ? g.lon : g.lat) = '\0';
            A->print_tiny(line, PANEL_X, (uint8_t)(10u + 7u * i), false, true);
        }
        A->print_tiny(g.label, PANEL_X, 27, false, true);
        text(T_KEYS, T_KEYS_LEN, 42);
        if (g.from[0]) text(T_BACK, T_BACK_LEN, 49);
        else           text(T_QUIT, T_QUIT_LEN, 49);
    }
    A->draw_battery();
    A->blit_status();
    A->blit_full();
}

/* ---- the hand-off message ---- */
static void readMessage(void){
    union { int32_t pos[2]; uint8_t b[APP_HANDOFF_MAX]; } msg;
    const int16_t n = g.A->handoff_read(msg.b, sizeof msg.b, g.from);
    if (n < (int16_t)POS_LEN) return;            /* -1: from the menu */
    g.lat = msg.pos[0];
    g.lon = msg.pos[1];
    g.pos = g.lat >= -LAT_MAX && g.lat <= LAT_MAX && g.lon >= -LON_MAX && g.lon <= LON_MAX;
    unsigned len = (unsigned)n - POS_LEN;
    if (len > LABEL_SHOW) len = LABEL_SHOW;
    for (unsigned i = 0; i < len && msg.b[POS_LEN + i]; i++) {
        const uint8_t c = msg.b[POS_LEN + i];
        g.label[i] = (char)(c >= 0x20u && c < 0x7Fu ? c : '?');   /* the font's range */
    }
}

__attribute__((section(".text.entry"),used))
void app_main(const app_api_t *api){
    g.A = api;                   /* the rest of g starts at 0 (overlay zeroed by the loader) */
    g.prevKey = APP_KEY_INVALID;
    readMessage();
    api->cfg_load(&g.fmt, 1);
    if (g.fmt >= N_FMT) g.fmt = 0;               /* erased flash: Google Maps */
    api->backlight_on();
    draw();

    for (unsigned tick = 0;; tick++) {
        const uint8_t key = api->get_key();
        if (key != g.prevKey) {
            g.prevKey = key;
            if (key == APP_KEY_EXIT) break;
            const int8_t d = api->nav_dir(key);
            if (d) {
                const int f = g.fmt + d;               /* wraps, no division */
                g.fmt = (uint8_t)(f < 0 ? (int)N_FMT - 1 : f >= (int)N_FMT ? 0 : f);
            }
            else if (key >= APP_KEY_1 && key <= N_FMT) g.fmt = (uint8_t)(key - APP_KEY_1);
            if (key != APP_KEY_INVALID && key != APP_KEY_SAVER) draw();
        }
        /* held lit while the code is shown, for the phone camera */
        if (tick >= SLOW_TICKS) {
            tick = 0;
            api->backlight_on();
            api->battery_sample();
            api->draw_battery();
            api->blit_status();
        }
        api->delay_ms(TICK_MS);
    }

    api->cfg_save(&g.fmt, 1);
    if (g.from[0]) api->handoff(g.from, NULL, 0);
}

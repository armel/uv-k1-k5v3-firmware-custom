/* Copyright 2026 Johan Denoyer F4WAT
 * https://github.com/jdenoy
 *
 * Based on the ATIS RX overlay app by Armel F4HWN (its receive path).
 *
 * Licensed under the Apache License, Version 2.0 (the "License");
 * you may not use this file except in compliance with the License.
 * You may obtain a copy of the License at
 *
 *     http://www.apache.org/licenses/LICENSE-2.0
 *
 *     Unless required by applicable law or agreed to in writing, software
 *     distributed under the License is distributed on an "AS IS" BASIS,
 *     WITHOUT WARRANTIES OR CONDITIONS OF ANY KIND, either express or implied.
 *     See the License for the specific language governing permissions and
 *     limitations under the License.
 */

/*
 * ATIS DSC RX - receives the VHF Digital Selective Calling of marine channel 70
 * (156.525 MHz; ITU-R M.493: 1200 bauds, 1300 / 2100 Hz, ten-unit code, DX/RX
 * time diversity) and keeps the last six calls, shown one at a time: what the
 * call is (distress, distress acknowledgement or relay, urgency, safety,
 * routine, test), who sent it (MMSI, country), to whom, and for a distress the
 * nature, the position and the time. A new distress or urgency call flashes
 * the screen and the LED and beeps, three times.
 * Tune the VFO (FM) to channel 70, or to 433.650 MHz for the Flipper Zero bench
 * files of test/flipper_dsc.py, then launch. Receive only.
 *
 * The receive path is ATIS RX's (atisrx_app.c): ATIS is a DSC call with format
 * specifier 121, so the band-pass, the 1300/2100 Hz sliding correlators, the
 * per-tone AGC, the three slicers and their DPLL are the same, and so is the
 * hunt for the phasing sequence. The sequence decoder differs (test/model_dsc.py,
 * class Slicer: keep the two in step): a call has a variable length, so each
 * slicer reads symbols until an end of sequence (117, 122, 127) shows at
 * character 8 or later, from its DX copy, or from its RX copy when the DX one
 * failed; the call ends with the RX copy of the error check, 7 (or 2) symbols
 * later, the earliest such end winning. Then each character from its DX copy,
 * else its RX copy; no earlier end of sequence, a known format specifier and
 * the error check must hold. The fields are read from the call at draw time.
 *
 * Keys (UV-K5 and UV-K1): UP/DOWN the newer / older call · 1 speaker on/off
 *   (saved, off by default; while on, the squelch gates it) · 2 clear · EXIT quit.
 * The loader re-runs RADIO_SetupRegisters on exit; the resident capture
 * (af_capture_close) restores the ADC, PA4, the DAC and its clock.
 */

#include <stdint.h>
#include <stdbool.h>
#include <stddef.h>
#include "../app_api.h"
#include "atisdscrx_assets.h"      /* generated by gen_assets.py */

/* ---- sampling (ATIS RX) ---- */
#define BIAS_CODE      2048u
#define FS             9600u
#define CYC_PER_SAMPLE (48000000u / FS)            /* 5000 */
#define HOUSE_EVERY    480u    /* samples between key/screen slots (50 ms)       */
#define BUSY_MAX       20u     /* serve them anyway after 20 busy slots (1 s)    */
#define REFRESH_SLOTS  100u    /* 100 housekeeping slots = 5 s (battery, age)    */
#define REDRAW_ON      1u      /* g.redraw: a key or the periodic refresh        */
#define REDRAW_FRAME   2u      /* g.redraw: a call, also wakes the backlight     */
#define DUP_MS         1000u   /* the same call from another slicer              */
#define BEEP_HZ        1800u   /* a new distress or urgency call: ALERTS times   */
#define BEEP_MS        200u    /* the screen inverted, the LED and a beep, then  */
#define GAP_MS         150u    /* the screen back, LED off, a pause              */
#define ALERTS         3u

/* ---- demodulator (atisrx/test/model_rx.py, class Demod) ---- */
#define BP_B0       5391
#define BP_A1     (-10336)
#define BP_A2       5603
#define AGC_ATT     5
#define AGC_DEC     10
#define PK_MIN      16
#define PLL_STEP    8192
#define PLL_CTR     36864
#define PLL_SHIFT   3
#define NSL         3

/* ---- DSC call sequence (test/dsc.py) ----
 *   DX 125 x6   A  A  I1 I2 ... In  EOS ECC EOS EOS
 *   RX 111..104       A  A  I1 ...  In  EOS ECC
 * The DX copy of character k (A = 0) is the symbol INFO0 + 2k of the stream,
 * its RX copy comes RX_LAG later. */
#define INFO0       14u
#define RX_LAG      5u
#define SLOTS       64u    /* stream symbols kept from INFO0: 30 characters */
#define MIN_EOS     8u     /* the earliest character an end of sequence can be */
#define SYM_DX      125u
#define SYM_BAD     255u
#define CALL_MAX    29u    /* characters A..EOS kept per call */
#define HISTORY     6u

/* end of sequence: 117 acknowledgement requested, 122 given, 127 other */
static bool isEos(unsigned v){ return v==127u || v==122u || v==117u; }

typedef struct {
    uint8_t  c[CALL_MAX];              /* A .. EOS                                */
    uint8_t  len;
    uint8_t  n;                        /* times heard, up to 255                  */
    int16_t  rssi;
    uint32_t t;                        /* ticks_ms when last heard                */
} call_t;

typedef struct {
    int32_t  dc;
    int32_t  x1, x2, y1, y2;
    int32_t  iy, qy, ib, qb;
    int32_t  py, pb;
    uint32_t r, ky, kb;
    int16_t  ring[8][4];
    int8_t   cy[COS1300_LEN], cb[COS2100_LEN];
} dem_t;
_Static_assert(COS2100==COS1300+COS1300_LEN && COS1300==DEMOD_INIT+DEMOD_INIT_LEN &&
               offsetof(dem_t,cy)==DEMOD_INIT_LEN &&
               offsetof(dem_t,cb)==offsetof(dem_t,cy)+COS1300_LEN &&
               sizeof(dem_t)==DEMOD_INIT_LEN+COS1300_LEN+COS2100_LEN,
               "demodulator initialization asset must match dem_t");
_Static_assert(BIAS_CODE==2048u && offsetof(dem_t,py)==36u && offsetof(dem_t,pb)==40u,
               "gen_assets.py DEMOD_INIT layout");
_Static_assert(COS2100_LEN==32u, "the 2100 Hz phase wraps with a mask");

/* one slicer: decision weights, DPLL, sequence decoder */
typedef struct {
    int32_t  dprev, phase;
    uint32_t sr;                       /* the last 30 bits, the oldest in bit 0   */
    uint8_t  wa, wb;
    uint8_t  idx;                      /* stream index of the last symbol read;
                                          0 = hunting the phasing sequence        */
    uint8_t  nb;                       /* bits of the symbol being read           */
    uint8_t  end;                      /* stream index of the ECC's RX copy; 0 = not known yet */
    uint8_t  buf[SLOTS];               /* symbols INFO0 ..                        */
} sl_t;

static struct {
    uint8_t  prevKey, redraw;
    bool     running;
    uint8_t  count, cur;               /* calls kept, call shown (0 = newest)     */
    uint8_t  spk;                      /* the saved setting: speaker on (key 1)   */
    uint8_t  refresh;
    uint8_t  alert;                    /* a new distress / urgency call: beep     */
    uint16_t nOk;                      /* calls received                          */
    const app_api_t *A;
    char *text;                        /* formatting buffer (app_main's stack)    */
    uint32_t tHit;
    call_t   h[HISTORY];               /* newest first                            */
} g;
#define str g.text

void *memset(void *d, int c, size_t n) {
    uint8_t *p = d; while (n) p[--n] = (uint8_t)c; return d;
}
void *memcpy(void *d, const void *s, size_t n) {
    uint8_t *p = d; const uint8_t *q = s;
    while (n) { --n; p[n] = q[n]; } return d;
}

/* ---- formatting ---- */
__attribute__((noinline))
static char *put(char *o,const char *s){ while(*s)*o++=*s++; return o; }
static unsigned sub(uint32_t *v,uint32_t d){ unsigned q=0; while(*v>=d){ *v-=d; q++; } return q; }
__attribute__((noinline))
static char *puti(char *o,int32_t v){ return g.A->append_i32(o,v); }
__attribute__((noinline))
static char *put2(char *o,uint32_t v){ *o++=(char)('0'+sub(&v,10u)); *o++=(char)('0'+v); return o; }
/* n symbols as 2n digits; '?' pairs for a symbol above 99 */
__attribute__((noinline))
static char *putDigits(char *o,const uint8_t *s,unsigned n){
    while(n--){
        unsigned v=*s++;
        if(v>99u){ *o++='?'; *o++='?'; }
        else o=put2(o,v);
    }
    return o;
}

#define WAIT_CAPS_X 40u
#define SPK_X       59u
#define CAPS_END    127u
#define CH_X        108u

/* Marine VHF channel of a ship-station frequency (10 Hz units), 0 when it is
 * not one (atisrx_app.c). */
static unsigned channel(uint32_t f){
    f-=15602500u;
    if(f>142500u) return 0;
    unsigned k=sub(&f,2500u);
    if(f) return 0;
    return (k&1u) ? 1u+(k>>1) : 60u+(k>>1);
}

/* ---- a valid call from a slicer: it goes (back) to the front of the
 * history, unless another slicer just gave this very call ---- */
static void accept(const uint8_t *c,unsigned len){
    const app_api_t *A=g.A;
    uint32_t t=A->ticks_ms();
    call_t e;
    unsigned j=0;
    for(;j<g.count;j++){
        unsigned k=0;
        if(g.h[j].len!=len) continue;
        while(k<len && g.h[j].c[k]==c[k]) k++;
        if(k==len) break;
    }
    if(j<g.count){
        if(!j && t-g.tHit<DUP_MS) return;
        e=g.h[j];
    } else {
        memset(&e,0,sizeof e);
        memcpy(e.c,c,len);
        e.len=(uint8_t)len;
        if(g.count<HISTORY) g.count++;
        j=g.count-1u;
    }
    for(;j;j--) g.h[j]=g.h[j-1u];
    if(e.n<255u) e.n++;
    e.rssi=A->rssi_dbm();
    e.t=t;
    g.h[0]=e;
    g.tHit=t;
    g.nOk++;
    g.cur=0;
    g.redraw|=REDRAW_FRAME;
    /* distress (format 112, or category 112) and urgency (category 110): the
     * category follows the format, or the 5-symbol address */
    unsigned cat=c[c[0]==116u ? 1u : 6u];
    if(c[0]==112u || cat==112u || cat==110u) g.alert=1;
}

/* Symbol of a 10-bit word (atisrx_app.c) */
__attribute__((noinline))
static unsigned sym(uint32_t w){
    unsigned v=w&127u, zeros=7u;
    for(unsigned i=0;i<7u;i++) zeros-=(v>>i)&1u;
    unsigned chk=((w>>7)&1u)*4u+((w>>8)&1u)*2u+((w>>9)&1u);
    return chk==zeros ? v : SYM_BAD;
}

/* r: the buffer slot of the ECC's RX copy. Each character from its DX copy,
 * else its RX copy; no end of sequence before the last one, a known format
 * specifier, the error check (the XOR of A..ECC is 0). */
static void finish(const sl_t *m,unsigned r){
    uint8_t c[CALL_MAX+1u];
    unsigned n=((r-RX_LAG)>>1)+1u, x=0;      /* A .. ECC */
    for(unsigned k=0;k<n;k++){
        unsigned v=m->buf[2u*k];
        if(v==SYM_BAD) v=m->buf[2u*k+RX_LAG];
        if(v==SYM_BAD) return;
        if(k && k+2u<n && isEos(v)) return;
        c[k]=(uint8_t)v;
        x^=v;
    }
    unsigned f=c[0];
    if(x || !(f==102u || f==112u || f==114u || f==116u || f==120u || f==123u)) return;
    accept(c,n-1u);
}

/* ---- sequence decoder, one bit (1 = Y, the lower tone). Hunting as ATIS RX;
 * then one symbol every 10 bits until the end of the call. ---- */
__attribute__((noinline))
static void seqBit(sl_t *m,uint32_t b){
    uint32_t sr=(m->sr>>1)|(b<<29);
    m->sr=sr;
    unsigned s2=sym(sr>>20);
    unsigned idx=m->idx;
    if(!idx){
        if(s2==SYM_BAD) return;
        unsigned s0=sym(sr&1023u), s1=sym((sr>>10)&1023u);
        if(s0==SYM_DX && s2==SYM_DX && s1-104u<8u) idx=2u*(111u-s1)+2u;
        else if(s1==SYM_DX && s2-104u<7u && s0==s2+1u) idx=2u*(111u-s2)+1u;
        else return;
        m->nb=0;
        m->end=0;
        memset(m->buf,(int)SYM_BAD,sizeof m->buf);
    } else {
        if(++m->nb<10u) return;
        m->nb=0;
        idx++;
    }
    m->idx=(uint8_t)idx;
    if(idx<INFO0) return;
    unsigned r=idx-INFO0;
    m->buf[r]=(uint8_t)s2;
    if(isEos(s2)){
        /* the DX copy of character r/2, or the RX copy of character (r-5)/2
         * when its DX copy failed: the ECC's RX copy is 7, or 2, symbols on */
        unsigned e=0;
        if(!(r&1u)){ if(r>=2u*MIN_EOS) e=idx+7u; }
        else if(r>=2u*MIN_EOS+RX_LAG && m->buf[r-RX_LAG]==SYM_BAD) e=idx+2u;
        if(e && (!m->end || e<m->end)) m->end=(uint8_t)e;
    }
    if(idx==m->end){ m->idx=0; finish(m,r); }
    else if(r==SLOTS-1u) m->idx=0;           /* no end of sequence: drop it */
}

static int32_t mag(int32_t i,int32_t q){
    if(i<0) i=-i;
    if(q<0) q=-q;
    if(i<q){ int32_t t=i; i=q; q=t; }
    return i+(q>>2)+(q>>3);
}

__attribute__((noinline))
static int32_t tone(int32_t i,int32_t q,int32_t *pk){
    int32_t mt=mag(i,q), p=*pk;
    p+= mt>p ? (mt-p)>>AGC_ATT : -(p>>AGC_DEC);
    if(p<PK_MIN) p=PK_MIN;
    *pk=p;
    return mt;
}

/* ---- front end, one ADC sample (atisrx_app.c) ---- */
static void front(dem_t *m,int32_t adc,int32_t *a,int32_t *b){
    m->dc+=((adc<<4)-m->dc)>>6;
    int32_t x=adc-(m->dc>>4);
    int32_t y=(BP_B0*(x-m->x2)-BP_A1*m->y1-BP_A2*m->y2)>>14;
    m->x2=m->x1; m->x1=x; m->y2=m->y1; m->y1=y;

    int16_t *o=m->ring[m->r];
    uint32_t ky=m->ky, kb=m->kb;
    uint32_t k=ky+Q_Y; if(k>=COS1300_LEN) k-=COS1300_LEN;
    int32_t p;
    p=(y*m->cy[ky])>>8;                         m->iy+=p-o[0]; o[0]=(int16_t)p;
    p=(y*m->cy[k])>>8;                          m->qy+=p-o[1]; o[1]=(int16_t)p;
    p=(y*m->cb[kb])>>8;                         m->ib+=p-o[2]; o[2]=(int16_t)p;
    p=(y*m->cb[(kb+Q_B)&(COS2100_LEN-1u)])>>8;  m->qb+=p-o[3]; o[3]=(int16_t)p;
    m->r=(m->r+1u)&7u;
    if(++ky>=COS1300_LEN) ky=0;
    m->ky=ky;
    m->kb=(kb+1u)&(COS2100_LEN-1u);

    int32_t my=tone(m->iy,m->qy,&m->py), mb=tone(m->ib,m->qb,&m->pb);
    *a=my*m->pb;
    *b=mb*m->py;
}

static void slice(sl_t *m,int32_t a,int32_t b){
    int32_t d=a*m->wa-b*m->wb;
    m->phase+=PLL_STEP;
    if((d>0)!=(m->dprev>0)) m->phase+=(PLL_CTR-m->phase)>>PLL_SHIFT;
    m->dprev=d;
    if(m->phase>=65536){
        m->phase-=65536;
        seqBit(m,d>0);
    }
}

/* ---- display ---- */

/* The short name of a code of one kind (gen_assets.py NAMES), else "?code". */
__attribute__((noinline))
static char *putName(char *o,unsigned kind,unsigned code){
    char rec[NAME_STRIDE];
    for(unsigned j=0;j<NAME_COUNT;j++){
        g.A->asset_read((uint16_t)(NAMES+j*NAME_STRIDE),rec,NAME_STRIDE);
        if(rec[0]==(char)code && rec[1]==(char)kind) return put(o,rec+2);
    }
    *o++='?';
    return puti(o,(int32_t)code);
}

/* An MMSI (5 symbols, the tenth digit dropped) and, when it fits, its country:
 * the MID is its first three digits, after the 00 of a coast station or the 0
 * of a group. */
__attribute__((noinline))
static char *putMmsi(char *o,const uint8_t *s,bool country){
    char d[11];
    *putDigits(d,s,5u)='\0';
    d[9]='\0';
    o=put(o,d);
    if(!country) return o;
    const char *m=d;
    if(*m=='0') m++;
    if(*m=='0') m++;
    unsigned mid=(unsigned)(m[0]-'0')*100u+(unsigned)(m[1]-'0')*10u+(unsigned)(m[2]-'0');
    uint16_t mids[MID_COUNT];
    g.A->asset_read(MIDS,mids,sizeof mids);
    for(unsigned j=0;j<MID_COUNT;j++){
        if(mids[j]!=mid) continue;
        char rec[MID_STRIDE];
        g.A->asset_read((uint16_t)(MID_NAME+j*MID_STRIDE),rec,MID_STRIDE);
        *o++=' ';
        return put(o,rec);
    }
    return o;
}

/* One normal-font row of the call view: the text, cut to 18 columns. */
__attribute__((noinline))
static void row(char *end,unsigned *line){
    if(end-str>18) end=str+18;
    *end='\0';
    if(*line<6u) g.A->print_normal(str,0,0,(uint8_t)(*line)++);
}

/* The call shown, rows 1.. below the title: from, to, the distressed vessel,
 * the nature and the time, the position; or the telecommand and channel. */
static void drawCall(const call_t *e,const char *s){
    const uint8_t *c=e->c;
    unsigned fmt=c[0], p=1, line=1, cat=112, tc1=0;
    unsigned len=e->len-1u;                   /* characters before the EOS */
    char *o;
    const uint8_t *to=0;
    if(fmt!=112u){
        if(fmt!=116u){ to=c+p; p+=5; }
        cat=c[p++];
    }
    const uint8_t *from=c+p; p+=5;
    if(p>len) return;
    bool tail=fmt==112u;
    if(!tail){
        tc1=c[p++];
        tail=cat==112u && (tc1==110u || tc1==112u);
    }

    /* title, bold: the telecommand for a distress acknowledgement, relay or
     * test, else the category */
    o=(tail && fmt!=112u) || tc1==118u ? putName(str,K_TC,tc1) : putName(str,K_CAT,cat);
    *o='\0';
    g.A->print_bold(str,0,0,0);

    row(putMmsi(str,from,true),&line);
    if(fmt==116u) row(put(str,s+T_ALL),&line);
    else if(fmt==102u) row(put(str,s+T_AREA),&line);
    else if(to) row(putMmsi(put(str,s+T_TO),to,false),&line);

    if(tail){
        if(fmt!=112u){
            if(p+5u>len) return;
            row(putMmsi(put(str,s+T_MAYDAY),c+p,false),&line);
            p+=5;
        }
        if(p+9u>len) return;                  /* nature, position 5, time 2, subsequent */
        o=putName(str,K_NAT,c[p]);
        const uint8_t *pos=c+p+1u, *utc=c+p+6u;
        if(utc[0]==88u && utc[1]==88u) o=put(o,s+T_NOUTC);
        else { *o++=' '; o=put2(o,utc[0]); *o++=':'; o=put2(o,utc[1]); }
        row(o,&line);
        /* "43 18N 005 22E": quadrant, latitude DDMM, longitude DDDMM */
        char d[11];
        *putDigits(d,pos,5u)='\0';
        o=str;
        if(d[0]=='9' && d[1]=='9' && d[9]=='9') o=put(o,s+T_NOPOS);
        else {
            unsigned q=(unsigned)(d[0]-'0');
            *o++=d[1]; *o++=d[2]; *o++=' '; *o++=d[3]; *o++=d[4];
            *o++= q&2u ? 'S' : 'N'; *o++=' ';
            *o++=d[5]; *o++=d[6]; *o++=d[7]; *o++=' '; *o++=d[8]; *o++=d[9];
            *o++= q&1u ? 'W' : 'E';
        }
        row(o,&line);
    } else {
        /* telecommand 1, then after telecommand 2 a VHF channel when the
         * frequency message starts with a 9: "90 00 16" is channel 16 */
        o=putName(str,K_TC,tc1);
        p++;
        if(p+3u<=len && c[p]/10u==9u && c[p+1u]<100u && c[p+2u]<100u){
            *o++=' ';
            o=puti(put(o,s+T_CH),(int32_t)(c[p+1u]*100u+c[p+2u]));
        }
        row(o,&line);
    }
}

__attribute__((noinline))
static void draw(void){
    const app_api_t *A=g.A;
    char s[UI_SIZE] __attribute__((aligned(4)));
    char *o;
    const call_t *e=&g.h[g.cur];
    uint8_t *b=A->fb[0];
    A->asset_read(0,s,UI_SIZE);
    A->display_clear();
    A->status_clear();
    A->print_inverse(s+T_TITLE,2,0,true,true,(uint8_t)(2u+T_TITLE_CHARS*4u));
    A->draw_battery();

    if(!g.count){
        /* no call yet: the WAIT capsule and the frequency, as ATIS RX */
        A->print_inverse(s+T_WAIT,WAIT_CAPS_X,0,true,true,(uint8_t)(WAIT_CAPS_X+T_WAIT_CHARS*4u));
        for(unsigned x=0;x<128u;x+=2u) b[384u+x]|=0x80u;
        uint32_t f=A->rx_freq();
        A->draw_frequency(f,0,4);
        unsigned ch=channel(f);
        if(ch){
            A->print_tiny(s+T_CH,CH_X+6u,34,false,true);
            *puti(str,(int32_t)ch)='\0';
            A->print_bold(str,CH_X,127,5);
        }
    } else {
        drawCall(e,s);
        /* at the right of the title: the calls received and, once several are
         * kept, "2/6" at the edge (the call shown / the calls kept) */
        unsigned capsEnd=CAPS_END;
        if(g.count>1u){
            o=str; *o++=(char)('1'+g.cur); *o++='/'; *o++=(char)('0'+g.count); *o='\0';
            A->print_inverse(str,CAPS_END-12u,0,false,true,CAPS_END);
            capsEnd-=16u;
        }
        o=puti(str,g.nOk); *o='\0';
        A->print_inverse(str,(uint8_t)(capsEnd-4u*(unsigned)(o-str)),0,false,true,(uint8_t)capsEnd);
    }
    unsigned t=g.spk;
    if(g.cur) t+=2u;
    if(g.cur+1u<g.count) t+=4u;
    A->asset_read((uint16_t)(BMP_TAIL+t*TAIL_W),A->status_line+SPK_X,TAIL_W);

    /* bottom line: "-89dBm  heard 3  last 02m15" (atisrx_app.c) */
    o=str;
    if(g.count){
        uint32_t age=A->ticks_ms()-e->t;
        uint32_t mn=sub(&age,60000u);
        o=puti(o,e->rssi); o=put(o,s+T_DBM);
        o=puti(o,e->n); o=put(o,s+T_LAST);
        if(mn>=60u){
            unsigned h=sub(&mn,60u);
            o=h<100u?put2(o,h):puti(o,(int32_t)h);
            *o++='h';
            o=put2(o,mn);
        } else {
            o=put2(o,mn); *o++='m';
            o=put2(o,sub(&age,1000u));
        }
    }
    *o='\0';
    A->print_tiny(str,0,49,false,true);
}

/* ---- input ---- */
static void handleKeys(void){
    uint8_t key=g.A->get_key();
    if(key==APP_KEY_INVALID||key==g.prevKey){ g.prevKey=key; return; }
    g.prevKey=key;
    g.redraw|=REDRAW_ON;
    unsigned cur=(unsigned)(g.cur+(key==APP_KEY_DOWN)-(key==APP_KEY_UP));
    if(cur<g.count) g.cur=(uint8_t)cur;
    if(key==APP_KEY_EXIT) g.running=false;
    else if(key==APP_KEY_2){ g.count=g.cur=0; g.nOk=0; }
    else if(key==APP_KEY_1) g.spk^=1u;
}

/* ---- keys, alert and screen, between calls ---- */
static void house(void){
    const app_api_t *A=g.A;
    handleKeys();
    if(!g.running) return;
    if(g.redraw&REDRAW_FRAME) A->backlight_on();
    A->backlight_update();
    if(++g.refresh>=REFRESH_SLOTS) g.redraw|=REDRAW_ON;
    if(!g.redraw) return;
    g.redraw=0;
    g.refresh=0;
    A->battery_sample();
    draw();
    A->blit_status();
    A->blit_full();
    if(g.alert){
        /* a new distress or urgency call, now on screen: ALERTS times the
         * screen inverted, the green LED and a beep (the speaker whatever key
         * 1 says), then back. The tone takes the BK4829 off RX for its
         * length: the call is in. */
        g.alert=0;
        uint8_t *f=A->fb[0];
        for(unsigned n=0;n<2u*ALERTS;n++){
            for(unsigned i=0;i<7u*128u;i++) f[i]^=0xFFu;
            A->blit_full();
            if(!(n&1u)){ A->led(true); A->play_tone(BEEP_HZ,BEEP_MS); }
            else { A->led(false); A->delay_ms(GAP_MS); }
        }
        A->tones_off_rx();
        A->set_af(APP_AF_FM);
    }
}

/* ---- the receiver: PA4 at 9.6 kHz, continuously, until EXIT ---- */
__attribute__((noinline))
static void listen(void){
    const app_api_t *A=g.A;
    dem_t d;
    sl_t sl[NSL];
    memset(sl,0,sizeof sl);
    A->asset_read(DEMOD_INIT,&d,sizeof d);
    /* Decision weights 1300 : 2100 Hz (test/model_dsc.py, SLICERS): on six
     * captures of real calls on a UV-K1 (1.5 to 3.5 kHz of deviation), 5:4,
     * 4:3 and 7:5 give 99.5 to 100 % of the bits right; 6:5 and 3:2 fall to
     * 84 % in one of them, 1:1 to 70 %, ATIS RX's 2:3 to about 60 % */
    sl[0].wa=5; sl[0].wb=4;
    sl[1].wa=4; sl[1].wb=3;
    sl[2].wa=7; sl[2].wb=5;

    uint32_t (*const clk)(void)=g.A->cycles_48mhz;
    uint16_t (*const sample)(void)=g.A->af_capture_sample;
    uint32_t next=clk();
    uint16_t cnt=0;
    uint8_t busyFor=0;
    g.redraw=REDRAW_ON;
    while(g.running){
        while((int32_t)(clk()-next)<0){}
        next+=CYC_PER_SAMPLE;
        int32_t a,b;
        front(&d,sample(),&a,&b);
        for(uint8_t k=0;k<NSL;k++) slice(&sl[k],a,b);
        if(++cnt<HOUSE_EVERY) continue;
        cnt=0;
        A->audio_path(g.spk & (A->bk_read(0x0Cu)>>1));
        unsigned bz=0;
        for(uint8_t k=0;k<NSL;k++) bz|=sl[k].idx;
        if(bz && ++busyFor<BUSY_MAX) continue;
        busyFor=0;
        house();
        next=clk();
    }
}

__attribute__((section(".text.entry"),used))
void app_main(const app_api_t *api){
    char text[34];
    g.A=api;
    g.text=text;

    api->af_capture_open();
    api->backlight_on();
    api->cfg_load(&g.spk,1);
    g.spk=(uint8_t)(g.spk==1u);
    api->set_af(APP_AF_FM);
    api->delay_ms(50);

    g.running=true;
    listen();

    api->af_capture_close();
    api->set_af(APP_AF_MUTE);
    api->audio_path(false);
    api->cfg_save(&g.spk,1);
}

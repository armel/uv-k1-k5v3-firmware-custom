/* Copyright 2026 Armel F4HWN
 * https://github.com/armel
 *
 * Licensed under the Apache License, Version 2.0 (the "License");
 * you may not use this file except in compliance with the License.
 * You may obtain a copy of the License at
 *
 *     http://www.apache.org/licenses/LICENSE-2.0
 *
 *     Unless required by applicable law or agreed to in writing, software
 *     distributed under the License is distributed on an "AS IS" BASIS,
 *     WITHOUT WARRANTIES OR CONDITIONS OF ANY KIND, either express or implied.
 *     See the License for the specific language governing permissions and
 *     limitations under the License.
 */

/*
 * ATIS RX - receives the ATIS identification that inland-waterway VHF radios
 * send at the end of each transmission (ETSI EN 300 698 annex B: 1200 bauds,
 * 1300 / 2100 Hz, ten-unit code, DX/RX time diversity) and keeps the last
 * eight stations, shown one at a time: call sign, identity, country. Tune the
 * VFO to the working channel (FM; marine VHF, or 433.650 MHz for the Flipper
 * Zero bench files of test/flipper_atis.py), then launch.
 *
 * The receive path is APRS RX's: the RX audio reaches PA4 (the voice DAC pin),
 * held at mid-scale by the MCU DAC (unbuffered), and is read on ADC channel 4
 * at 9.6 kHz, timed from SysTick, continuously: no RSSI gate, the check bits
 * and the error check sort sequences from noise. Each sample goes through the
 * demodulator modelled and tested in test/model_rx.py: band-pass, 1300/2100 Hz
 * sliding correlators over one bit, per-tone AGC, then 3 slicers (weights 5:4,
 * 4:3, 7:5), each with its DPLL and its sequence decoder. Keep the two in step.
 * Keys and the screen cost sample time (the key scan alone is ~400 us), so they
 * are served every 50 ms only while no slicer is inside a sequence; the redraw
 * follows a new station, a key, or every 5 s (battery, age).
 *
 * Keys (UV-K5 and UV-K1): UP/DOWN the newer / older station · 1 speaker on/off
 *   (saved, off by default: the decoder does not need it; while on, the squelch
 *   gates it) · 2 clear · EXIT quit.
 * The loader re-runs RADIO_SetupRegisters on exit; the resident capture
 * (af_capture_close) restores the ADC, PA4, the DAC and its clock.
 */

#include <stdint.h>
#include <stdbool.h>
#include <stddef.h>
#include "../app_api.h"
#include "atisrx_assets.h"     /* generated by gen_assets.py */

/* ---- sampling: the PA4 capture and the 48 MHz cycle clock are resident
 * (API level 3); the capture holds PA4 at mid-scale (ADC code 2048). ---- */
#define BIAS_CODE      2048u
#define FS             9600u
#define CYC_PER_SAMPLE (48000000u / FS)            /* 5000 */
#define HOUSE_EVERY    480u    /* samples between key/screen slots (50 ms)       */
#define BUSY_MAX       20u     /* serve them anyway after 20 busy slots (1 s)    */
#define REFRESH_SLOTS  100u    /* 100 housekeeping slots = 5 s (battery, age)    */
#define REDRAW_ON      1u      /* g.redraw: a key or the periodic refresh        */
#define REDRAW_FRAME   2u      /* g.redraw: a station, also wakes the backlight  */
#define DUP_MS         1000u   /* the same sequence from another slicer          */

/* ---- demodulator (test/model_rx.py, class Demod) ---- */
#define BP_B0       5391   /* band-pass 1652 Hz, Q 0.9, Q14 (b2 = -b0, b1 = 0) */
#define BP_A1     (-10336)
#define BP_A2       5603
#define AGC_ATT     5      /* peak tracker: attack 1/32 ...                 */
#define AGC_DEC     10     /* ... decay 1/1024 per sample                   */
#define PK_MIN      16
#define PLL_STEP    8192   /* 65536 per bit / 8 samples per bit             */
#define PLL_CTR     36864  /* transitions pulled to mid-bit + half a sample */
#define PLL_SHIFT   3      /* 1/8 of the error per transition (model_rx.py) */
#define NSL         3      /* slicers                                       */

/* ---- ATIS signal sequence (test/atis.py): 17 DX/RX pairs, 34 symbols ----
 *   DX 125 125 125 125 125 125  A   A   B1 B2 B3 B4 B5  C   D   C   C
 *   RX 111 110 109 108 107 106 105 104  A   A  B1 B2 B3 B4 B5   C   D
 * A format specifier, B1..B5 the identity (two digits each), C end of sequence,
 * D error check. The DX copy of the k-th information symbol (A, B1..B5, C, D)
 * is the symbol INFO0 + 2k of the stream, its RX copy comes RX_LAG later. */
#define SYMBOLS     34u
#define INFO0       14u
#define RX_LAG      5u
#define SLOTS       (SYMBOLS - INFO0)
#define SYM_DX      125u
#define SYM_FORMAT  121u
#define SYM_EOS     127u
#define SYM_BAD     255u   /* check bits wrong */
#define ID_LEN      5u     /* identity: 10 digits, two per symbol */
#define HISTORY     8u

typedef struct {
    uint8_t  id[ID_LEN];               /* 9 MID X1X2 X3X4 X5X6, two digits per byte */
    uint8_t  n;                        /* times heard, up to 255                  */
    int16_t  rssi;
    uint32_t t;                        /* ticks_ms when last heard                */
} station_t;

/* the front end shared by the slicers */
typedef struct {
    int32_t  dc;                       /* DC tracker, Q4                          */
    int32_t  x1, x2, y1, y2;           /* band-pass state                         */
    int32_t  iy, qy, ib, qb;           /* sliding correlator sums                 */
    int32_t  py, pb;                   /* per-tone magnitude peaks (AGC)          */
    uint32_t r, ky, kb;                /* ring slot, 1300 Hz phase, 2100 Hz phase;
                                          words: dem_t is on the stack, where only
                                          words have an sp-relative load/store    */
    int16_t  ring[8][4];               /* the products of the last bit            */
    int8_t   cy[COS1300_LEN], cb[COS2100_LEN];   /* cos tables (assets)           */
} dem_t;
/* listen() loads the initial state and both tables in one asset_read: they
 * must stay back to back, in the assets as in dem_t. */
_Static_assert(COS2100==COS1300+COS1300_LEN && COS1300==DEMOD_INIT+DEMOD_INIT_LEN &&
               offsetof(dem_t,cy)==DEMOD_INIT_LEN &&
               offsetof(dem_t,cb)==offsetof(dem_t,cy)+COS1300_LEN &&
               sizeof(dem_t)==DEMOD_INIT_LEN+COS1300_LEN+COS2100_LEN,
               "demodulator initialization asset must match dem_t");
_Static_assert(BIAS_CODE==2048u && offsetof(dem_t,py)==36u && offsetof(dem_t,pb)==40u,
               "gen_assets.py DEMOD_INIT layout");
_Static_assert(COS2100_LEN==32u, "the 2100 Hz phase wraps with a mask");

/* one slicer: decision weights, DPLL, sequence decoder */
typedef struct {
    int32_t  dprev, phase;             /* last decision, DPLL phase (65536/bit)   */
    uint32_t sr;                       /* the last 30 bits, the oldest in bit 0   */
    uint8_t  wa, wb;                   /* Y / B weights                           */
    uint8_t  idx;                      /* stream index of the last symbol read;
                                          0 = hunting the phasing sequence        */
    uint8_t  nb;                       /* bits of the symbol being read           */
    uint8_t  buf[SLOTS];               /* symbols INFO0..33                       */
} sl_t;

/* The app state in one struct: a function loads one base address instead of one
 * literal-pool word per global. Bytes, then halfwords, then words; the history
 * goes last. The loader zeroes the overlay (.bss) at every launch. */
static struct {
    uint8_t  prevKey, redraw;
    bool     running;
    uint8_t  count, cur;               /* stations kept, station shown (0 = newest) */
    uint8_t  spk;                      /* the saved setting: speaker amplifier on (key 1) */
    uint8_t  refresh;                  /* housekeeping slots since the last redraw */
    uint16_t nOk;                      /* sequences received                      */
    const app_api_t *A;
    char *text;                        /* formatting buffer (app_main's stack)    */
    uint32_t tHit;                     /* ticks_ms of the last sequence           */
    station_t h[HISTORY];              /* newest first                            */
} g;
#define str g.text

/* ---- tiny freestanding helpers: GCC may turn the zeroing / copy loops into calls ---- */
void *memset(void *d, int c, size_t n) {
    uint8_t *p = d; while (n) p[--n] = (uint8_t)c; return d;
}
void *memcpy(void *d, const void *s, size_t n) {
    uint8_t *p = d; const uint8_t *q = s;
    while (n) { --n; p[n] = q[n]; } return d;
}

/* ---- formatting ---- */
__attribute__((noinline))
static char *put(char *o,const char *s){ while(*s)*o++=*s++; return o; }
/* Formatting by repeated subtraction: no division. Values printed stay below 100000. */
static unsigned sub(uint32_t *v,uint32_t d){ unsigned q=0; while(*v>=d){ *v-=d; q++; } return q; }
/* The resident formatter (API level 3). One local stub keeps every call a
 * plain bl: the service lies past the ldr immediate range of the table. */
__attribute__((noinline))
static char *puti(char *o,int32_t v){ return g.A->append_i32(o,v); }
static char *put2(char *o,uint32_t v){ *o++=(char)('0'+sub(&v,10u)); *o++=(char)('0'+v); return o; }

#define WAIT_CAPS_X 40u    /* "WAIT" capsule in the status bar, after the title */
#define SPK_X       59u    /* speaker icon (FoxHunt's, x = 59-68) after the capsule
                              (x <= 56), then the marks at x = 72-76 as in APRS RX,
                              before the battery text (x >= 83): BMP_TAIL in the
                              assets, both in one read */
#define CAPS_END    127u   /* last column of the capsules at the right of the
                              call sign (x >= 89 with "65535" and "2/8") */
#define CH_X        108u   /* the marine channel, in the 20 columns APRS RX gives
                              its symbol */

/* Marine VHF channel of a ship-station frequency (10 Hz units), 0 when it is
 * not one: channels 60-88 from 156.025 MHz and 1-28 from 156.050 MHz, 50 kHz
 * apart, the two series interleaved every 25 kHz. */
static unsigned channel(uint32_t f){
    f-=15602500u;
    if(f>142500u) return 0;                 /* also below the band: f wrapped */
    unsigned k=sub(&f,2500u);
    if(f) return 0;
    return (k&1u) ? 1u+(k>>1) : 60u+(k>>1);
}

/* ---- a valid sequence from a slicer: the station goes (back) to the front of
 * the history, unless another slicer just gave this very sequence ---- */
static void accept(const uint8_t *id){
    const app_api_t *A=g.A;
    uint32_t t=A->ticks_ms();
    station_t e;
    unsigned j=0;
    for(;j<g.count;j++){
        unsigned k=0;
        while(k<ID_LEN && g.h[j].id[k]==id[k]) k++;
        if(k==ID_LEN) break;
    }
    if(j<g.count){
        if(!j && t-g.tHit<DUP_MS) return;
        e=g.h[j];
    } else {
        memset(&e,0,sizeof e);
        memcpy(e.id,id,ID_LEN);
        if(g.count<HISTORY) g.count++;
        j=g.count-1u;                      /* the new last slot, or the oldest station's */
    }
    for(;j;j--) g.h[j]=g.h[j-1u];
    if(e.n<255u) e.n++;
    e.rssi=A->rssi_dbm();                  /* capture while the carrier is still up */
    e.t=t;
    g.h[0]=e;
    g.tHit=t;
    g.nOk++;                               /* wraps after 65535: five digits in its capsule */
    g.cur=0;                               /* show it */
    g.redraw|=REDRAW_FRAME;
}

/* Symbol of a 10-bit word, the first bit received in bit 0: 7 information
 * bits, least significant first, then the number of zeros among them, most
 * significant bit first. SYM_BAD when that count is wrong. */
__attribute__((noinline))
static unsigned sym(uint32_t w){
    unsigned v=w&127u, zeros=7u;
    for(unsigned i=0;i<7u;i++) zeros-=(v>>i)&1u;
    unsigned chk=((w>>7)&1u)*4u+((w>>8)&1u)*2u+((w>>9)&1u);
    return chk==zeros ? v : SYM_BAD;
}

/* The 34 symbols are in: each information symbol from its DX copy, else from
 * its RX copy; then the format specifier, the end of sequence, the digits and
 * the error check (the XOR of the eight is 0). */
static void finish(const sl_t *m){
    uint8_t info[8];
    unsigned x=0;
    for(unsigned k=0;k<8u;k++){
        unsigned v=m->buf[2u*k];
        if(v==SYM_BAD) v=m->buf[2u*k+RX_LAG];
        if(v==SYM_BAD) return;
        info[k]=(uint8_t)v;
        x^=v;
    }
    if(x || info[0]!=SYM_FORMAT || info[6]!=SYM_EOS) return;
    for(unsigned k=1;k<=ID_LEN;k++) if(info[k]>99u) return;
    accept(info+1);
}

/* ---- sequence decoder, one bit (1 = Y, the lower tone). Hunting: the last 30
 * bits hold DX 125, RX 111..104, DX 125, or RX n, DX 125, RX n-1: the symbol
 * phase and the position in the sequence are known (RX 111 - p closes pair p).
 * Then one symbol every 10 bits up to the 34th. Not inlined: its m stays in a
 * register; called 3600 times a second only. ---- */
__attribute__((noinline))
static void seqBit(sl_t *m,uint32_t b){
    uint32_t sr=(m->sr>>1)|(b<<29);
    m->sr=sr;
    unsigned s2=sym(sr>>20);
    unsigned idx=m->idx;
    if(!idx){
        if(s2==SYM_BAD) return;
        unsigned s0=sym(sr&1023u), s1=sym((sr>>10)&1023u);
        if(s0==SYM_DX && s2==SYM_DX && s1-104u<8u) idx=2u*(111u-s1)+2u;      /* s2: DX of the next pair */
        else if(s1==SYM_DX && s2-104u<7u && s0==s2+1u) idx=2u*(111u-s2)+1u;  /* s2: RX of its pair      */
        else return;
        m->nb=0;
        memset(m->buf,(int)SYM_BAD,sizeof m->buf);
    } else {
        if(++m->nb<10u) return;
        m->nb=0;
        idx++;
    }
    if(idx>=INFO0) m->buf[idx-INFO0]=(uint8_t)s2;
    if(idx==SYMBOLS-1u){ idx=0; finish(m); }
    m->idx=(uint8_t)idx;
}

/* |(i, q)| ~ max + 3/8 min */
static int32_t mag(int32_t i,int32_t q){
    if(i<0) i=-i;
    if(q<0) q=-q;
    if(i<q){ int32_t t=i; i=q; q=t; }
    return i+(q>>2)+(q>>3);
}

/* Magnitude of one tone and its peak tracker (AGC). Not inlined: one copy for
 * both tones, two calls per sample. */
__attribute__((noinline))
static int32_t tone(int32_t i,int32_t q,int32_t *pk){
    int32_t mt=mag(i,q), p=*pk;
    p+= mt>p ? (mt-p)>>AGC_ATT : -(p>>AGC_DEC);
    if(p<PK_MIN) p=PK_MIN;
    *pk=p;
    return mt;
}

/* ---- front end, one ADC sample: *a = My*Pb, *b = Mb*Py (each tone over its
 * own peak, without division; both stay below ~2^21) ---- */
static void front(dem_t *m,int32_t adc,int32_t *a,int32_t *b){
    m->dc+=((adc<<4)-m->dc)>>6;
    int32_t x=adc-(m->dc>>4);
    int32_t y=(BP_B0*(x-m->x2)-BP_A1*m->y1-BP_A2*m->y2)>>14;
    m->x2=m->x1; m->x1=x; m->y2=m->y1; m->y1=y;

    /* sliding correlators over one bit (8 samples); the sine is the cos table
     * 3/4 of a period ahead (Q_Y of 96 samples, Q_B of 32) */
    int16_t *o=m->ring[m->r];
    uint32_t ky=m->ky, kb=m->kb;
    uint32_t k=ky+Q_Y; if(k>=COS1300_LEN) k-=COS1300_LEN;
    int32_t p;
    p=(y*m->cy[ky])>>8;                         m->iy+=p-o[0]; o[0]=(int16_t)p;
    p=(y*m->cy[k])>>8;                          m->qy+=p-o[1]; o[1]=(int16_t)p;
    p=(y*m->cb[kb])>>8;                         m->ib+=p-o[2]; o[2]=(int16_t)p;
    p=(y*m->cb[(kb+Q_B)&(COS2100_LEN-1u)])>>8;  m->qb+=p-o[3]; o[3]=(int16_t)p;
    m->r=(m->r+1u)&7u;
    if(++ky>=COS1300_LEN) ky=0;
    m->ky=ky;
    m->kb=(kb+1u)&(COS2100_LEN-1u);

    int32_t my=tone(m->iy,m->qy,&m->py), mb=tone(m->ib,m->qb,&m->pb);
    *a=my*m->pb;
    *b=mb*m->py;
}

/* ---- slicer: decision sign(wa*a - wb*b), DPLL, sequence decoder ---- */
static void slice(sl_t *m,int32_t a,int32_t b){
    int32_t d=a*m->wa-b*m->wb;
    /* DPLL: a bit at each phase wrap (mid-bit), transitions pulled to mid-phase */
    m->phase+=PLL_STEP;
    if((d>0)!=(m->dprev>0)) m->phase+=(PLL_CTR-m->phase)>>PLL_SHIFT;
    m->dprev=d;
    if(m->phase>=65536){
        m->phase-=65536;
        seqBit(m,d>0);                    /* the lower tone (Y) is a 1 */
    }
}

/* ---- display ---- */
__attribute__((noinline))
static void draw(void){
    const app_api_t *A=g.A;
    /* The UI texts live in the assets: one read into this word-aligned stack
     * block, so each text costs a 2-byte sp-relative add instead of a literal
     * and its pool word (gen_assets.py keeps every offset aligned). */
    char s[UI_SIZE] __attribute__((aligned(4)));
    char *o;
    const station_t *e=&g.h[g.cur];      /* read only when there is a station */
    uint8_t *b=A->fb[0];
    A->asset_read(0,s,UI_SIZE);
    A->display_clear();
    A->status_clear();
    A->print_inverse(s+T_TITLE,2,0,true,true,(uint8_t)(2u+T_TITLE_CHARS*4u));
    A->draw_battery();

    if(!g.count)                         /* no station yet: a capsule, as APRS RX */
        A->print_inverse(s+T_WAIT,WAIT_CAPS_X,0,true,true,(uint8_t)(WAIT_CAPS_X+T_WAIT_CHARS*4u));
    else {
        /* the country record of the identity's MID: the first letter of its
         * call signs, then its name; none for an unknown MID */
        uint16_t mids[MID_COUNT];
        char rec[MID_STRIDE];
        char dig[2u*ID_LEN+1u];
        unsigned mid=(unsigned)(e->id[0]-90u)*100u+e->id[1];   /* "9 MID": junk without the 9 */
        unsigned j=0;
        A->asset_read(MIDS,mids,sizeof mids);
        while(j<MID_COUNT && mids[j]!=mid) j++;
        rec[0]=rec[1]='\0';
        if(j<MID_COUNT) A->asset_read((uint16_t)(MID_INFO+j*MID_STRIDE),rec,MID_STRIDE);

        o=dig;
        for(unsigned k=0;k<ID_LEN;k++) o=put2(o,e->id[k]);
        *o='\0';
        /* line 0, bold: the call sign the identity stands for (clause B.1.11:
         * the MID gives the first letter, X1X2 the second one, 01 = A, then the
         * four figures), else the ten digits */
        o=str;
        unsigned x=e->id[2]-1u;
        if(rec[0] && x<26u){ *o++=rec[0]; *o++=(char)('A'+x); o=put(o,dig+6); }
        else o=put(o,dig);
        *o='\0';
        A->print_bold(str,0,0,0);
        /* at its right, two capsules as in APRS RX: once several stations are
         * kept, "2/8" at the edge (the station shown / the stations kept, 1 =
         * newest), and left of it the sequences received */
        unsigned capsEnd=CAPS_END;
        if(g.count>1u){
            o=str; *o++=(char)('1'+g.cur); *o++='/'; *o++=(char)('0'+g.count); *o='\0';
            A->print_inverse(str,CAPS_END-12u,0,false,true,CAPS_END);
            capsEnd-=16u;                 /* that capsule and a blank column */
        }
        o=puti(str,g.nOk); *o='\0';
        A->print_inverse(str,(uint8_t)(capsEnd-4u*(unsigned)(o-str)),0,false,true,(uint8_t)capsEnd);

        A->print_normal(dig,0,0,1);       /* "9244038075"  */
        A->print_normal(rec+1,0,0,2);     /* "Netherlands" */
    }
    /* Status bar from SPK_X: the speaker icon while on, an up mark while a
     * newer station is kept, a down mark while an older one is. */
    unsigned t=g.spk;
    if(g.cur) t+=2u;
    if(g.cur+1u<g.count) t+=4u;
    A->asset_read((uint16_t)(BMP_TAIL+t*TAIL_W),A->status_line+SPK_X,TAIL_W);

    /* dotted separator above the frequency: y = 31, bit 7 of line 3 (the big
     * digits start at y = 33: one blank px between) */
    for(unsigned x=0;x<128u;x+=2u) b[384u+x]|=0x80u;
    uint32_t f=A->rx_freq();
    g.A->draw_frequency(f,0,4);   /* the main screen's big digits, lines 4-5 */
    /* the marine channel, right of the frequency: "CH" over its number */
    unsigned ch=channel(f);
    if(ch){
        A->print_tiny(s+T_CH,CH_X+6u,34,false,true);
        *puti(str,(int32_t)ch)='\0';
        A->print_bold(str,CH_X,127,5);
    }

    /* bottom line: "-89dBm  heard 3  last 02m15", the level of the station
     * shown, the times it was heard, the time since the last one, two digits
     * each: "02m15" (minutes, seconds) under an hour, then "03h07" (hours,
     * minutes). ticks_ms wraps after 49 days, so the hours stay below 1194.
     * print_tiny does not clip: "-120dBm  heard 255  last 1193h02" is the 32
     * characters a row holds. */
    o=str;
    if(g.count){
        uint32_t age=A->ticks_ms()-e->t;
        uint32_t mn=sub(&age,60000u);
        o=puti(o,e->rssi); o=put(o,s+T_DBM);
        o=puti(o,e->n); o=put(o,s+T_LAST);
        if(mn>=60u){
            unsigned h=sub(&mn,60u);
            o=h<100u?put2(o,h):puti(o,(int32_t)h);
            *o++='h';
            o=put2(o,mn);
        } else {
            o=put2(o,mn); *o++='m';
            o=put2(o,sub(&age,1000u));
        }
    }
    *o='\0';
    A->print_tiny(str,0,49,false,true);
}

/* ---- input ---- */
static void handleKeys(void){
    uint8_t key=g.A->get_key();
    if(key==APP_KEY_INVALID||key==g.prevKey){ g.prevKey=key; return; }
    g.prevKey=key;
    g.redraw|=REDRAW_ON;
    /* UP the newer station, DOWN the older one. Raw KEY_UP is UP on K5 and
     * LEFT on K1; KEY_DOWN is DOWN / RIGHT (as APRS RX). */
    unsigned cur=(unsigned)(g.cur+(key==APP_KEY_DOWN)-(key==APP_KEY_UP));
    if(cur<g.count) g.cur=(uint8_t)cur;   /* wraps past the newest: no move */
    if(key==APP_KEY_EXIT) g.running=false;
    else if(key==APP_KEY_2){ g.count=g.cur=0; g.nOk=0; }
    else if(key==APP_KEY_1) g.spk^=1u;   /* speaker: listen() gates it at the next slot */
}

/* ---- keys and screen, between sequences ---- */
static void house(void){
    const app_api_t *A=g.A;
    handleKeys();
    if(!g.running) return;
    if(g.redraw&REDRAW_FRAME) A->backlight_on();   /* wake on a new station */
    A->backlight_update();     /* normal BLTime timeout; keys re-arm it in get_key() */
    if(++g.refresh>=REFRESH_SLOTS) g.redraw|=REDRAW_ON;
    if(!g.redraw) return;
    g.redraw=0;
    g.refresh=0;
    A->battery_sample();         /* yields the capture's ADC itself */
    draw();
    A->blit_status();
    A->blit_full();
}

/* ---- the receiver: PA4 at 9.6 kHz, continuously, until EXIT ---- */
__attribute__((noinline))
static void listen(void){
    const app_api_t *A=g.A;
    dem_t d;
    sl_t sl[NSL];
    memset(sl,0,sizeof sl);
    A->asset_read(DEMOD_INIT,&d,sizeof d);  /* initial state, then both cosine tables */
    /* Decision weights 1300 : 2100 Hz (test/model_rx.py, Demod): on ADC
     * samples captured on a UV-K1 (ATIS DSC RX, which shares this front end),
     * 5:4, 4:3 and 7:5 keep 99.5 to 100 % of the bits right; the former 2:3,
     * 1:1 and 3:2 fell to about 60, 70 and 84 % (issue #705) */
    sl[0].wa=5; sl[0].wb=4;
    sl[1].wa=4; sl[1].wb=3;
    sl[2].wa=7; sl[2].wb=5;

    /* The two per-sample services, held in registers: their table slots lie
     * past the ldr immediate range. */
    uint32_t (*const clk)(void)=g.A->cycles_48mhz;
    uint16_t (*const sample)(void)=g.A->af_capture_sample;
    uint32_t next=clk();                    /* the first sample at once */
    uint16_t cnt=0;
    uint8_t busyFor=0;
    g.redraw=REDRAW_ON;
    while(g.running){
        while((int32_t)(clk()-next)<0){}
        next+=CYC_PER_SAMPLE;
        int32_t a,b;
        front(&d,sample(),&a,&b);
        for(uint8_t k=0;k<NSL;k++) slice(&sl[k],a,b);
        if(++cnt<HOUSE_EVERY) continue;
        cnt=0;
        /* Speaker amplifier: on only while key 1 allows it and the squelch is
         * open (REG_0C bit 1), as APRS RX. Here, ahead of the busy test:
         * house() is skipped during a sequence. The decoder is not gated, it
         * reads the AF output. */
        A->audio_path(g.spk & (A->bk_read(0x0Cu)>>1));
        /* busy: a slicer found the phasing sequence and reads its 34 symbols
         * (0.3 s); a false one in noise releases itself as fast */
        unsigned bz=0;
        for(uint8_t k=0;k<NSL;k++) bz|=sl[k].idx;
        if(bz && ++busyFor<BUSY_MAX) continue;
        busyFor=0;
        house();
        next=clk();                  /* skip the samples the slot took */
    }
}

__attribute__((section(".text.entry"),used))
void app_main(const app_api_t *api){
    char text[34];
    g.A=api;
    g.text=text;
    /* The overlay loader zeroes g; the first idle key scan records APP_KEY_INVALID. */

    api->af_capture_open();      /* PA4 bias and ADC channel 4, restored by close */
    api->backlight_on();
    api->cfg_load(&g.spk,1);     /* speaker; erased flash (0xFF) or junk: off */
    g.spk=(uint8_t)(g.spk==1u);
    /* Speaker amplifier (PA8) as saved, off by default: PA4 joins the audio
     * before the amplifier (APRS RX); only the BK4829 AF output must be on.
     * Key 1 allows the speaker; listen() switches it with the squelch. */
    api->set_af(APP_AF_FM);
    api->delay_ms(50);

    g.running=true;
    listen();

    api->af_capture_close();
    api->set_af(APP_AF_MUTE);
    api->audio_path(false);
    api->cfg_save(&g.spk,1);     /* staged: flash is written only after a change */
}
